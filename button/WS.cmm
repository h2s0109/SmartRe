LOCAL &SCRIPT_SELECTED

LOCAL &SCRIPT_SELECTED_FOLDER

IF (!os.file(~~\Button\Env\SCRIPT_PATH_2.txt))
(
	OPEN  #1 ~~\Button\Env\SCRIPT_PATH_2.txt /CREATE
	WRITE #1 "C:"
	WRITE #1 "C:"
	WRITE #1 "C:"
	WRITE #1 "C:"
	WRITE #1 "C:"
	CLOSE #1
)
	OPEN  #1 ~~\Button\Env\SCRIPT_PATH_2.txt /READ
	READ  #1 %line &SCRIPT_SELECTED
	CLOSE #1
	
	&SCRIPT_SELECTED_FOLDER=os.file.path("&SCRIPT_SELECTED")
	
	store &SCRIPT_SELECTED_FOLDER\*.cmm win
ENDDO
