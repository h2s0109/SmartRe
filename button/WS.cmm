LOCAL &SCRIPT1
LOCAL &SCRIPT2
LOCAL &SCRIPT_SELECTED_CHANGE
LOCAL &SCRIPT_CHANGE1
LOCAL &SCRIPT_CHANGE2
LOCAL &SCRIPT_SELECTED_FOLDER
LOCAL &SCRIPT_FOLDER1
LOCAL &SCRIPT_FOLDER2

IF (!os.file(~~\Button\Env\SCRIPT_PATH.txt))
(
	OPEN  #1 ~~\Button\Env\SCRIPT_PATH.txt /CREATE
	WRITE #1 "C:\"
	WRITE #1 "C:\"
	WRITE #1 "C:\"
	CLOSE #1
)
	OPEN  #1 ~~\Button\Env\SCRIPT_PATH.txt /READ
	READ  #1 %line &SCRIPT_SELECTED
	READ  #1 %line &SCRIPT1
	READ  #1 %line &SCRIPT2
	CLOSE #1
	
	&SCRIPT_SELECTED_FOLDER=os.file.path("&SCRIPT_SELECTED")
	&SCRIPT_FOLDER1=os.file.path("&SCRIPT1")
	&SCRIPT_FOLDER2=os.file.path("&SCRIPT2")
	
	store &SCRIPT_SELECTED_FOLDER\Window_*.cmm win
ENDDO
