

LOCAL &portTC0 &portGTM &addressTC0 &addressGTM

GOSUB setup_intercom

ON CMD COREGTM GOSUB coreGTM

ON CMD CORETC0 GOSUB coreTC0
ON CMD COREGTM GOSUB coreGTM

COREGTM RESet
CORETC0 RESet
; ; set up synchronization between GUIs
CORETC0 SYStem.Option PERSTOP Off //needs to be enabled, GTM acts as periphery
CORETC0 SYnch.Connect &addressGTM
COREGTM SYnch.Connect &addressTC0
CORETC0 SYnch.MasterBreak ON // required
COREGTM SYnch.SlaveBreak ON  // required
CORETC0 SYnch.MasterGo ON    // optional, also served by PERSTOP
COREGTM SYnch.SlaveGo ON     // optional, also served by PERSTOP

COREGTM SYSTEM.CPU TC277TF		// Select CPU
COREGTM sys.config.core 7. 1.		// Select GTM Module of TC277TE CPU
COREGTM SYStem.CONFIG.MCSModule MCS2	// Select MCS channel
COREGTM sys.o.dualport on		// Optional
COREGTM SETUP.Var %SpotLight		// Optional
COREGTM Break.Select Program Onchip 	// Optional
COREGTM TrOnchip.RESet

COREGTM TrOnchip.OTGB0 SELECT MCA
COREGTM TrOnchip.OTGB2 SELECT ARU
COREGTM TrOnchip.OTGB2 Fetch
COREGTM TrOnchip.MCS Module MCS2
COREGTM TrOnchip.MCS Channel ALL

SYSTEM.CONFIG.DEBUGPORTTYPE DAP2
SYSTEM.CONFIG.DAP.DAPEN.ON
SYSTEM.O.DUALPORT.ON
SYSTEM.O.IMASKASM.ON
SYSTEM.O.IMASKHLL.ON
COREGTM SYSTEM.O.DUALPORT.ON
COREGTM SYSTEM.O.IMASKASM.ON
COREGTM SYSTEM.O.IMASKHLL.ON

CORETC0 MAP.BOnchip 0x0--0xffffffff // force onchip-breakpoints
CORETC0 SETUP.VAR %SPOTLIGHT
CORETC0 TargetSystem.state DEFault
CORETC0 SYStem.Up
COREGTM SYStem.Mode Attach
COREGTM Break




ENDDO
setup_intercom:
(
  &portTC0=FORMAT.DECIMAL(1.,INTERCOM.PORT())
  &portGTM=FORMAT.DECIMAL(1.,INTERCOM.PORT()+1.)
  &addressTC0="127.0.0.1:&portTC0"
  &addressGTM="127.0.0.1:&portGTM"
  RETURN
)
coreGTM:
(
  LOCAL &params
  ENTRY %Line &params
  INTERCOM.execute &addressGTM &params ; execute on remote GUI
  RETURN
)
coreTC0:
(
  LOCAL &params
  ENTRY %Line &params
  &params ; execute on this GUI
  RETURN
)
