b::
Sys.d
Sys.u
GO
WAIT 50.ms
PER.Set.simple D:0xF019FD38 %Long 0x11000000
