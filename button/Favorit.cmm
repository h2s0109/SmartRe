
LOCAL &SET_VALUE &SAVE_LOAD_FAV &APPLY_CHECK_FAV &CPU_TYPE_FAV &CONNECT_TYPE_FAV
LOCAL &PATH_SELECTED_FAV &PATH_SELECTED_BOOT_FAV &PATH_SELECTED_NUM_FAV &USEBOOT_DYNA_FAV
ENTRY &SET_VALUE_FAV &SAVE_LOAD_FAV &APPLY_CHECK_FAV &USEBOOT_DYNA_FAV &CPU_TYPE_FAV &CONNECT_TYPE_FAV \
&PATH_SELECTED_FAV &PATH_SELECTED_BOOT_FAV &PATH_SELECTED_NUM_FAV 

GOSUB FAVORIT_MAINSUB  &SET_VALUE_FAV &SAVE_LOAD_FAV &APPLY_CHECK_FAV &USEBOOT_DYNA_FAV &CPU_TYPE_FAV &CONNECT_TYPE_FAV \
&PATH_SELECTED_FAV &PATH_SELECTED_BOOT_FAV &PATH_SELECTED_NUM_FAV 

FAVORIT_MAINSUB:
(
	
	LOCAL &FAV_USE_MAINSUB &FAV_VERI_CHECK_PULLDOWN_MAINSUB
	
	LOCAL &SET_VALUE_FAV_MAINSUB &SAVE_LOAD_FAV_MAINSUB &APPLY_CHECK_FAV_MAINSUB
	LOCAL &CPU_TYPE_FAV_MAINSUB &CONNECT_TYPE_FAV_MAINSUB &PATH_SELECTED_FAV_MAINSUB &PATH_SELECTED_BOOT_FAV_MAINSUB \
	&PATH_SELECTED_NUM_FAV_MAINSUB &USEBOOT_DYNA_FAV_MAINSUB

	ENTRY &SET_VALUE_FAV_MAINSUB &SAVE_LOAD_FAV_MAINSUB &APPLY_CHECK_FAV_MAINSUB &USEBOOT_DYNA_FAV_MAINSUB\
	&CPU_TYPE_FAV_MAINSUB &CONNECT_TYPE_FAV_MAINSUB &PATH_SELECTED_FAV_MAINSUB &PATH_SELECTED_BOOT_FAV_MAINSUB \
	&PATH_SELECTED_NUM_FAV_MAINSUB 
	
	IF &SAVE_LOAD_FAV_MAINSUB=="SAVE"
	(	
		GOSUB FAVORIT_SUB_SAVE &SET_VALUE_FAV_MAINSUB  &USEBOOT_DYNA_FAV_MAINSUB &CPU_TYPE_FAV_MAINSUB &CONNECT_TYPE_FAV_MAINSUB &PATH_SELECTED_FAV_MAINSUB \
		&PATH_SELECTED_BOOT_FAV_MAINSUB &PATH_SELECTED_NUM_FAV_MAINSUB
		ENDDO
	)
	ELSE IF (&APPLY_CHECK_FAV_MAINSUB=="CHANGE") 
	(
		GOSUB FAVORIT_SUB_LOAD &SET_VALUE_FAV_MAINSUB &APPLY_CHECK_FAV_MAINSUB &USEBOOT_DYNA_FAV_MAINSUB &CPU_TYPE_FAV_MAINSUB &CONNECT_TYPE_FAV_MAINSUB &PATH_SELECTED_FAV_MAINSUB\
		&PATH_SELECTED_BOOT_FAV_MAINSUB &PATH_SELECTED_NUM_FAV_MAINSUB \
		&FAV_VERI_CHECK_PULLDOWN_MAINSUB 
		
		ENTRY &FAV_USE_MAINSUB &FAV_VERI_CHECK_PULLDOWN_MAINSUB &CPU_TYPE_FAV_MAINSUB &CONNECT_TYPE_FAV_MAINSUB \
		&PATH_SELECTED_FAV_MAINSUB &PATH_SELECTED_BOOT_FAV_MAINSUB \
		&PATH_SELECTED_NUM_FAV_MAINSUB
		
		ENDDO &FAV_USE_MAINSUB &FAV_VERI_CHECK_PULLDOWN_MAINSUB &CPU_TYPE_FAV_MAINSUB &CONNECT_TYPE_FAV_MAINSUB \
		&PATH_SELECTED_FAV_MAINSUB &PATH_SELECTED_BOOT_FAV_MAINSUB \
		&PATH_SELECTED_NUM_FAV_MAINSUB
	)
	ELSE IF (&SAVE_LOAD_FAV_MAINSUB=="LOAD")
	(
		GOSUB FAVORIT_SUB_LOAD &SET_VALUE_FAV_MAINSUB &APPLY_CHECK_FAV_MAINSUB &USEBOOT_DYNA_FAV_MAINSUB &CPU_TYPE_FAV_MAINSUB &CONNECT_TYPE_FAV_MAINSUB &PATH_SELECTED_FAV_MAINSUB\
		&PATH_SELECTED_BOOT_FAV_MAINSUB &PATH_SELECTED_NUM_FAV_MAINSUB \
		&FAV_VERI_CHECK_PULLDOWN_MAINSUB 
		
		ENTRY &FAV_USE_MAINSUB &FAV_VERI_CHECK_PULLDOWN_MAINSUB &CPU_TYPE_FAV_MAINSUB &CONNECT_TYPE_FAV_MAINSUB \
		&PATH_SELECTED_FAV_MAINSUB &PATH_SELECTED_BOOT_FAV_MAINSUB \
		&PATH_SELECTED_NUM_FAV_MAINSUB
		
		ENDDO &FAV_USE_MAINSUB &FAV_VERI_CHECK_PULLDOWN_MAINSUB &CPU_TYPE_FAV_MAINSUB &CONNECT_TYPE_FAV_MAINSUB \
		&PATH_SELECTED_FAV_MAINSUB &PATH_SELECTED_BOOT_FAV_MAINSUB \
		&PATH_SELECTED_NUM_FAV_MAINSUB
	)
)

FAVORIT_SUB_SAVE:
(
	LOCAL &SET_VALUE_FAV_SAVE &USEBOOT_DYNA_FAV_SAVE &CPU_TYPE_FAV_SAVE &CONNECT_TYPE_FAV_SAVE &PATH_SELECTED_FAV_SAVE \
	&PATH_SELECTED_BOOT_FAV_SAVE &PATH_SELECTED_NUM_FAV_SAVE
	ENTRY &SET_VALUE_FAV_SAVE &USEBOOT_DYNA_FAV_SAVE &CPU_TYPE_FAV_SAVE &CONNECT_TYPE_FAV_SAVE &PATH_SELECTED_FAV_SAVE \
	&PATH_SELECTED_BOOT_FAV_SAVE &PATH_SELECTED_NUM_FAV_SAVE 
	IF &USEBOOT_DYNA_FAV_SAVE==FALSE()
	(
		IF &SET_VALUE_FAV_SAVE=="SET_1"
		(
			OPEN #1 ~~\Button\Env\FAVORITE_SET_1.txt /CREATE
			WRITE #1 "&CPU_TYPE_FAV_SAVE"
			WRITE #1 "&CONNECT_TYPE_FAV_SAVE"
			WRITE #1 "&PATH_SELECTED_FAV_SAVE"
			WRITE #1 "&PATH_SELECTED_NUM_FAV_SAVE"			
			CLOSE #1
		)
		IF &SET_VALUE_FAV_SAVE=="SET_2"
		(
			OPEN #1 ~~\Button\Env\FAVORITE_SET_2.txt /CREATE
			WRITE #1 "&CPU_TYPE_FAV_SAVE"
			WRITE #1 "&CONNECT_TYPE_FAV_SAVE"
			WRITE #1 "&PATH_SELECTED_FAV_SAVE"			
			WRITE #1 "&PATH_SELECTED_NUM_FAV_SAVE"			
			CLOSE #1
		)
	)
	ELSE
	(
		IF &SET_VALUE_FAV_SAVE=="SET_1"
		(
			OPEN #1 ~~\Button\Env\Favorite_SET_1_boot.txt /CREATE
			WRITE #1 "&CPU_TYPE_FAV_SAVE"
			WRITE #1 "&CONNECT_TYPE_FAV_SAVE"
			WRITE #1 "&PATH_SELECTED_FAV_SAVE"
			WRITE #1 "&PATH_SELECTED_BOOT_FAV_SAVE"
			WRITE #1 "&PATH_SELECTED_NUM_FAV_SAVE"			
			CLOSE #1
		)
		IF &SET_VALUE_FAV_SAVE=="SET_2"
		(
			OPEN #1 ~~\Button\Env\Favorite_SET_2_boot.txt /CREATE
			WRITE #1 "&CPU_TYPE_FAV_SAVE"
			WRITE #1 "&CONNECT_TYPE_FAV_SAVE"
			WRITE #1 "&PATH_SELECTED_FAV_SAVE"
			WRITE #1 "&PATH_SELECTED_BOOT_FAV_SAVE"
			WRITE #1 "&PATH_SELECTED_NUM_FAV_SAVE"			
			CLOSE #1
		)
	)
	RETURN
)


FAVORIT_SUB_LOAD:
(
	LOCAL &SET_VALUE_FAV_LOAD &APPLY_CHECK_FAV_LOAD &CPU_TYPE_FAV_LOAD &CONNECT_TYPE_FAV_LOAD
	LOCAL &PATH_SELECTED_FAV_LOAD
	LOCAL &PATH_SELECTED_BOOT_FAV_LOAD &PATH_SELECTED_NUM_FAV_LOAD
	LOCAL &FAV_USE_LOAD &FAV_VERI_CHECK_PULLDOWN_LOAD &USEBOOT_DYNA_FAV_LOAD
	&FAV_USE_LOAD=FALSE()
	ENTRY &SET_VALUE_FAV_LOAD &APPLY_CHECK_FAV_LOAD &USEBOOT_DYNA_FAV_LOAD &CPU_TYPE_FAV_LOAD &CONNECT_TYPE_FAV_LOAD \
	&PATH_SELECTED_FAV_LOAD &PATH_SELECTED_BOOT_FAV_LOAD &PATH_SELECTED_NUM_FAV_LOAD \
	&FAV_VERI_CHECK_PULLDOWN_LOAD 
	
	PRINT "WHO AM I"
	IF &USEBOOT_DYNA_FAV_LOAD==FALSE()
	(
		IF &SET_VALUE_FAV_LOAD=="SET_1"
		(
			PRINT "I AM SET 1"
			IF (os.file(~~\Button\Env\FAVORITE_SET_1.txt))
			(
				OPEN  #1 ~~\Button\Env\FAVORITE_SET_1.txt /READ
				READ  #1 %line &CPU_TYPE_FAV_LOAD
				READ  #1 %line &CONNECT_TYPE_FAV_LOAD
				READ  #1 %line &PATH_SELECTED_FAV_LOAD
				READ  #1 %line &PATH_SELECTED_NUM_FAV_LOAD
				CLOSE #1
				PRINT "&CPU_TYPE_FAV_LOAD" "&CONNECT_TYPE_FAV_LOAD" "&PATH_SELECTED_FAV_LOAD" "&PATH_SELECTED_NUM_FAV_LOAD" "&APPLY_CHECK_FAV_LOAD"
				
				;Apply Varification
				GOSUB FAVORITE_VARIFICATION_SUB &CPU_TYPE_FAV_LOAD &CONNECT_TYPE_FAV_LOAD &PATH_SELECTED_FAV_LOAD \
				&PATH_SELECTED_NUM_FAV_LOAD &APPLY_CHECK_FAV_LOAD \
				&FAV_USE_LOAD &FAV_VERI_CHECK_PULLDOWN_VARI
				
				ENTRY &FAV_USE_LOAD &FAV_VERI_CHECK_PULLDOWN_LOAD  
			)
			ELSE
			(
					&FAV_USE_LOAD=FALSE()
					&FAV_VERI_CHECK_PULLDOWN_LOAD=FALSE()
					PRINT "File can`t finde FAVORITE_SET_1"
			)
		)
		IF &SET_VALUE_FAV_LOAD=="SET_2"
		(
			PRINT "I AM SET 2"
			IF (os.file(~~\Button\Env\Favorite_SET_2.txt))
			(
				OPEN  #1 ~~\Button\Env\Favorite_SET_2.txt /READ
				READ  #1 %line &CPU_TYPE_FAV_LOAD
				READ  #1 %line &CONNECT_TYPE_FAV_LOAD
				READ  #1 %line &PATH_SELECTED_FAV_LOAD
				READ  #1 %line &PATH_SELECTED_NUM_FAV_LOAD
				CLOSE #1			
				PRINT "&CPU_TYPE_FAV_LOAD" "&CONNECT_TYPE_FAV_LOAD" "&PATH_SELECTED_FAV_LOAD" "&PATH_SELECTED_NUM_FAV_LOAD" "&APPLY_CHECK_FAV_LOAD"
				
				;Apply Varification
				GOSUB FAVORITE_VARIFICATION_SUB &CPU_TYPE_FAV_LOAD &CONNECT_TYPE_FAV_LOAD &PATH_SELECTED_FAV_LOAD \
				&PATH_SELECTED_NUM_FAV_LOAD &APPLY_CHECK_FAV_LOAD \
				&FAV_USE_LOAD &FAV_VERI_CHECK_PULLDOWN_VARI
				
				ENTRY &FAV_USE_LOAD &FAV_VERI_CHECK_PULLDOWN_LOAD  
			)
			ELSE
			(
					&FAV_USE_LOAD=FALSE()
					&FAV_VERI_CHECK_PULLDOWN_LOAD=FALSE()
					PRINT "File can`t finde FAVORITE_SET_2"
			)
		)
	)
	ELSE
	(
		IF &SET_VALUE_FAV_LOAD=="SET_1"
		(
			PRINT "I AM SET 1 BOOT"
			IF (os.file(~~\Button\Env\Favorite_SET_1_boot.txt))
			(
				OPEN  #1 ~~\Button\Env\Favorite_SET_1_boot.txt /READ
				READ  #1 %line &CPU_TYPE_FAV_LOAD
				READ  #1 %line &CONNECT_TYPE_FAV_LOAD
				READ  #1 %line &PATH_SELECTED_FAV_LOAD
				READ  #1 %line &PATH_SELECTED_BOOT_FAV_LOAD
				READ  #1 %line &PATH_SELECTED_NUM_FAV_LOAD
				CLOSE #1
				PRINT "&CPU_TYPE_FAV_LOAD" "&CONNECT_TYPE_FAV_LOAD" "&PATH_SELECTED_FAV_LOAD" "&PATH_SELECTED_BOOT_FAV_LOAD" "&PATH_SELECTED_NUM_FAV_LOAD" "&APPLY_CHECK_FAV_LOAD"
				
				;Apply Varification
				GOSUB FAVORITE_VARIFICATION_BOOT_SUB &CPU_TYPE_FAV_LOAD &CONNECT_TYPE_FAV_LOAD &PATH_SELECTED_FAV_LOAD \
				&PATH_SELECTED_BOOT_FAV_LOAD &PATH_SELECTED_NUM_FAV_LOAD &APPLY_CHECK_FAV_LOAD \
				&FAV_USE_LOAD &FAV_VERI_CHECK_PULLDOWN_VARI
				
				ENTRY &FAV_USE_LOAD &FAV_VERI_CHECK_PULLDOWN_LOAD  
			)
			ELSE
			(
					&FAV_USE_LOAD=FALSE()
					&FAV_VERI_CHECK_PULLDOWN_LOAD=FALSE()
					PRINT "File can`t finde FAVORITE_SET_1"
			)
		)
		IF &SET_VALUE_FAV_LOAD=="SET_2"
		(
			PRINT "I AM SET 2 BOOT"
			IF (os.file(~~\Button\Env\Favorite_SET_2_boot.txt))
			(
				OPEN  #1 ~~\Button\Env\Favorite_SET_2_boot.txt /READ
				READ  #1 %line &CPU_TYPE_FAV_LOAD
				READ  #1 %line &CONNECT_TYPE_FAV_LOAD
				READ  #1 %line &PATH_SELECTED_FAV_LOAD
				READ  #1 %line &PATH_SELECTED_BOOT_FAV_LOAD
				READ  #1 %line &PATH_SELECTED_NUM_FAV_LOAD
				CLOSE #1			
				PRINT "&CPU_TYPE_FAV_LOAD" "&CONNECT_TYPE_FAV_LOAD" "&PATH_SELECTED_FAV_LOAD" "&PATH_SELECTED_BOOT_FAV_LOAD" "&PATH_SELECTED_NUM_FAV_LOAD" "&APPLY_CHECK_FAV_LOAD"
				
				;Apply Varification
				GOSUB FAVORITE_VARIFICATION_BOOT_SUB &CPU_TYPE_FAV_LOAD &CONNECT_TYPE_FAV_LOAD &PATH_SELECTED_FAV_LOAD \
				&PATH_SELECTED_BOOT_FAV_LOAD &PATH_SELECTED_NUM_FAV_LOAD &APPLY_CHECK_FAV_LOAD \
				&FAV_USE_LOAD &FAV_VERI_CHECK_PULLDOWN_VARI
				
				ENTRY &FAV_USE_LOAD &FAV_VERI_CHECK_PULLDOWN_LOAD  
			)
			ELSE
			(
					&FAV_USE_LOAD=FALSE()
					&FAV_VERI_CHECK_PULLDOWN_LOAD=FALSE()
					PRINT "File can`t finde FAVORITE_SET_2"
			)
		)
	)
	PRINT "&FAV_USE_LOAD" "&FAV_VERI_CHECK_PULLDOWN_LOAD"
	RETURN &FAV_USE_LOAD &FAV_VERI_CHECK_PULLDOWN_LOAD &CPU_TYPE_FAV_LOAD &CONNECT_TYPE_FAV_LOAD &PATH_SELECTED_FAV_LOAD &PATH_SELECTED_BOOT_FAV_LOAD &PATH_SELECTED_NUM_FAV_LOAD
)

FAVORITE_VARIFICATION_SUB:
(
	LOCAL &CPU_TYPE_FAV_VARI &CONNECT_TYPE_FAV_VARI &PATH_SELECTED_FAV_VARI &PATH_SELECTED_NUM_FAV_VARI &APPLY_CHECK_FAV_VARI
	LOCAL &FAV_USE_VARI &FAV_VERI_CHECK_PULLDOWN_VARI
	
	ENTRY &CPU_TYPE_FAV_VARI &CONNECT_TYPE_FAV_VARI &PATH_SELECTED_FAV_VARI \
	&PATH_SELECTED_NUM_FAV_VARI &APPLY_CHECK_FAV_VARI \
	&FAV_USE_VARI &FAV_VERI_CHECK_PULLDOWN_VARI

	;Apply Varification
	IF (("&CPU_TYPE_FAV_VARI"!="")&&("&CONNECT_TYPE_FAV_VARI"!="")&&("&PATH_SELECTED_FAV_VARI"!="")&&("&PATH_SELECTED_NUM_FAV_VARI"!="")&&(&APPLY_CHECK_FAV_VARI=="APPLY"))
	(
		&FAV_USE_VARI=TRUE()
		&FAV_VERI_CHECK_PULLDOWN_VARI=FALSE()
		PRINT "Apply Varification"
	)
	;Pulldown Varification
	ELSE IF (("&CPU_TYPE_FAV_VARI"!="")&&("&CONNECT_TYPE_FAV_VARI"!="")&&("&PATH_SELECTED_FAV_VARI"!="")&&("&PATH_SELECTED_NUM_FAV_VARI"!="")&&(&APPLY_CHECK_FAV_VARI=="PULLDOWN"))
	(
		&FAV_USE_VARI=FALSE()
		&FAV_VERI_CHECK_PULLDOWN_VARI=TRUE()
		PRINT "Pulldown Varification"
	)
	;Change Varification
	ELSE IF (("&CPU_TYPE_FAV_VARI"!="")&&("&CONNECT_TYPE_FAV_VARI"!="")&&("&PATH_SELECTED_FAV_VARI"!="")&&("&PATH_SELECTED_NUM_FAV_VARI"!="")&&(&APPLY_CHECK_FAV_VARI=="CHANGE"))
	(
		&FAV_USE_VARI=FALSE()
		&FAV_VERI_CHECK_PULLDOWN_VARI=TRUE()
		PRINT "Change Varification"
	)
	ELSE
	(
		&FAV_USE_VARI=FALSE()
		&FAV_VERI_CHECK_PULLDOWN_VARI=FALSE()
		PRINT "Failure"
	)
	RETURN &FAV_USE_VARI &FAV_VERI_CHECK_PULLDOWN_VARI
)

FAVORITE_VARIFICATION_BOOT_SUB:
(
	LOCAL &CPU_TYPE_FAV_VARI &CONNECT_TYPE_FAV_VARI &PATH_SELECTED_FAV_VARI &PATH_SELECTED_BOOT_FAV_VARI &PATH_SELECTED_NUM_FAV_VARI &APPLY_CHECK_FAV_VARI
	LOCAL &FAV_USE_VARI &FAV_VERI_CHECK_PULLDOWN_VARI
	
	ENTRY &CPU_TYPE_FAV_VARI &CONNECT_TYPE_FAV_VARI &PATH_SELECTED_FAV_VARI \
	&PATH_SELECTED_BOOT_FAV_VARI &PATH_SELECTED_NUM_FAV_VARI &APPLY_CHECK_FAV_VARI \
	&FAV_USE_VARI &FAV_VERI_CHECK_PULLDOWN_VARI

	;Apply Varification
	IF (("&CPU_TYPE_FAV_VARI"!="")&&("&CONNECT_TYPE_FAV_VARI"!="")&&("&PATH_SELECTED_FAV_VARI"!="")&&("&PATH_SELECTED_BOOT_FAV_VARI"!="")&&("&PATH_SELECTED_NUM_FAV_VARI"!="")&&(&APPLY_CHECK_FAV_VARI=="APPLY"))
	(
		&FAV_USE_VARI=TRUE()
		&FAV_VERI_CHECK_PULLDOWN_VARI=FALSE()
		PRINT "Apply Varification"
	)
	;Pulldown Varification
	ELSE IF (("&CPU_TYPE_FAV_VARI"!="")&&("&CONNECT_TYPE_FAV_VARI"!="")&&("&PATH_SELECTED_FAV_VARI"!="")&&("&PATH_SELECTED_BOOT_FAV_VARI"!="")&&("&PATH_SELECTED_NUM_FAV_VARI"!="")&&(&APPLY_CHECK_FAV_VARI=="PULLDOWN"))
	(
		&FAV_USE_VARI=FALSE()
		&FAV_VERI_CHECK_PULLDOWN_VARI=TRUE()
		PRINT "Pulldown Varification"
	)
	;Change Varification
	ELSE IF (("&CPU_TYPE_FAV_VARI"!="")&&("&CONNECT_TYPE_FAV_VARI"!="")&&("&PATH_SELECTED_FAV_VARI"!="")&&("&PATH_SELECTED_BOOT_FAV_VARI"!="")&&("&PATH_SELECTED_NUM_FAV_VARI"!="")&&(&APPLY_CHECK_FAV_VARI=="CHANGE"))
	(
		&FAV_USE_VARI=FALSE()
		&FAV_VERI_CHECK_PULLDOWN_VARI=TRUE()
		PRINT "Change Varification"
	)
	ELSE
	(
		&FAV_USE_VARI=FALSE()
		&FAV_VERI_CHECK_PULLDOWN_VARI=FALSE()
		PRINT "Failure"
	)
	RETURN &FAV_USE_VARI &FAV_VERI_CHECK_PULLDOWN_VARI
)

