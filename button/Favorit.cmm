LOCAL &SETTING_VALUE &SAVE_LOAD_FAVORITE &APPLY_CHECK_FAV
LOCAL &FAVORITE_USE &FAVORITE_VERI_CHECK_PULLDOWN &CPU_TYPE_FAVORITE &CONNECT_TYPE_FAVORITE &PATH_SELECTED_FAVORITE &PATH_SELECTED_NUM_FAVORITE
ENTRY &SETTING_VALUE &SAVE_LOAD_FAVORITE &APPLY_CHECK_FAV &CPU_TYPE_FAVORITE &CONNECT_TYPE_FAVORITE &PATH_SELECTED_FAVORITE &PATH_SELECTED_NUM_FAVORITE

FAVORIT_MAINSUB:
(
	IF &SAVE_LOAD_FAVORITE=="SAVE"
	(	
		GOSUB FAVORIT_SUB_SAVE
		ENDDO
	)
	ELSE IF (&APPLY_CHECK_FAV=="CHANGE") 
	(
		GOSUB FAVORIT_SUB_LOAD
		ENDDO &FAVORITE_VERI_CHECK_PULLDOWN &CPU_TYPE_FAVORITE &CONNECT_TYPE_FAVORITE &PATH_SELECTED_FAVORITE &PATH_SELECTED_NUM_FAVORITE
	)
	ELSE IF &SAVE_LOAD_FAVORITE=="LOAD"
	(
		GOSUB FAVORIT_SUB_LOAD
		ENDDO &FAVORITE_USE &FAVORITE_VERI_CHECK_PULLDOWN &CPU_TYPE_FAVORITE &CONNECT_TYPE_FAVORITE &PATH_SELECTED_FAVORITE &PATH_SELECTED_NUM_FAVORITE
	)
)

FAVORIT_SUB_SAVE:
(
	IF &SETTING_VALUE=="SET_1"
	(
		OPEN #1 ~~\Button\Env\FAVORITE_SET_1.txt /CREATE
		WRITE #1 "&CPU_TYPE_FAVORITE"
		WRITE #1 "&CONNECT_TYPE_FAVORITE"
		WRITE #1 "&PATH_SELECTED_FAVORITE"
		WRITE #1 "&PATH_SELECTED_NUM_FAVORITE"			
		CLOSE #1
	)
	IF &SETTING_VALUE=="SET_2"
	(
		OPEN #1 ~~\Button\Env\FAVORITE_SET_2.txt /CREATE
		WRITE #1 "&CPU_TYPE_FAVORITE"
		WRITE #1 "&CONNECT_TYPE_FAVORITE"
		WRITE #1 "&PATH_SELECTED_FAVORITE"
		WRITE #1 "&PATH_SELECTED_NUM_FAVORITE"			
		CLOSE #1
	)

	RETURN
)


FAVORIT_SUB_LOAD:
(
	IF &SETTING_VALUE=="SET_1"
	(
		IF (os.file(~~\Button\Env\FAVORITE_SET_1.txt))
		(
			OPEN  #1 ~~\Button\Env\FAVORITE_SET_1.txt /READ
			READ  #1 %line &CPU_TYPE_FAVORITE
			READ  #1 %line &CONNECT_TYPE_FAVORITE
			READ  #1 %line &PATH_SELECTED_FAVORITE
			READ  #1 %line &PATH_SELECTED_NUM_FAVORITE
			CLOSE #1
			
			IF (("&CPU_TYPE_FAVORITE"!="")&&("&CONNECT_TYPE_FAVORITE"!="")&&("&PATH_SELECTED_FAVORITE"!="")&&("&PATH_SELECTED_NUM_FAVORITE"!="")&&(&APPLY_CHECK_FAV=="APPLY"))
			(
				&FAVORITE_USE=TRUE()
				&FAVORITE_VERI_CHECK_PULLDOWN=FALSE()
			)
			ELSE IF (("&CPU_TYPE_FAVORITE"!="")&&("&CONNECT_TYPE_FAVORITE"!="")&&("&PATH_SELECTED_FAVORITE"!="")&&("&PATH_SELECTED_NUM_FAVORITE"!="")&&(&APPLY_CHECK_FAV=="PULLDOWN"))
			(
				&FAVORITE_USE=FALSE()
				&FAVORITE_VERI_CHECK_PULLDOWN=TRUE()
			)
			ELSE IF (("&CPU_TYPE_FAVORITE"!="")&&("&CONNECT_TYPE_FAVORITE"!="")&&("&PATH_SELECTED_FAVORITE"!="")&&("&PATH_SELECTED_NUM_FAVORITE"!="")&&(&APPLY_CHECK_FAV=="CHANGE"))
			(
				&FAVORITE_VERI_CHECK_PULLDOWN=TRUE()
			)
			ELSE
			(
				&FAVORITE_USE=FALSE()
				&FAVORITE_VERI_CHECK_PULLDOWN=FALSE()
			)	
		)
		ELSE
		(
				&FAVORITE_USE=FALSE()
				&FAVORITE_VERI_CHECK_PULLDOWN=FALSE()
		)
	)
	IF &SETTING_VALUE=="SET_2"
	(
		IF (os.file(~~\Button\Env\FAVORITE_SET_2.txt))
		(
			OPEN  #1 ~~\Button\Env\FAVORITE_SET_2.txt /READ
			READ  #1 %line &CPU_TYPE_FAVORITE
			READ  #1 %line &CONNECT_TYPE_FAVORITE
			READ  #1 %line &PATH_SELECTED_FAVORITE
			READ  #1 %line &PATH_SELECTED_NUM_FAVORITE
			CLOSE #1
			
			IF (("&CPU_TYPE_FAVORITE"!="")&&("&CONNECT_TYPE_FAVORITE"!="")&&("&PATH_SELECTED_FAVORITE"!="")&&("&PATH_SELECTED_NUM_FAVORITE"!="")&&(&APPLY_CHECK_FAV=="APPLY"))
			(
				&FAVORITE_USE=TRUE()
				&FAVORITE_VERI_CHECK_PULLDOWN=FALSE()
			)
			ELSE IF (("&CPU_TYPE_FAVORITE"!="")&&("&CONNECT_TYPE_FAVORITE"!="")&&("&PATH_SELECTED_FAVORITE"!="")&&("&PATH_SELECTED_NUM_FAVORITE"!="")&&(&APPLY_CHECK_FAV=="PULLDOWN"))
			(
				&FAVORITE_USE=FALSE()
				&FAVORITE_VERI_CHECK_PULLDOWN=TRUE()
			)
			ELSE IF (("&CPU_TYPE_FAVORITE"!="")&&("&CONNECT_TYPE_FAVORITE"!="")&&("&PATH_SELECTED_FAVORITE"!="")&&("&PATH_SELECTED_NUM_FAVORITE"!="")&&(&APPLY_CHECK_FAV=="CHANGE"))
			(
				&FAVORITE_VERI_CHECK_PULLDOWN=TRUE()
			)
			ELSE
			(
				&FAVORITE_USE=FALSE()
				&FAVORITE_VERI_CHECK_PULLDOWN=FALSE()
			)	
		)
		ELSE
		(
			&FAVORITE_USE=FALSE()
			&FAVORITE_VERI_CHECK_PULLDOWN=FALSE()
		)
	)
	RETURN
)