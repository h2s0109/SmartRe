LOCAL &SELECT_FAVORITE &SAVE_LOAD_FAVORITE
LOCAL &VERIFY_FAVORITE &CPU_TYPE_FAVORITE &CONNECT_TYPE_FAVORITE &PATH_SELECTED_FAVORITE &PATH_SELECTED_NUM_FAVORITE
ENTRY &SELECT_FAVORITE &SAVE_LOAD_FAVORITE &CPU_TYPE_FAVORITE &CONNECT_TYPE_FAVORITE &PATH_SELECTED_FAVORITE &PATH_SELECTED_NUM_FAVORITE

FAVORIT_MAINSUB:
(
	IF &SAVE_LOAD_FAVORITE=="SAVE"
	(	
		GOSUB FAVORIT_SUB_SAVE
		ENDDO
	)
	ELSE IF &SAVE_LOAD_FAVORITE=="LOAD"
	(
		GOSUB FAVORIT_SUB_LOAD
		ENDDO &VERIFY_FAVORITE &CPU_TYPE_FAVORITE &CONNECT_TYPE_FAVORITE &PATH_SELECTED_FAVORITE &PATH_SELECTED_NUM_FAVORITE
	)
)

FAVORIT_SUB_SAVE:
(
	IF &SELECT_FAVORITE=="SET_1"
	(
		OPEN #1 ~~\Button\Env\FAVORITE_SET_1.txt /CREATE
		WRITE #1 "&CPU_TYPE_FAVORITE"
		WRITE #1 "&CONNECT_TYPE_FAVORITE"
		WRITE #1 "&PATH_SELECTED_FAVORITE"
		WRITE #1 "&PATH_SELECTED_NUM_FAVORITE"			
		CLOSE #1
	)
	IF &SELECT_FAVORITE=="SET_2"
	(
		OPEN #1 ~~\Button\Env\FAVORITE_SET_2.txt /CREATE
		WRITE #1 "&CPU_TYPE_FAVORITE"
		WRITE #1 "&CONNECT_TYPE_FAVORITE"
		WRITE #1 "&PATH_SELECTED_FAVORITE"
		WRITE #1 "&PATH_SELECTED_NUM_FAVORITE"			
		CLOSE #1
	)

	RETURN
)


FAVORIT_SUB_LOAD:
(
	IF &SELECT_FAVORITE=="SET_1"
	(
		IF (os.file(~~\Button\Env\FAVORITE_SET_1.txt))
		(
			OPEN  #1 ~~\Button\Env\FAVORITE_SET_1.txt /READ
			READ  #1 %line &CPU_TYPE_FAVORITE
			READ  #1 %line &CONNECT_TYPE_FAVORITE
			READ  #1 %line &PATH_SELECTED_FAVORITE
			READ  #1 %line &PATH_SELECTED_NUM_FAVORITE
			CLOSE #1
			IF (("&CPU_TYPE_FAVORITE"!="")&&("&CONNECT_TYPE_FAVORITE"!="")&&("&PATH_SELECTED_FAVORITE"!="")&&("&PATH_SELECTED_NUM_FAVORITE"!=""))
			(
				&VERIFY_FAVORITE=TRUE()
				DIALOG.MESSAGE "Below configuration is applied:"\
				"CPU: &CPU_TYPE_FAVORITE"\
				"CONNECT: &CONNECT_TYPE_FAVORITE"\
				"PATH: &PATH_SELECTED_FAVORITE"
			)
			ELSE
			(
				DIALOG.MESSAGE "There is no Favorite information"
				&VERIFY_FAVORITE=FALSE()
			)
		)
		ELSE
		(
		
			DIALOG.MESSAGE "There is no Favorite information"
			&VERIFY_FAVORITE=FALSE()
		)
	)
	IF &SELECT_FAVORITE=="SET_2"
	(
		IF (os.file(~~\Button\Env\FAVORITE_SET_2.txt))
		(
			OPEN  #1 ~~\Button\Env\FAVORITE_SET_2.txt /READ
			READ  #1 %line &CPU_TYPE_FAVORITE
			READ  #1 %line &CONNECT_TYPE_FAVORITE
			READ  #1 %line &PATH_SELECTED_FAVORITE
			READ  #1 %line &PATH_SELECTED_NUM_FAVORITE
			CLOSE #1
			IF (("&CPU_TYPE_FAVORITE"!="")&&("&CONNECT_TYPE_FAVORITE"!="")&&("&PATH_SELECTED_FAVORITE"!="")&&("&PATH_SELECTED_NUM_FAVORITE"!=""))
			(
				&VERIFY_FAVORITE=TRUE()
				DIALOG.MESSAGE "Below configuration is applied:"\
				"CPU: &CPU_TYPE_FAVORITE"\
				"CONNECT: &CONNECT_TYPE_FAVORITE"\
				"PATH: &PATH_SELECTED_FAVORITE"
			)
			ELSE
			(
				DIALOG.MESSAGE "There is no Favorite information"
				&VERIFY_FAVORITE=FALSE()
			)
		)
		ELSE
		(
		
			DIALOG.MESSAGE "There is no Favorite information"
			&VERIFY_FAVORITE=FALSE()
		)
	)
	RETURN
)