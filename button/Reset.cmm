b::
Sys.d
Sys.u
PER.Set.simple D:0xF019FD38 %Long 0x11000000
