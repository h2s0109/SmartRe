
LOCAL &portTC0 &portGTM &addressTC0 &addressGTM

LOCAL &MODE &CORE_SELECTED &GTM_SELECT
LOCAL &MCS_CORE
LOCAL &MCS_CHANNEL_NUMBER
LOCAL &MCS_CORE_CONFIG


IF (!os.file(~~\Button\Env\ETC_PATH.txt))
(
	&FIRST_USER=TRUE()
	OPEN  #1 ~~\Button\Env\ETC_PATH.txt /CREATE
	WRITE #1 "SINGLE"
	WRITE #1 "SIMPLE"
	WRITE #1 "MCS0"
	WRITE #1 "5"
	WRITE #1 "CHANNEL_0"
	WRITE #1 "GTM_YES"
	CLOSE #1
)
	OPEN  #1 ~~\Button\Env\ETC_PATH.txt /READ
	READ  #1 %line &CORE_SELECTED
	READ  #1 %line &MODE
	READ  #1 %line &MCS_CORE
	READ  #1 %line &MCS_CORE_CONFIG
	READ  #1 %line &MCS_CHANNEL_NUMBER
	READ  #1 %line &GTM_SELECT
	CLOSE #1
GOSUB MCS_SUB
ENDDO

setup_intercom:
(
  &portTC0=FORMAT.DECIMAL(1.,10000.)
  &portGTM=FORMAT.DECIMAL(1.,10001.)
  &addressTC0="127.0.0.1:&portTC0"
  &addressGTM="127.0.0.1:&portGTM"
  RETURN
)
coreGTM:
(
  LOCAL &params
  ENTRY %Line &params
  INTERCOM.execute &addressGTM &params ; execute on remote GUI
  RETURN
)
coreTC0:
(
  LOCAL &params
  ENTRY %Line &params
  &params ; execute on this GUI
  RETURN
)


MCS_SUB:
(
	DIALOG
	(
		HEADER "MCS"
		POS 0. 0. 8. 6.
		BOX "CORE"
		POS 1. 1. 5. 1.
		MCS_CORE.0: 	CHOOSEBOX "MCS0" ""
		MCS_CORE.1: 	CHOOSEBOX "MCS1" ""
		MCS_CORE.2: 	CHOOSEBOX "MCS2" ""
		MCS_CORE.3: 	CHOOSEBOX "MCS3" ""
		POS 0. 6. 8.
		BUTTON    "APPLY"
		(
			IF DIALOG.BOOLEAN(MCS_CORE.0)
			(
				&MCS_CORE="MCS0"
				&MCS_CORE_CONFIG="5"
			)
			ELSE IF DIALOG.BOOLEAN(MCS_CORE.1)
			(
				&MCS_CORE="MCS1"
				&MCS_CORE_CONFIG="6"
			)
			ELSE IF DIALOG.BOOLEAN(MCS_CORE.2)
			(
				&MCS_CORE="MCS2"
				&MCS_CORE_CONFIG="7"
			)
			ELSE IF DIALOG.BOOLEAN(MCS_CORE.3)
			(
				&MCS_CORE="MCS3"
				&MCS_CORE_CONFIG="8"
			)
			
			IF DIALOG.BOOLEAN(MCS_CHANNEL.0)
			(
				&MCS_CHANNEL_NUMBER="0"
			)
			ELSE IF DIALOG.BOOLEAN(MCS_CHANNEL.1)
			(
				&MCS_CHANNEL_NUMBER="1"
			)
			ELSE IF DIALOG.BOOLEAN(MCS_CHANNEL.2)
			(
				&MCS_CHANNEL_NUMBER="2"
			)
			ELSE IF DIALOG.BOOLEAN(MCS_CHANNEL.3)
			(
				&MCS_CHANNEL_NUMBER="3"
			)
			ELSE IF DIALOG.BOOLEAN(MCS_CHANNEL.4)
			(
				&MCS_CHANNEL_NUMBER="4"
			)
			ELSE IF DIALOG.BOOLEAN(MCS_CHANNEL.5)
			(
				&MCS_CHANNEL_NUMBER="5"
			)
			ELSE IF DIALOG.BOOLEAN(MCS_CHANNEL.6)
			(
				&MCS_CHANNEL_NUMBER="6"
			)
			ELSE IF DIALOG.BOOLEAN(MCS_CHANNEL.7)
			(
				&MCS_CHANNEL_NUMBER="7"
			)
			GOSUB setup_intercom
			ON CMD CORETC0 GOSUB coreTC0
			ON CMD COREGTM GOSUB coreGTM
			
			coreGTM SYSTEM.DOWN
	
			coreGTM SYSTEM.CONFIG.CORE &MCS_CORE_CONFIG. 1.		// Select GTM Module of TC277TE CPU
			coreGTM SYStem.CONFIG.MCSModule &MCS_CORE	// Select MCS channel
			
			coreGTM TrOnchip.MCS Module &MCS_CORE
			coreGTM TrOnchip.MCS Channel &MCS_CHANNEL_NUMBER
			COREGTM TrOnchip.MCS A ON
			;CORETC0 SYStem.Option PERSTOP off
			CORETC0 SYStem.UP
			
			coreGTM SYStem.Mode Attach
			coreGTM Break
			GOSUB ENVIRONMENT_SUB
			DIALOG.END
		)
		POS 8. 0. 8. 10.
		BOX "CHANNEL"
		POS 10. 1. 3. 1.
		MCS_CHANNEL.0: 	CHOOSEBOX "0" ""
		MCS_CHANNEL.1: 	CHOOSEBOX "1" ""
		MCS_CHANNEL.2: 	CHOOSEBOX "2" ""
		MCS_CHANNEL.3: 	CHOOSEBOX "3" ""
		MCS_CHANNEL.4: 	CHOOSEBOX "4" ""
		MCS_CHANNEL.5: 	CHOOSEBOX "5" ""
		MCS_CHANNEL.6: 	CHOOSEBOX "6" ""
		MCS_CHANNEL.7: 	CHOOSEBOX "7" ""
	)
	
	
	IF	"&MCS_CORE"=="MCS0"
	(
		DIALOG.SET MCS_CORE.0
	)
	ELSE IF	"&MCS_CORE"=="MCS1"
	(
		DIALOG.SET MCS_CORE.1
	)
	ELSE IF	"&MCS_CORE"=="MCS2"
	(
		DIALOG.SET MCS_CORE.2
	)
	ELSE IF	"&MCS_CORE"=="MCS3"
	(
		DIALOG.SET MCS_CORE.3
	)

	IF "&MCS_CHANNEL_NUMBER"=="0"
	(
		DIALOG.SET MCS_CHANNEL.0
	)
	ELSE IF "&MCS_CHANNEL_NUMBER"=="1"
	(
		DIALOG.SET MCS_CHANNEL.1
	)
	ELSE IF "&MCS_CHANNEL_NUMBER"=="2"
	(
		DIALOG.SET MCS_CHANNEL.2
	)	
	ELSE IF "&MCS_CHANNEL_NUMBER"=="3"
	(
		DIALOG.SET MCS_CHANNEL.3
	)
	ELSE IF "&MCS_CHANNEL_NUMBER"=="4"
	(
		DIALOG.SET MCS_CHANNEL.4
	)
	ELSE IF "&MCS_CHANNEL_NUMBER"=="5"
	(
		DIALOG.SET MCS_CHANNEL.5
	)
	ELSE IF "&MCS_CHANNEL_NUMBER"=="6"
	(
		DIALOG.SET MCS_CHANNEL.6
	)
	ELSE IF "&MCS_CHANNEL_NUMBER"=="7"
	(
		DIALOG.SET MCS_CHANNEL.7
	)	
	
STOP
)
ENVIRONMENT_SUB:
(
	OPEN #1 ~~\Button\Env\ETC_PATH.txt /CREATE
	WRITE #1 "&CORE_SELECTED"
	WRITE #1 "&MODE"
	WRITE #1 "&MCS_CORE"
	WRITE #1 "&MCS_CORE_CONFIG"
	WRITE #1 "&MCS_CHANNEL_NUMBER"
	WRITE #1 "&GTM_SELECT"
	CLOSE #1	
	RETURN
)