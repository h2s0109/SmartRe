
ENTRY &MCS_CORE &MCS_CORE_CONFIG &MCS_CHANNEL &CPU_TYPE &CONNECT_TYPE
LOCAL &portTC0 &portGTM &addressTC0 &addressGTM

GOSUB setup_intercom

ON CMD CORETC0 GOSUB coreTC0
ON CMD COREGTM GOSUB coreGTM
ON CMD COREALL GOSUB coreAll
GOSUB other_gui
COREGTM SYSTEM.DOWN

;set up synchronization between GUIs
CORETC0 SYStem.Option PERSTOP Off //needs to be enabled, GTM acts as periphery
CORETC0 SYnch.Connect &addressGTM
COREGTM SYnch.Connect &addressTC0

CORETC0 SYnch.MasterBreak ON 			// required
CORETC0 SYnch.SlaveBreak ON 			// required
CORETC0 SYnch.MasterGo ON   		 	// optional, also served by PERSTOP
CORETC0 SYnch.SlaveGo ON    			// optional, also served by PERSTOP
CORETC0 SYnch.SlaveSystemMode ON    	// optional, also served by PERSTOP
CORETC0 SYnch.MasterSystemMode ON   	// optional, also served by PERSTOP

COREGTM SYnch.SlaveBreak ON  // required
COREGTM SYnch.MasterBreak ON  // required
COREGTM SYnch.SlaveGo ON     // optional, also served by PERSTOP
COREGTM SYnch.MasterGo ON     // optional, also served by PERSTOP
COREGTM SYnch.SlaveSystemMode ON    // optional, also served by PERSTOP
COREGTM SYnch.MasterSystemMode ON    // optional, also served by PERSTOP

COREGTM SYSTEM.CPU &CPU_TYPE		// Select CPU

COREGTM SYSTEM.CONFIG.CORE &MCS_CORE_CONFIG. 1.		// Select GTM Module of TC277TE CPU
COREGTM SYStem.CONFIG.MCSModule &MCS_CORE			// Select MCS Core
COREGTM CORE.select 1 								// Select MCS channel


IF "&CONNECT_TYPE"=="DAP2"
(
	CORETC0 SYSTEM.CONFIG.DEBUGPORTTYPE DAP2
	CORETC0 SYSTEM.CONFIG.DAP.DAPEN.ON
	CORETC0 SYSTEM.JC 10MHZ
	COREGTM SYSTEM.CONFIG.DEBUGPORTTYPE DAP2
	COREGTM SYSTEM.CONFIG.DAP.DAPEN.ON
	COREGTM SYSTEM.JC 10MHZ
)
ELSE IF "&CONNECT_TYPE"=="JTAG"
(
	CORETC0 SYSTEM.CONFIG.DEBUGPORTTYPE JTAG
	COREGTM SYSTEM.CONFIG.DEBUGPORTTYPE JTAG
)

IF CHIP.EmulationDevice()
(
	COREALL MCDS.SOURCE NONE
	COREGTM MCDS.ON
	COREGTM MCDS.SOURCE CpuMux1 Core OTGM
	COREALL MCDS.TimeStamp ON
	COREALL CLOCK.OSCillator 20.MHz
	COREALL CLOCK.ON
	COREALL Trace.METHOD.Onchip
	COREALL Trace.Mode Stack
	COREGTM TrOnchip.RESet
	COREGTM TrOnchip.OTGB2 SELECT ARU
	COREGTM TrOnchip.ARU.Access0 0x77
	COREGTM TrOnchip.ARU.Access1 0x78

	COREGTM TrOnchip.OTGB0 SELECT MCA
	COREGTM TrOnchip.OTGB1 SELECT IOS
	COREGTM TrOnchip.OTGB1 LowBMType ATOM
	COREGTM TrOnchip.OTGB1 HighBMType ATOM
	COREGTM TrOnchip.OTGB1 LowBMInst 0
	COREGTM TrOnchip.OTGB1 HighBMInst 3
	COREGTM TrOnchip.MCS Module &MCS_CORE
	COREGTM TrOnchip.MCS Channel &MCS_CHANNEL
	COREGTM TrOnchip.MCS A ON
)

COREGTM SYSTEM.O.DUALPORT.ON
COREGTM SYSTEM.O.IMASKASM.ON
COREGTM SYSTEM.O.IMASKHLL.ON
CORETC0 SYStem.UP
COREGTM SYStem.Mode Attach
COREGTM Break.direct
COREGTM SETUP.Var %SpotLight			// Optional
COREGTM Break.Select Program Onchip 	// Optional
CORETC0 MAP.BOnchip 0x0--0xffffffff 	// force onchip-breakpoints
COREGTM CORE.select 1
ENDDO
setup_intercom:
(
  &portTC0=FORMAT.DECIMAL(1.,INTERCOM.PORT())
  &portGTM=FORMAT.DECIMAL(1.,INTERCOM.PORT()+1.)
  &addressTC0="127.0.0.1:&portTC0"
  &addressGTM="127.0.0.1:&portGTM"
  RETURN
)
coreGTM:
(
  LOCAL &params
  ENTRY %Line &params
  INTERCOM.execute &addressGTM &params ; execute on remote GUI
  RETURN
)
coreTC0:
(
  LOCAL &params
  ENTRY %Line &params
  &params ; execute on this GUI
  RETURN
)
coreAll:
(
  LOCAL &params
  ENTRY %LINE &params
  GOSUB coreTC0 &params
  GOSUB coreGTM &params
  RETURN
)
other_gui:
(
  WAIT INTERCOM.PING(&addressGTM) 1.s
  IF !INTERCOM.PING(&addressGTM)
  (
    PRINT "no debugger / GUI at &addressGTM detected, launching second GUI..."  
  )
  WAIT INTERCOM.PING(&addressGTM) 1.s
  RETURN
)