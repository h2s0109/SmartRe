// T32_1000009 Fri Apr 03 15:07:13 2015

 B::
 
 TOOLBAR ON
 STATUSBAR ON
 FramePOS -241.57,-8.25,,,Maximized
 WinPAGE.RESet
 
 WinPAGE.Create P000
 
 WinCLEAR
 WinPOS 4.2857 2.5 80. 5. 0. 0. W000
 v.w
 
 VAR.ADDWATCH count
 
 WinPAGE.select P000
 
 ENDDO
