// T32 Tue Oct 28 17:20:22 2014

 B::
 
 TOOLBAR ON
 STATUSBAR ON
 FramePOS 31.25 17.857 177. 41.
 WinPAGE.RESet
 
 WinPAGE.Create P000
 
 WinCLEAR
 WinPOS 115.75 8.1429 55. 21. 0. 1. W003
 WinTABS 20. 15. 20.
 TargetSystem.state DEFault
 
 WinPOS 112.5 1.1429 24. 3. 0. 0. W004
 CORE.SHOWACTIVE
 
 WinPOS 5.625 3.2143 80. 25. 13. 1. W000
 WinTABS 10. 10. 25. 62.
 d.l /core 0
 
 WinPOS 0.875 28.5 80. 25. 13. 1. W001
 WinTABS 10. 10. 25. 62.
 d.l /core 1
 
 WinPOS 78.0 7.7857 80. 25. 13. 1. W002
 WinTABS 10. 10. 25. 62.
 d.l /core 2
 
 WinPOS 58.75 6.8571 51. 16. 0. 0. W005
 SYStem.state
 
 WinPAGE.select P000
 
 ENDDO
