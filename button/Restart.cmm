B::

IF (!os.file(~~\Button\Env\Store_window.cmm))
(
	MKDIR ~~\Button\Env
	OPEN #1 ~~\Button\Env\Store_window.cmm /CREATE
	WRITE #1 "abc"
	CLOSE #1
)
STORE ~~\Button\Env\Store_window.cmm win
PRINT "Working windows store complete."

LOCAL &FIRST_USER
LOCAL &CURRNENT_PATH_USE

LOCAL &PATH_SELECTED
LOCAL &PATH1
LOCAL &PATH2
LOCAL &PATH_SELECTED_CHANGE
LOCAL &PATH_CHANGE1
LOCAL &PATH_CHANGE2
LOCAL &PATH_SELECTED_FOLDER
LOCAL &PATH_FOLDER1
LOCAL &PATH_FOLDER2
LOCAL &PATH_SELECTED

LOCAL &SCRIPT1
LOCAL &SCRIPT2
LOCAL &SCRIPT_SELECTED_CHANGE
LOCAL &SCRIPT_CHANGE1
LOCAL &SCRIPT_CHANGE2
LOCAL &SCRIPT_SELECTED_FOLDER
LOCAL &SCRIPT_FOLDER1
LOCAL &SCRIPT_FOLDER2

LOCAL &CONNECT_TYPE
LOCAL &CONNECT_MODIFY
LOCAL &CPU_TYPE
LOCAL &CPU_TYPE_MODIFY
&FIRST_USER=FALSE()
&CURRNENT_PATH_USE=TRUE()

IF (!os.file(~~\Button\Env\ELF_PATH.txt))
(
	&FIRST_USER=TRUE()
	OPEN  #1 ~~\Button\Env\ELF_PATH.txt /CREATE
	WRITE #1 "C:\"
	WRITE #1 "C:\"
	WRITE #1 "C:\"
	CLOSE #1
)
	OPEN  #1 ~~\Button\Env\ELF_PATH.txt /READ
	READ  #1 %line &PATH_SELECTED
	READ  #1 %line &PATH1
	READ  #1 %line &PATH2
	CLOSE #1
	&PATH_SELECTED_FOLDER=os.file.path("&PATH_SELECTED")
	&PATH_FOLDER1=os.file.path("&PATH1")
	&PATH_FOLDER2=os.file.path("&PATH2")
	
IF (!os.file(~~\Button\Env\SCRIPT_PATH.txt))
(
	&FIRST_USER=TRUE()
	OPEN  #1 ~~\Button\Env\SCRIPT_PATH.txt /CREATE
	WRITE #1 "C:\"
	WRITE #1 "C:\"
	WRITE #1 "C:\"
	CLOSE #1
)
	OPEN  #1 ~~\Button\Env\SCRIPT_PATH.txt /READ
	READ  #1 %line &SCRIPT_SELECTED
	READ  #1 %line &SCRIPT1
	READ  #1 %line &SCRIPT2
	CLOSE #1
	&SCRIPT_SELECTED_FOLDER=os.file.path("&SCRIPT_SELECTED")
	&SCRIPT_FOLDER1=os.file.path("&SCRIPT1")
	&SCRIPT_FOLDER2=os.file.path("&SCRIPT2")	


IF (!os.file(~~\Button\Env\CONNECT_TYPE.txt))
(
	&FIRST_USER=TRUE()
	&CONNECT_TYPE="JTAG"
)
ELSE
(
	OPEN  #1 ~~\Button\Env\CONNECT_TYPE.txt /READ
	READ  #1 %line &CONNECT_TYPE
	CLOSE #1
)

IF (!os.file(~~\Button\Env\CPU_TYPE.txt))
(

	&FIRST_USER=TRUE()
)
ELSE
(
	OPEN  #1 ~~\Button\Env\CPU_TYPE.txt /READ
	READ  #1 %line &CPU_TYPE
	CLOSE #1
)
SYSTEM.DOWN
IF &FIRST_USER
(
	DIALOG.MESSAGE "You are first user."\
	"Click the CHANGE button,please."\
	"If you have question, send a email to me."\
	"       	       Steve.han@infineon.com"
	SYSTEM.CPU TC2*
)
ELSE
(
	SYSTEM.CPU &CPU_TYPE
)

IF "&CONNECT_TYPE"=="DAP"
(
	SYSTEM.CONFIG.DEBUGPORTTYPE DAP2
	SYSTEM.CONFIG.DAP.DAPEN.ON
)
ELSE IF "&CONNECT_TYPE"=="JTAG"
(
	SYSTEM.CONFIG.DEBUGPORTTYPE JTAG
)
SYSTEM.O.DUALPORT.ON
SYSTEM.O.IMASKASM.ON
SYSTEM.O.IMASKHLL.ON

//SYStem.Option PERSTOP OFF //prevent halting the GTM via TriCore (chip bug)

DIALOG
(
  HEADER "Power Reprogram V3.0"
 
  POS 1. 0. 27.
  TEXT "Do you want use current path & setting?"
  POS 1. 3. 27.
  TEXT "Developed by Steve.Han@InfineonKOR"
  
;buttons OK (Default) and Change
  POS 2. 2. 10.
  DEFBUTTON "Yes" "GOTO Reprogram"
  POS 16. 2. 10.
  BUTTON    "Change" "GOTO Change"
;define action when window is closed
  CLOSE "GOTO Close_window_1"
)
STOP

Reprogram:
	&CPU_TYPE=CPU()
	&CPU_TYPE_MID=STRING.MID("&CPU_TYPE",0.,4.)
	IF "&CPU_TYPE_MID"=="TC27"
	(
		DO C:\T32\Button\flash\tc27x_Auto.cmm "&PATH_SELECTED"
	)
	ELSE IF "&CPU_TYPE_MID"=="TC23"
	(
		DO C:\T32\Button\flash\tc23x_Auto.cmm "&PATH_SELECTED"
	)
	ELSE IF "&CPU_TYPE_MID"=="TC26"
	(
		DO C:\T32\Button\flash\tc26x_Auto.cmm "&PATH_SELECTED"
	)
	ELSE IF "&CPU_TYPE_MID"=="TC29"
	(
		DO C:\T32\Button\flash\tc29x_Auto.cmm "&PATH_SELECTED"
	)
	PRINT "&PATH_SELECTED flash complete./&CPU_TYPE"
	IF &CURRNENT_PATH_USE==TRUE()
	(
		GOTO Close_window_1
	)
	ELSE
	(
		GOTO Close_window_2
	)

Change:
	DIALOG.END
	&CURRNENT_PATH_USE=FALSE()
	DIALOG
	(
//-----------------------		PATH_SELECT		-----------------------	
		POS 1. 0. 11.
		LINE "PATH_SELECT"
		HEADER "Change with reprogram"
		POS 1. 1. 6.
		PATH_CHECK.1: CHOOSEBOX "PATH_1" ""
		PATH_CHECK.2: CHOOSEBOX "PATH_2" ""
		
		POS 8. 1. 23.
		PATH_1:   EDIT "*.elf"
		(;get the user input when the cursor leaves the EDIT control
			&PATH_CHANGE1=DIALOG.STRing(PATH_1)
		)
		POS 8. 2. 23.
		PATH_2:   EDIT "*.elf"
		(;get the user input when the cursor leaves the EDIT control
			&PATH_CHANGE2=DIALOG.STRing(PATH_2)
		)
		
		POS 31. 1. 11.
		BUTTON "[:edit]PATH1_CHANGE "
		(
			
			DIALOG.SetFile PATH_1  &PATH_FOLDER1\*.elf
			DIALOG.SET PATH_CHECK.1
		)
		POS 31. 2. 11.
		BUTTON "[:edit]PATH2_CHANGE "
		(
			
			DIALOG.SetFile PATH_2  &PATH_FOLDER2\*.elf
			DIALOG.SET PATH_CHECK.2
		)
//-----------------------		SCRIPT_SELECT		-----------------------
		POS 1. 3. 15.
		LINE "WINDOW_SCRIPT_SELECT"
		POS 1. 4. 6.
		SCRIPT_CHECK.0: CHOOSEBOX "CURRENT" ""
		SCRIPT_CHECK.1: CHOOSEBOX "SCRIPT_1" ""
		SCRIPT_CHECK.2: CHOOSEBOX "SCRIPT_2" ""
		
		POS 8. 5. 23.
		SCRIPT_1:   EDIT "*.elf"
		(;get the user input when the cursor leaves the EDIT control
			&SCRIPT_CHANGE1=DIALOG.STRing(SCRIPT_1)
		)
		POS 8. 6. 23.
		SCRIPT_2:   EDIT "*.elf"
		(;get the user input when the cursor leaves the EDIT control
			&SCRIPT_CHANGE2=DIALOG.STRing(SCRIPT_2)
		)
		
		POS 31. 5. 11.
		BUTTON "[:edit]SCRIPT1_CHANGE "
		(
			
			DIALOG.SetFile SCRIPT_1  &SCRIPT_FOLDER1\*.cmm
			DIALOG.SET SCRIPT_CHECK.1
		)
		POS 31. 6. 11.
		BUTTON "[:edit]SCRIPT2_CHANGE "
		(
			
			DIALOG.SetFile SCRIPT_2  &SCRIPT_FOLDER2\*.cmm
			DIALOG.SET SCRIPT_CHECK.2
		)	
//-----------------------		CONNECTOR_SELECT		-----------------------
		;choosebox group for Connector 
		POS 1. 7. 15.
		LINE "CONNECTOR_SELECT"
		POS 1. 8. 10.
		Option_Connect.1: CHOOSEBOX "DAP2" ""
		Option_Connect.2: CHOOSEBOX "JTAG" ""
//-----------------------		CPU_SELECT		-----------------------
		POS 31. 7. 11.
		BUTTON "[:edit]CPU_CHANGE "
		(
			SYS.CPU *
		)
//-----------------------		OK_SELECT		-----------------------		
		POS 31. 8. 11.
		DEFBUTTON "OK" 
		(		
			//**********************		PATH_CREATION		**********************
			IF (STRING.FIND("elf","&PATH_CHANGE1")||STRING.FIND("elf","&PATH_CHANGE2"))
			(
				IF DIALOG.BOOLEAN(PATH_CHECK.1)
				(
					&PATH_SELECTED="&PATH_CHANGE1"
					OPEN #1 ~~\Button\Env\ELF_PATH.txt /CREATE
					WRITE #1 "&PATH_SELECTED"
					WRITE #1 "&PATH_CHANGE1"
					WRITE #1 "&PATH2"
					CLOSE #1
				)
				ELSE IF DIALOG.BOOLEAN(PATH_CHECK.2)
				(
					&PATH_SELECTED="&PATH_CHANGE2"
					OPEN #1 ~~\Button\Env\ELF_PATH.txt /CREATE
					WRITE #1 "&PATH_SELECTED"
					WRITE #1 "&PATH1"
					WRITE #1 "&PATH_CHANGE2"
					CLOSE #1
				)
			)
			
			IF (STRING.FIND("cmm","&SCRIPT_CHANGE1")||STRING.FIND("cmm","&SCRIPT_CHANGE2"))
			(
				IF DIALOG.BOOLEAN(SCRIPT_CHECK.1)
				(
					&SCRIPT_SELECTED="&SCRIPT_CHANGE1"
					OPEN #1 ~~\Button\Env\SCRIPT_PATH.txt /CREATE
					WRITE #1 "&SCRIPT_SELECTED"
					WRITE #1 "&SCRIPT_CHANGE1"
					WRITE #1 "&SCRIPT2"
					CLOSE #1
				)
				ELSE IF DIALOG.BOOLEAN(SCRIPT_CHECK.2)
				(
					&SCRIPT_SELECTED="&SCRIPT_CHANGE2"
					OPEN #1 ~~\Button\Env\SCRIPT_PATH.txt /CREATE
					WRITE #1 "&SCRIPT_SELECTED"
					WRITE #1 "&SCRIPT1"
					WRITE #1 "&SCRIPT_CHANGE2"
					CLOSE #1
				)
			)

			&CPU_TYPE_MODIFY=CPU()
			IF (("&CPU_TYPE_MODIFY"!="&CPU_TYPE")||(!os.file(~~\Button\Env\CPU_TYPE.txt)))
			(		
				OPEN #1 ~~\Button\Env\CPU_TYPE.txt /CREATE
				WRITE #1 CPU()
				CLOSE #1
			)			
			
			IF DIALOG.BOOLEAN(Option_Connect.1)
			(
				SYSTEM.CONFIG.DEBUGPORTTYPE DAP2
				SYSTEM.CONFIG.DAP.DAPEN.ON
				&CONNECT_MODIFY="DAP2"
			)
			ELSE IF DIALOG.BOOLEAN(Option_Connect.2)
			(
				SYSTEM.CONFIG.DEBUGPORTTYPE JTAG
				&CONNECT_MODIFY="JTAG"
			)
			
			IF ("&CONNECT_TYPE"!="&CONNECT_MODIFY")||(!os.file(~~\Button\Env\CONNECT_TYPE.txt))
			(
				OPEN  #1 ~~\Button\Env\CONNECT_TYPE.txt /CREATE
				WRITE  #1 "&CONNECT_MODIFY"
				CLOSE #1
			)
			GOSUB Reprogram
		)
//-----------------------		CLOSE_SELECT		-----------------------		
	  ;define action when window is closed
		CLOSE "GOTO Close_window_1"
	)
//-----------------------		DEFAULT_ACTION		-----------------------			
	DIALOG.SetFile PATH_1  "&PATH1"
	DIALOG.SetFile PATH_2  "&PATH2"
	DIALOG.SetFile SCRIPT_1  "&SCRIPT1"
	DIALOG.SetFile SCRIPT_2  "&SCRIPT2"	
	DIALOG.SET PATH_CHECK.1
	DIALOG.SET SCRIPT_CHECK.0
	DIALOG.SET Option_Connect.1
	STOP
	
Close_window_2:
IF DIALOG.BOOLEAN(SCRIPT_CHECK.0)==FALSE()
(
	WINCLEAR
	DO &SCRIPT_SELECTED win
)
DIALOG.END

ENDDO


Close_window_1:
DIALOG.END
ENDDO


