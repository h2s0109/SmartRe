B::

IF (!os.file(~~\Button\Env\Store_window.cmm))
(
	MKDIR ~~\Button\Env
	OPEN #1 ~~\Button\Env\Store_window.cmm /CREATE
	WRITE #1 "abc"
	CLOSE #1
)
STORE ~~\Button\Env\Store_window.cmm win
PRINT "Working windows store complete."
WINCLEAR

LOCAL &FIRST_USER
LOCAL &PATH_SELECTED
LOCAL &PATH1
LOCAL &PATH2
LOCAL &PATH_SELECTED_CHANGE
LOCAL &PATH_CHANGE1
LOCAL &PATH_CHANGE2
LOCAL &PATH_SELECTED_FOLDER
LOCAL &PATH_FOLDER1
LOCAL &PATH_FOLDER2
LOCAL &CONNECT_TYPE
LOCAL &CONNECT_MODIFY
LOCAL &CPU_TYPE
LOCAL &CPU_TYPE_MODIFY
&FIRST_USER=FALSE()

IF (!os.file(~~\Button\Env\ELF_PATH.txt))
(
	&FIRST_USER=TRUE()
	OPEN  #1 ~~\Button\Env\ELF_PATH.txt /CREATE
	WRITE #1 "C:\"
	WRITE #1 "C:\"
	WRITE #1 "C:\"
	CLOSE #1
)
	OPEN  #1 ~~\Button\Env\ELF_PATH.txt /READ
	READ  #1 %line &PATH_SELECTED
	READ  #1 %line &PATH1
	READ  #1 %line &PATH2
	CLOSE #1
	&PATH_SELECTED_FOLDER=os.file.path("&PATH_SELECTED")
	&PATH_FOLDER1=os.file.path("&PATH1")
	&PATH_FOLDER2=os.file.path("&PATH2")


IF (!os.file(~~\Button\Env\CONNECT_TYPE.txt))
(
	&FIRST_USER=TRUE()
	&CONNECT_TYPE="JTAG"
)
ELSE
(
	OPEN  #1 ~~\Button\Env\CONNECT_TYPE.txt /READ
	READ  #1 %line &CONNECT_TYPE
	CLOSE #1
)

IF (!os.file(~~\Button\Env\CPU_TYPE.txt))
(

	&FIRST_USER=TRUE()
)
ELSE
(
	OPEN  #1 ~~\Button\Env\CPU_TYPE.txt /READ
	READ  #1 %line &CPU_TYPE
	CLOSE #1
)
SYSTEM.DOWN
SYSTEM.O.DUALPORT.ON
SYSTEM.O.IMASKASM.ON
SYSTEM.O.IMASKHLL.ON
IF &FIRST_USER
(
	DIALOG.MESSAGE "You are first user."\
	"Click the CHANGE button,please."\
	"If you have question, send a email to me."\
	"       	       Steve.han@infineon.com"
	SYSTEM.CPU TC27*
)
ELSE
(
	SYSTEM.CPU &CPU_TYPE
)

IF "&CONNECT_TYPE"=="DAP"
(
SYSTEM.CONFIG.DEBUGPORTTYPE DAP2
SYSTEM.CONFIG.DAP.DAPEN.ON
)
ELSE IF "&CONNECT_TYPE"=="JTAG"
(
SYSTEM.CONFIG.DEBUGPORTTYPE JTAG
)



//SYStem.Option PERSTOP OFF //prevent halting the GTM via TriCore (chip bug)

DIALOG
(
  HEADER "Power Reprogram V2.0"
 
  POS 1. 0. 27.
  TEXT "Do you want use current path & setting?"
  POS 1. 3. 27.
  TEXT "Developed by Steve.Han@InfineonKOR"
  
;buttons OK (Default) and Change
  POS 2. 2. 10.
  DEFBUTTON "Yes" "GOTO Reprogram"
  POS 16. 2. 10.
  BUTTON    "Change" "GOTO Change"
;define action when window is closed
  CLOSE "GOTO Close_window"
)
STOP

Reprogram:
	&CPU_TYPE=CPU()
	&CPU_TYPE_MID=STRING.MID("&CPU_TYPE",0.,4.)
	IF "&CPU_TYPE_MID"=="TC27"
	(
		DO C:\T32\Button\flash\tc27x_Auto.cmm "&PATH_SELECTED"
	)
	ELSE IF "&CPU_TYPE_MID"=="TC23"
	(
		DO C:\T32\Button\flash\tc23x_Auto.cmm "&PATH_SELECTED"
	)
	ELSE IF "&CPU_TYPE_MID"=="TC26"
	(
		DO C:\T32\Button\flash\tc26x_Auto.cmm "&PATH_SELECTED"
	)
	ELSE IF "&CPU_TYPE_MID"=="TC29"
	(
		DO C:\T32\Button\flash\tc29x_Auto.cmm "&PATH_SELECTED"
	)
	PRINT "&PATH_SELECTED flash complete./&CPU_TYPE"
	GOTO Close_window

Change:
	DIALOG.END
	DIALOG
	(
		HEADER "Change with reprogram"
		POS 1. 0. 6.
		PATH_CHECK.1: CHOOSEBOX "PATH_1" ""
		PATH_CHECK.2: CHOOSEBOX "PATH_2" ""
		
		POS 8. 0. 23.
		PATH_1:   EDIT "*.elf"
		(;get the user input when the cursor leaves the EDIT control
			&PATH_CHANGE1=DIALOG.STRing(PATH_1)
		)
		POS 8. 1. 23.
		PATH_2:   EDIT "*.elf"
		(;get the user input when the cursor leaves the EDIT control
			&PATH_CHANGE2=DIALOG.STRing(PATH_2)
		)
		
		POS 31. 0. 11.
		BUTTON "[:edit]PATH1_CHANGE "
		(
			
			DIALOG.SetFile PATH_1  &PATH_FOLDER1\*.elf
		)
		POS 31. 1. 11.
		BUTTON "[:edit]PATH2_CHANGE "
		(
			
			DIALOG.SetFile PATH_2  &PATH_FOLDER2\*.elf
		)				
		
		;choosebox group for Connector 
		POS 13. 2. 10.
		LINE "Connector"
		POS 15. 3. 10.
		Option_Connect.1: CHOOSEBOX "DAP2" ""
		Option_Connect.2: CHOOSEBOX "JTAG" ""
	
		POS 31. 2. 11.
		BUTTON "[:edit]CPU_CHANGE "
		(
			SYS.CPU *
		)
		POS 31. 3. 11.
		DEFBUTTON "OK" 
		(		
			IF (STRING.FIND("elf","&PATH_CHANGE1")||STRING.FIND("elf","&PATH_CHANGE2"))
			(
				IF DIALOG.BOOLEAN(PATH_CHECK.1)
				(
					&PATH_SELECTED="&PATH_CHANGE1"
					OPEN #1 ~~\Button\Env\ELF_PATH.txt /CREATE
					WRITE #1 "&PATH_SELECTED"
					WRITE #1 "&PATH_CHANGE1"
					WRITE #1 "&PATH2"
					CLOSE #1
				)
				ELSE IF DIALOG.BOOLEAN(PATH_CHECK.2)
				(
					&PATH_SELECTED="&PATH_CHANGE2"
					OPEN #1 ~~\Button\Env\ELF_PATH.txt /CREATE
					WRITE #1 "&PATH_SELECTED"
					WRITE #1 "&PATH1"
					WRITE #1 "&PATH_CHANGE2"
					CLOSE #1
				)
			)

			&CPU_TYPE_MODIFY=CPU()
			IF (("&CPU_TYPE_MODIFY"!="&CPU_TYPE")||(!os.file(~~\Button\Env\CPU_TYPE.txt)))
			(		
				OPEN #1 ~~\Button\Env\CPU_TYPE.txt /CREATE
				WRITE #1 CPU()
				CLOSE #1
			)			
			
			IF DIALOG.BOOLEAN(Option_Connect.1)
			(
				SYSTEM.CONFIG.DEBUGPORTTYPE DAP2
				SYSTEM.CONFIG.DAP.DAPEN.ON
				&CONNECT_MODIFY="DAP2"
			)
			ELSE IF DIALOG.BOOLEAN(Option_Connect.2)
			(
				SYSTEM.CONFIG.DEBUGPORTTYPE JTAG
				&CONNECT_MODIFY="JTAG"
			)
			
			IF ("&CONNECT_TYPE"!="&CONNECT_MODIFY")||(!os.file(~~\Button\Env\CONNECT_TYPE.txt))
			(
				OPEN  #1 ~~\Button\Env\CONNECT_TYPE.txt /CREATE
				WRITE  #1 "&CONNECT_MODIFY"
				CLOSE #1
			)
			GOSUB Reprogram
		)
	  ;define action when window is closed
		CLOSE "GOTO Close_window"
	)
	DIALOG.SetFile PATH_1  "&PATH1"
	DIALOG.SetFile PATH_2  "&PATH2"
	DIALOG.SET PATH_CHECK.1
	DIALOG.SET Option_Connect.1
	STOP
	
Close_window:
DIALOG.END
DO ~~\Button\Env\Store_window.cmm win
ENDDO

