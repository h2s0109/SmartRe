B::

IF (!os.file(~~\Button\Env\Store_window.cmm))
(
	MKDIR ~~\Button\Env
	OPEN #1 ~~\Button\Env\Store_window.cmm /CREATE
	WRITE #1 "abc"
	CLOSE #1
)
STORE ~~\Button\Env\Store_window.cmm win
PRINT "Working windows store complete."
WINCLEAR

LOCAL &FIRST_USER
LOCAL &PATH
LOCAL &PATH_CHANGE
LOCAL &CONNECT_TYPE
LOCAL &CONNECT_MODIFY
LOCAL &CPU_TYPE
LOCAL &CPU_TYPE_MODIFY
&FIRST_USER=FALSE()

IF (!os.file(~~\Button\Env\ELF_PATH.txt))
(
	&FIRST_USER=TRUE()
)
ELSE
(
	OPEN  #1 ~~\Button\Env\ELF_PATH.txt /READ
	READ  #1 %line &PATH
	CLOSE #1
)

IF (!os.file(~~\Button\Env\CONNECT_TYPE.txt))
(
	&FIRST_USER=TRUE()
	&CONNECT_TYPE="JTAG"
)
ELSE
(
	OPEN  #1 ~~\Button\Env\CONNECT_TYPE.txt /READ
	READ  #1 %line &CONNECT_TYPE
	CLOSE #1
)

IF (!os.file(~~\Button\Env\CPU_TYPE.txt))
(

	&FIRST_USER=TRUE()
)
ELSE
(
	OPEN  #1 ~~\Button\Env\CPU_TYPE.txt /READ
	READ  #1 %line &CPU_TYPE
	CLOSE #1
)
SYSTEM.DOWN
SYSTEM.O.DUALPORT.ON
SYSTEM.O.IMASKASM.ON
SYSTEM.O.IMASKHLL.ON
IF &FIRST_USER
(
	DIALOG.MESSAGE "You are first user."\
	"Click the CHANGE button,please."\
	"If you have question, send a email to me."\
	"       	       Steve.han@infineon.com"
	SYSTEM.CPU TC27*
)
ELSE
(
	SYSTEM.CPU &CPU_TYPE
)

IF "&CONNECT_TYPE"=="DAP"
(
SYSTEM.CONFIG.DEBUGPORTTYPE DAP2
SYSTEM.CONFIG.DAP.DAPEN.ON
)
ELSE IF "&CONNECT_TYPE"=="JTAG"
(
SYSTEM.CONFIG.DEBUGPORTTYPE JTAG
)



//SYStem.Option PERSTOP OFF //prevent halting the GTM via TriCore (chip bug)

DIALOG
(
  HEADER "Power Reprogram"
 
  POS 1. 0. 27.
  TEXT "Do you want use current path & setting?"
  POS 1. 3. 27.
  TEXT "Developed by Steve.Han@InfineonKOR"
  
;buttons OK (Default) and Change
  POS 2. 2. 10.
  DEFBUTTON "Yes" "GOTO Reprogram"
  POS 16. 2. 10.
  BUTTON    "Change" "GOTO Change"
;define action when window is closed
  CLOSE "GOTO Close_window"
)
STOP

Reprogram:
	&CPU_TYPE=CPU()
	&CPU_TYPE_MID=STRING.MID("&CPU_TYPE",0.,4.)
	IF "&CPU_TYPE_MID"=="TC27"
	(
		DO C:\T32\Button\flash\tc27x_Auto.cmm "&PATH"
	)
	ELSE IF "&CPU_TYPE_MID"=="TC23"
	(
		DO C:\T32\Button\flash\tc23x_Auto.cmm "&PATH"
	)
	ELSE IF "&CPU_TYPE_MID"=="TC26"
	(
		DO C:\T32\Button\flash\tc26x_Auto.cmm "&PATH"
	)
	ELSE IF "&CPU_TYPE_MID"=="TC29"
	(
		DO C:\T32\Button\flash\tc29x_Auto.cmm "&PATH"
	)
	PRINT "&PATH flash complete./&CPU_TYPE"
	GOTO Close_window

Change:
	DIALOG.END
	DIALOG
	(
		HEADER "Change with reprogram"
		
		POS 1. 0. 20.
		myInputB:   EDIT "*.elf"
		(;get the user input when the cursor leaves the EDIT control
			&PATH_CHANGE=DIALOG.STRing(myInputB)
		)
		;choosebox group for Connector 
		POS 5. 1. 10.
		LINE "Connector"
		POS 7. 2. 10. 1.
		Option_Connect.1: CHOOSEBOX "DAP2" ""
		Option_Connect.2: CHOOSEBOX "JTAG" ""
		
		POS 22. 0. 11.
		BUTTON "[:edit]PATH_CHANGE "
		(
			
			DIALOG.SetFile myInputB  *.elf
		)
		POS 22. 1. 11.
		BUTTON "[:edit]CPU_CHANGE "
		(
			SYS.CPU *
		)
		POS 22. 2. 11.
		DEFBUTTON "OK" 
		(
			IF STRING.FIND("elf","&PATH_CHANGE")
			(
				OPEN #1 ~~\Button\Env\ELF_PATH.txt /CREATE
				WRITE #1 "&PATH_CHANGE"
				CLOSE #1
				&PATH="&PATH_CHANGE"
			)

			&CPU_TYPE_MODIFY=CPU()
			IF (("&CPU_TYPE_MODIFY"!="&CPU_TYPE")||(!os.file(~~\Button\Env\CPU_TYPE.txt)))
			(		
				OPEN #1 ~~\Button\Env\CPU_TYPE.txt /CREATE
				WRITE #1 CPU()
				CLOSE #1
			)			
			
			IF DIALOG.BOOLEAN(Option_Connect.1)
			(
				SYSTEM.CONFIG.DEBUGPORTTYPE DAP2
				SYSTEM.CONFIG.DAP.DAPEN.ON
				&CONNECT_MODIFY="DAP2"
			)
			ELSE IF DIALOG.BOOLEAN(Option_Connect.2)
			(
				SYSTEM.CONFIG.DEBUGPORTTYPE JTAG
				&CONNECT_MODIFY="JTAG"
			)
			
			IF ("&CONNECT_TYPE"!="&CONNECT_MODIFY")||(!os.file(~~\Button\Env\CONNECT_TYPE.txt))
			(
				OPEN  #1 ~~\Button\Env\CONNECT_TYPE.txt /CREATE
				WRITE  #1 "&CONNECT_MODIFY"
				CLOSE #1
			)
			GOSUB Reprogram
		)
	  ;define action when window is closed
		CLOSE "GOTO Close_window"
	)
	DIALOG.SET Option_Connect.1
	STOP
	
Close_window:
DIALOG.END
DO ~~\Button\Env\Store_window.cmm win
ENDDO

