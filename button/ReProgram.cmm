B::
SYSTEM.DOWN
LOCAL &portTC0 &portGTM &addressTC0 &addressGTM
GOSUB setup_intercom
ON CMD CORETC0 GOSUB coreTC0
ON CMD COREGTM GOSUB coreGTM

LOCAL &CURRENT_PATH_USE

LOCAL &PATH_SELECTED
LOCAL &PATH1
LOCAL &PATH2
LOCAL &PATH3
LOCAL &PATH4
LOCAL &PATH_SELECTED_CHANGE
LOCAL &PATH_CHANGE1
LOCAL &PATH_CHANGE2
LOCAL &PATH_CHANGE3
LOCAL &PATH_CHANGE4
LOCAL &PATH_SELECTED_FOLDER
LOCAL &PATH_FOLDER1
LOCAL &PATH_FOLDER2
LOCAL &PATH_FOLDER3
LOCAL &PATH_FOLDER4
LOCAL &PATH_SELECTED_NUM_CHECK
LOCAL &PATH_SELECTED_NUM_ELF

LOCAL &ELF_PATH_CORE

;Window save script
LOCAL &SCRIPT1
LOCAL &SCRIPT2
LOCAL &SCRIPT_CHANGE1
LOCAL &SCRIPT_CHANGE2
LOCAL &SCRIPT_SELECTED_FOLDER
LOCAL &SCRIPT_FOLDER1
LOCAL &SCRIPT_FOLDER2

;Favorite
LOCAL &FAVORITE_USE
LOCAL &FAVORITE_VERI_CHECK_PULLDOWN
LOCAL &CPU_TYPE_FAVORITE
LOCAL &CPU_TYPE_FAVORITE_TEMP
LOCAL &CONNECT_TYPE_FAVORITE
LOCAL &CONNECT_TYPE_FAVORITE_TEMP
LOCAL &PATH_SELECTED_FAVORITE
LOCAL &PATH_SELECTED_FAVORITE_TEMP
LOCAL &PATH_SELECTED_NUM_FAVORITE
&FAVORITE_USE=FALSE()
&FAVORITE_VERI_CHECK_PULLDOWN=FALSE()

;Previous
LOCAL &CONNECT_TYPE_PREVIOUS
LOCAL &CPU_TYPE_PREVIOUS
LOCAL &PATH_SELECTED_PREVIOUS

LOCAL &CONNECT_TYPE
LOCAL &CONNECT_TYPE_LAST
LOCAL &CONNECT_MODIFY
LOCAL &CPU_TYPE
LOCAL &CPU_TYPE_MID
LOCAL &CPU_TYPE_TEMP
LOCAL &CPU_TYPE_TEMP_COMPARE
LOCAL &CPU_TYPE_TEMP_COMPARE_STAR
LOCAL &CPU_TYPE_TEMP_SELECT
LOCAL &CPU_TYPE_MODIFY


;Core
LOCAL &CORE_SELECTED
LOCAL &SINGLE_CORE_T
LOCAL &DOUBLE_CORE_T
LOCAL &TRIPLE_CORE_T

&SINGLE_CORE_T=FALSE()
&DOUBLE_CORE_T=FALSE()
&TRIPLE_CORE_T=FALSE()


;ETC Functionality
LOCAL &MULTI_CORE_WINDOW_T
LOCAL &CORE_STATE_T
LOCAL &MODE

&MULTI_CORE_WINDOW_T=FALSE()
&CORE_STATE_T=FALSE()

LOCAL &MCS_CORE
LOCAL &MCS_CHANNEL_NUMBER
LOCAL &MCS_CORE_CONFIG
LOCAL &GTM_SELECT

//-----------------------		FILE_CHECK&CREATION		-----------------------
IF (!os.file(~~\Button\Env\PREVIOUS_TYPE.txt))
(
	DIALOG.MESSAGE "You are first user."\
	"Click the CHANGE button,please."\
	"If you have question, send a email to me."\
	"       	       Steve.han@infineon.com"
	SYSTEM.CPU TC2*
	&CPU_TYPE_PREVIOUS=CPU()
	&CONNECT_TYPE_PREVIOUS="JTAG"
	&PATH_SELECTED_PREVIOUS="C:\"
	MKDIR ~~\Button\Env
	MKDIR ~~\Button\Env\Elf_path
	OPEN  #1 ~~\Button\Env\PREVIOUS_TYPE.txt /CREATE
	WRITE #1 "TC277TF"
	WRITE #1 "JTAG"
	WRITE #1 "C:\"
	CLOSE #1
	
	
)
ELSE
(
	OPEN #1 ~~\Button\Env\PREVIOUS_TYPE.txt /READ
	READ  #1 %line &CPU_TYPE_PREVIOUS
	READ  #1 %line &CONNECT_TYPE_PREVIOUS
	READ  #1 %line &PATH_SELECTED_PREVIOUS
	CLOSE #1
	IF "&PATH_SELECTED_PREVIOUS"==""
	(
		&PATH_SELECTED_PREVIOUS="C:\"
	)
	SYSTEM.CPU &CPU_TYPE_PREVIOUS
)

&CONNECT_TYPE="&CONNECT_TYPE_PREVIOUS"
&CPU_TYPE="&CPU_TYPE_PREVIOUS"
&PATH_SELECTED="&PATH_SELECTED_PREVIOUS"

IF (!os.file(~~\Button\Env\ETC_PATH.txt))
(
	OPEN  #1 ~~\Button\Env\ETC_PATH.txt /CREATE
	WRITE #1 "SINGLE"
	WRITE #1 "SIMPLE"
	WRITE #1 "MCS0"
	WRITE #1 "5"
	WRITE #1 "CHANNEL_0"
	WRITE #1 "GTM_NO"
	CLOSE #1
)
	OPEN  #1 ~~\Button\Env\ETC_PATH.txt /READ
	READ  #1 %line &CORE_SELECTED
	READ  #1 %line &MODE
	READ  #1 %line &MCS_CORE
	READ  #1 %line &MCS_CORE_CONFIG
	READ  #1 %line &MCS_CHANNEL_NUMBER
	READ  #1 %line &GTM_SELECT
	CLOSE #1
	
IF (!os.file(~~\Button\Env\SCRIPT_PATH_2.txt))
(
	OPEN  #1 ~~\Button\Env\SCRIPT_PATH_2.txt /CREATE
	WRITE #1 "C:"
	WRITE #1 "C:"
	WRITE #1 "C:"
	CLOSE #1
)
	OPEN  #1 ~~\Button\Env\SCRIPT_PATH_2.txt /READ
	READ  #1 %line &SCRIPT_SELECTED
	READ  #1 %line &SCRIPT1
	READ  #1 %line &SCRIPT2
	CLOSE #1
	&SCRIPT_SELECTED_FOLDER=os.file.path("&SCRIPT_SELECTED")
	&SCRIPT_FOLDER1=os.file.path("&SCRIPT1")
	&SCRIPT_FOLDER2=os.file.path("&SCRIPT2")


IF "&CONNECT_TYPE"=="DAP2"
(
	SYSTEM.CONFIG.DEBUGPORTTYPE DAP2
	SYSTEM.CONFIG.DAP.DAPEN.ON
	SYSTEM.JC 20MHZ
	&CONNECT_TYPE_LAST="Option_Connect.1"
)
ELSE IF "&CONNECT_TYPE"=="JTAG"
(
	SYSTEM.CONFIG.DEBUGPORTTYPE JTAG
	&CONNECT_TYPE_LAST="Option_Connect.2"
)


//SYStem.Option PERSTOP OFF //prevent halting the GTM via TriCore (chip bug)

DIALOG
(
	HEADER "SMART Reprogram V10.0"
	
	POS 0. 0. 14. 5.
	BOX "CORE"
	POS 1. 1. 10. 1.
	CORE_CHEK.0: 	CHOOSEBOX "1 CORE" ""
	CORE_CHEK.1: 	CHOOSEBOX "2 CORE"
	(
		IF ("&CPU_CHECK"=="TC22"||"&CPU_CHECK"=="TC23")
		(
			DIALOG.SET CORE_CHEK.0
			PRINT "Current core is &CPU_TYPE, This option can not select."
		)
	)
	CORE_CHEK.2: 	CHOOSEBOX "3 CORE"
	(
		IF ("&CPU_CHECK"=="TC22"||"&CPU_CHECK"=="TC23"||"&CPU_CHECK"=="TC26")
		(
			DIALOG.SET CORE_CHEK.0
			PRINT "Current core is &CPU_TYPE, This option can not select."
		)
	)
	POS 14. 0. 16. 5.
	BOX "ETC"
	POS 15. 1. 14. 1.
	CORE_STATE: CHECKBOX "Core state" ""
	POS 15. 2. 14. 1.
	MULTI_CORE_WINDOW: CHECKBOX "Multicore window" ""
	POS 15. 3. 14. 1.
	SIMPLE_REPROGRAM: CHECKBOX "Simple reprogram" ""
	POS 0. 4. 30. 3.
	BOX "GTM"
	POS 1. 5. 10. 1.
	GTM_DEBUG: CHECKBOX "GTM Debug" ""
	POS 19. 5. 10. 1.
	BUTTON "[:edit]MCS "
	(
		DO ~\Button\GTM_mcs.cmm 
	)
	POS 0. 6. 30. 3.
	BOX "MCU type select"
	POS 1. 7. 28. 1.
	MCU_TYPE: PULLDOWN "TC21x,TC22x,TC23x,TC26x,TC27x,TC29x"
	(
		GOSUB CPU_TYPE_SUB
	)
	
	POS 0. 8. 30. 6.
	BOX "Previous and Favorite configuration"
	POS 1. 10. 28. 1.
	Dyna_Favorite: DYNTEXT ""
	POS 1. 11. 28. 1.
	Dyna_Favorite2: DYNTEXT ""
	POS 1. 12. 28. 1.
	Dyna_Favorite3: DYNTEXT ""
	
	POS 1. 9. 18. 1.
	LOAD_CONFIG: PULLDOWN "PREVIOUS_SET,SET_1,SET_2"
	(
		IF DIALOG.STRing(LOAD_CONFIG)=="PREVIOUS_SET"			
		(
			DIALOG.Set Dyna_Favorite	"CPU: &CPU_TYPE_PREVIOUS"
			DIALOG.Set Dyna_Favorite2	"CONNECT: &CONNECT_TYPE_PREVIOUS"
			DIALOG.Set Dyna_Favorite3	OS.FILE.NAME("&PATH_SELECTED_PREVIOUS")
		)
		IF DIALOG.STRing(LOAD_CONFIG)=="SET_1"			
		(
			GOSUB FAVORITE_DYNA_HANDLE_SUB "SET_1" "PULLDOWN"
		)
		IF DIALOG.STRing(LOAD_CONFIG)=="SET_2"
		(
			GOSUB FAVORITE_DYNA_HANDLE_SUB "SET_2" "PULLDOWN"
		)
	)
	
	POS 19. 9. 10. 1.
	BUTTON "[:edit]APPLY "
	(
		IF DIALOG.STRing(LOAD_CONFIG)=="PREVIOUS_SET"			
		(
			DIALOG.Set Dyna_Firstwindow "Do you want to use previous configuration?"
			&CPU_TYPE="&CPU_TYPE_PREVIOUS"
			&CONNECT_TYPE="&CONNECT_TYPE_PREVIOUS"
			&PATH_SELECTED="&PATH_SELECTED_PREVIOUS"
		)
		IF DIALOG.STRing(LOAD_CONFIG)=="SET_1"			
		(
			GOSUB FAVORITE_DYNA_HANDLE_SUB "SET_1" "APPLY"
			DIALOG.Set Dyna_Firstwindow "Do you want to use SET_1?"
		)
		IF DIALOG.STRing(LOAD_CONFIG)=="SET_2"
		(
			GOSUB FAVORITE_DYNA_HANDLE_SUB "SET_2" "APPLY"
			DIALOG.Set Dyna_Firstwindow "Do you want to use SET_2?"
		)
		&CPU_CHECK=STRING.MID("&CPU_TYPE",0.,4.)
	)
	POS 1. 14. 30. 0.
	Dyna_Firstwindow: DYNTEXT ""
  
	;buttons OK (Default) and Change
	POS 2. 15. 10.
	BUTTON "Yes"
	(
		SYSTEM.DOWN
		IF DIALOG.BOOLEAN(GTM_DEBUG)
		(
			&GTM_SELECT="GTM_YES"
		)
		ELSE
		(
			&GTM_SELECT="GTM_NO"
		)
		&CURRENT_PATH_USE=TRUE()
		IF DIALOG.BOOLEAN(SIMPLE_REPROGRAM)
		(	
			&MODE="SIMPLE"
		)
		ELSE
		(	
			&MODE="COMPLEX"
		)
		&CONNECT_MODIFY="&CONNECT_TYPE"
		GOSUB CORE_CHECK_SUB
		GOSUB ENVIRONMENT_SUB
		GOSUB REPROGRAM_SUB
		//GOSUB PREVIOUS_INFORMATION_SAVE_SUB
	)
	POSX 5.
	BUTTON    "Change"
	(
			IF DIALOG.BOOLEAN(GTM_DEBUG)
			(
				&GTM_SELECT="GTM_YES"
			)
			ELSE
			(
				&GTM_SELECT="GTM_NO"
			)
		GOSUB ENVIRONMENT_SUB
		GOSUB CORE_CHECK_SUB
		GOSUB CPU_MATCH_CHECK_SUB
		GOSUB CHANGE_BUTTON_SUB
	)

POS 5. 16. 20.
	TEXT "Developed by Steve.Han@IFX"
	
;define action when window is closed
	CLOSE "GOTO CLOSE_END_SUB"
)
	
;Default Configuration
&CPU_CHECK=STRING.MID("&CPU_TYPE",0.,4.)
PRINT "&CPU_CHECK"
IF !("&CPU_CHECK"=="TC22"||"&CPU_CHECK"=="TC23")
(
	IF "&CORE_SELECTED"=="SINGLE"
	(
		DIALOG.SET CORE_CHEK.0
	)
	ELSE IF "&CORE_SELECTED"=="DOUBLE"
	(
		DIALOG.SET CORE_CHEK.1
	)
	ELSE IF "&CORE_SELECTED"=="TRIPLE"
	(
		DIALOG.SET CORE_CHEK.2
	)
)
ELSE
(
	DIALOG.SET CORE_CHEK.0
)

IF "&MODE"=="SIMPLE"
(
	DIALOG.SET SIMPLE_REPROGRAM
)
IF "&GTM_SELECT"=="GTM_YES"
(
	DIALOG.SET GTM_DEBUG
)

DIALOG.SET LOAD_CONFIG "PREVIOUS_SET"
DIALOG.Set Dyna_Favorite	"CPU: &CPU_TYPE_PREVIOUS"
DIALOG.Set Dyna_Favorite2	"CONNECT: &CONNECT_TYPE_PREVIOUS"
DIALOG.Set Dyna_Favorite3	OS.FILE.NAME("&PATH_SELECTED_PREVIOUS")
DIALOG.Set Dyna_Firstwindow "Do you want to use previous configuration?"
DIALOG.SET MCU_TYPE STRING.MID("&CPU_TYPE",0.,4.)+"x"
GOSUB CPU_TYPE_SUB

STOP
ENDDO

//-----------------------		CPU_TYPE_SUB		-----------------------	
CPU_TYPE_SUB:
(
	&CPU_TYPE_TEMP=DIALOG.STRing(MCU_TYPE)
	&CPU_TYPE_TEMP_COMPARE=STRING.MID("&CPU_TYPE_TEMP",0.,4.)
	&CPU_TYPE_TEMP_SELECT=STRING.MID("&CPU_TYPE",0.,4.)+"*"
	&CPU_TYPE_TEMP_COMPARE_STAR=STRING.MID("&CPU_TYPE_TEMP",0.,4.)+"*"
	RETURN
)
//-----------------------		CPU_MATCH_CHECK_SUB		-----------------------	
CPU_MATCH_CHECK_SUB:
(
	LOCAL &CPU_SELECTION_RIGHT
	LOCAL &CPU_TYPE_MID_TEMP

	&CPU_SELECTION_RIGHT=FALSE()
	WHILE &CPU_SELECTION_RIGHT==FALSE()
	(

		&CPU_TYPE_MID_TEMP=STRING.MID(CPU(),0.,4.)
		IF "&CPU_TYPE_TEMP_COMPARE"!="&CPU_TYPE_MID_TEMP"
		(
			SYS.CPU &CPU_TYPE_TEMP_COMPARE_STAR
		)
		ELSE IF "&CPU_TYPE_TEMP_COMPARE"=="&CPU_TYPE_MID_TEMP"
		(
			&CPU_SELECTION_RIGHT=TRUE()
		)
		ELSE
		(
			&CPU_SELECTION_RIGHT=FALSE()
		)		

	)
		
	RETURN
)

CPU_MATCH_CHECK_IN_CHANGE_SUB:
(
	LOCAL &CPU_SELECTION_RIGHT
	LOCAL &CPU_TYPE_MID_TEMP
	&CPU_SELECTION_RIGHT=FALSE()
	WHILE &CPU_SELECTION_RIGHT==FALSE()
	(
		SYS.CPU &CPU_TYPE_TEMP_COMPARE_STAR
		&CPU_TYPE_MID_TEMP=STRING.MID(CPU(),0.,4.)
		IF "&CPU_TYPE_TEMP_COMPARE"=="&CPU_TYPE_MID_TEMP"
		(
			&CPU_SELECTION_RIGHT=TRUE()
		)
		ELSE
		(
			&CPU_SELECTION_RIGHT=FALSE()
		)		

	)
		
	RETURN
)

//-----------------------		CORE_CHECK_SUB		-----------------------	
CORE_CHECK_SUB:
(
	IF DIALOG.BOOLEAN(CORE_CHEK.0)
	(
		&SINGLE_CORE_T=TRUE()
		&CORE_SELECTED="SINGLE"
	)
	ELSE IF DIALOG.BOOLEAN(CORE_CHEK.1)
	(	
		&DOUBLE_CORE_T=TRUE()
		&CORE_SELECTED="DOUBLE"
		IF DIALOG.BOOLEAN(MULTI_CORE_WINDOW)
		(	
			&MULTI_CORE_WINDOW_T=TRUE()
		)
	)
	ELSE IF DIALOG.BOOLEAN(CORE_CHEK.2)
	(
		&TRIPLE_CORE_T=TRUE()
		&CORE_SELECTED="TRIPLE"
		IF DIALOG.BOOLEAN(MULTI_CORE_WINDOW)
		(	
			&MULTI_CORE_WINDOW_T=TRUE()
		)
	)
	
	IF DIALOG.BOOLEAN(CORE_STATE)
	(
		&CORE_STATE_T=TRUE()
	)
	RETURN
)
//-----------------------		ENVIRONMENT_SUB		-----------------------	
ENVIRONMENT_SUB:
(
	OPEN #1 ~~\Button\Env\ETC_PATH.txt /CREATE
	WRITE #1 "&CORE_SELECTED"
	WRITE #1 "&MODE"
	WRITE #1 "&MCS_CORE"
	WRITE #1 "&MCS_CORE_CONFIG"
	WRITE #1 "&MCS_CHANNEL_NUMBER"
	WRITE #1 "&GTM_SELECT"
	CLOSE #1	
	RETURN
)

//-----------------------		CHANGE_BUTTON_SUB		-----------------------	
CHANGE_BUTTON_SUB:
(
	DIALOG.END
	&CURRENT_PATH_USE=FALSE()
	DIALOG
	(
//-----------------------		PATH_SELECT		-----------------------	
		POS 1. 0. 11.
		LINE "PATH_SELECT"
		HEADER "SMART Reprogram V10.0-HanSungsu"
		POS 1. 1. 6.
		PATH_CHECK.1: CHOOSEBOX "PATH_1"
		(
			&PATH_SELECTED_NUM_CHECK="PATH_CHECK.1"
			&PATH_SELECTED_NUM_ELF="PATH_1"
			PRINT "&PATH_SELECTED_NUM_CHECK selected"
		)
		PATH_CHECK.2: CHOOSEBOX "PATH_2"
		(
			&PATH_SELECTED_NUM_CHECK="PATH_CHECK.2"
			&PATH_SELECTED_NUM_ELF="PATH_2"
			PRINT "&PATH_SELECTED_NUM_CHECK selected"
		)
		PATH_CHECK.3: CHOOSEBOX "PATH_3"
		(
			&PATH_SELECTED_NUM_CHECK="PATH_CHECK.3"
			&PATH_SELECTED_NUM_ELF="PATH_3"
			PRINT "&PATH_SELECTED_NUM_CHECK selected"
		)
		PATH_CHECK.4: CHOOSEBOX "PATH_4"
		(
			&PATH_SELECTED_NUM_CHECK="PATH_CHECK.4"
			&PATH_SELECTED_NUM_ELF="PATH_4"
			PRINT "&PATH_SELECTED_NUM_CHECK selected"
		)
	
		POS 8. 1. 35.
		PATH_1:   EDIT "*.elf"
		(;get the user input when the cursor leaves the EDIT control
			&PATH1=DIALOG.STRing(PATH_1)
		)
		POS 8. 2. 35.
		PATH_2:   EDIT "*.elf"
		(;get the user input when the cursor leaves the EDIT control
			&PATH2=DIALOG.STRing(PATH_2)
		)
		POS 8. 3. 35.
		PATH_3:   EDIT "*.elf"
		(;get the user input when the cursor leaves the EDIT control
			&PATH3=DIALOG.STRing(PATH_3)
		)
		POS 8. 4. 35.
		PATH_4:   EDIT "*.elf"
		(;get the user input when the cursor leaves the EDIT control
			&PATH4=DIALOG.STRing(PATH_4)
		)
		
		POS 1. 5. 6. 
			TEXT "FAVORITE"		
		POS 8. 5. 35.
		PATH_5:   EDIT "*.elf"
		(
		)
		
		POS 45. 1. 11.
		BUTTON "[:edit]PATH1_CHANGE "
		(
			
			DIALOG.SetFile PATH_1  &PATH_FOLDER1\*.elf
			DIALOG.SET PATH_CHECK.1
		)
		POS 45. 2. 11.
		BUTTON "[:edit]PATH2_CHANGE "
		(
			
			DIALOG.SetFile PATH_2 &PATH_FOLDER2\*.elf
			DIALOG.SET PATH_CHECK.2
		)
		POS 45. 3. 11.
		BUTTON "[:edit]PATH3_CHANGE "
		(
			
			DIALOG.SetFile PATH_3  &PATH_FOLDER3\*.elf
			DIALOG.SET PATH_CHECK.3
		)
		POS 45. 4. 11.
		BUTTON "[:edit]PATH4_CHANGE "
		(
			
			DIALOG.SetFile PATH_4  &PATH_FOLDER4\*.elf
			DIALOG.SET PATH_CHECK.4
		)
		POS 45. 5. 11.
		BUTTON "[:edit]COPY_PATH "
		(						
			IF &FAVORITE_USE==TRUE()
			(
				GOSUB FAVORITE_PATH_COPY_SUB
			)
			ELSE
			(
				DIALOG.MESSAGE "There is no Favorite information"
			)
			
		)
//-----------------------		SCRIPT_SELECT		-----------------------
		POS 1. 6. 15.
		LINE "WINDOW_SCRIPT_SELECT"
		POS 1. 7. 6.
		SCRIPT_CHECK.0: CHOOSEBOX "CURRENT" ""
		SCRIPT_CHECK.1: CHOOSEBOX "SCRIPT_1" ""
		SCRIPT_CHECK.2: CHOOSEBOX "SCRIPT_2" ""
		
		POS 8. 8. 35.
		SCRIPT_1:   EDIT "*.elf"
		(;get the user input when the cursor leaves the EDIT control
			&SCRIPT_CHANGE1=DIALOG.STRing(SCRIPT_1)
		)
		POS 8. 9. 35.
		SCRIPT_2:   EDIT "*.elf"
		(;get the user input when the cursor leaves the EDIT control
			&SCRIPT_CHANGE2=DIALOG.STRing(SCRIPT_2)
		)
		
		POS 45. 8. 11.
		BUTTON "[:edit]SCRIPT1_CHANGE "
		(
			
			DIALOG.SetFile SCRIPT_1  &SCRIPT_FOLDER1\*.cmm
			DIALOG.SET SCRIPT_CHECK.1
		)
		POS 45. 9. 11.
		BUTTON "[:edit]SCRIPT2_CHANGE "
		(
			
			DIALOG.SetFile SCRIPT_2  &SCRIPT_FOLDER2\*.cmm
			DIALOG.SET SCRIPT_CHECK.2
		)	
//-----------------------		CONNECTOR_SELECT		-----------------------
		;choosebox group for Connector 
		POS 1. 10. 15.
		LINE "CONNECTOR_SELECT"
		POS 1. 11. 10.
		Option_Connect.1: CHOOSEBOX "DAP2" ""
		Option_Connect.2: CHOOSEBOX "JTAG" ""
//-----------------------		FAVORITE_SAVE		-----------------------		
		POS 45. 14. 11.
		BUTTON "[:edit]SAVE "
		(
			IF DIALOG.STRing(SAVED_CONFIG)=="SET_1"			
			(
				GOSUB FAVORITE_SAVE_LOAD_SUB "SET_1" "SAVE" "APPLY"
				GOSUB FAVORITE_DYNA_HANDLE_SUB "SET_1" "CHANGE"
			)
			IF DIALOG.STRing(SAVED_CONFIG)=="SET_2"
			(
				GOSUB FAVORITE_SAVE_LOAD_SUB "SET_2" "SAVE" "APPLY"
				GOSUB FAVORITE_DYNA_HANDLE_SUB "SET_2" "CHANGE"
			)
		)
		POS 8. 13. 35. 6.
		BOX "FAVORITE_SAVE"
		POS 9. 15. 33. 1.
		Dyna_Favorite: DYNTEXT ""
		POS 9. 16. 33. 1.
		Dyna_Favorite2: DYNTEXT ""
		POS 9. 17. 33. 1.
		Dyna_Favorite3: DYNTEXT ""
		
		POS 9. 14. 33. 1.
		SAVED_CONFIG: PULLDOWN "SET_1,SET_2"
		(
			IF DIALOG.STRing(SAVED_CONFIG)=="SET_1"			
			(
				GOSUB FAVORITE_DYNA_HANDLE_SUB "SET_1" "CHANGE"
			)
			IF DIALOG.STRing(SAVED_CONFIG)=="SET_2"
			(
				GOSUB FAVORITE_DYNA_HANDLE_SUB "SET_2" "CHANGE"
			)
		)
		
//-----------------------		CPU_SELECT		-----------------------
		POS 45. 10. 11.
		BUTTON "[:edit]CPU_CHANGE "
		(
			GOSUB CPU_MATCH_CHECK_IN_CHANGE_SUB
			&CPU_TYPE_MODIFY=CPU()
		)		
//-----------------------		OK_SELECT		-----------------------		
		POS 45. 12. 11.
		DEFBUTTON "OK" 
		(		
			SYSTEM.DOWN
			//**********************		PATH_CREATION		**********************
			IF DIALOG.BOOLEAN(PATH_CHECK.1)==TRUE()
			(
				IF STRING.FIND("elf","&PATH1")==TRUE()
				(
					&PATH_SELECTED="&PATH1"
					GOSUB PATH_FILE_SAVE_SUB
					GOSUB PREVIOUS_INFORMATION_SAVE_SUB
				)
			)
			ELSE IF DIALOG.BOOLEAN(PATH_CHECK.2)==TRUE()
			(
				IF STRING.FIND("elf","&PATH2")==TRUE()
				(
					&PATH_SELECTED="&PATH2"
					GOSUB PATH_FILE_SAVE_SUB
					GOSUB PREVIOUS_INFORMATION_SAVE_SUB
				)
			)
			ELSE IF DIALOG.BOOLEAN(PATH_CHECK.3)==TRUE()
			(
				IF STRING.FIND("elf","&PATH3")==TRUE()
				(
					&PATH_SELECTED="&PATH3"
					GOSUB PATH_FILE_SAVE_SUB
					GOSUB PREVIOUS_INFORMATION_SAVE_SUB
				)
			)
			ELSE IF DIALOG.BOOLEAN(PATH_CHECK.4)==TRUE()
			(
				IF STRING.FIND("elf","&PATH4")==TRUE()
				(
					&PATH_SELECTED="&PATH4"
					GOSUB PATH_FILE_SAVE_SUB
					GOSUB PREVIOUS_INFORMATION_SAVE_SUB
				)
			)
			ELSE
			(
			
			)
			
			IF (STRING.FIND("cmm","&SCRIPT_CHANGE1")||STRING.FIND("cmm","&SCRIPT_CHANGE2"))
			(
				IF DIALOG.BOOLEAN(SCRIPT_CHECK.1)
				(
					&SCRIPT_SELECTED="&SCRIPT_CHANGE1"
					OPEN #1 ~~\Button\Env\SCRIPT_PATH_2.txt /CREATE
					WRITE #1 "&SCRIPT_SELECTED"
					WRITE #1 "&SCRIPT_CHANGE1"
					WRITE #1 "&SCRIPT2"
					CLOSE #1
				)
				ELSE IF DIALOG.BOOLEAN(SCRIPT_CHECK.2)
				(
					&SCRIPT_SELECTED="&SCRIPT_CHANGE2"
					OPEN #1 ~~\Button\Env\SCRIPT_PATH_2.txt /CREATE
					WRITE #1 "&SCRIPT_SELECTED"
					WRITE #1 "&SCRIPT1"
					WRITE #1 "&SCRIPT_CHANGE2"
					CLOSE #1
				)
			)
			GOSUB REPROGRAM_SUB
		)
//-----------------------		CLOSE_SELECT		-----------------------		
	  ;define action when window is closed
		CLOSE "GOTO CLOSE_END_SUB"
	)
//-----------------------		DEFAULT_ACTION		-----------------------			
	GOSUB PATH_HANDLE_SUB 
	GOSUB FAVORITE_DYNA_HANDLE_SUB "SET_1" "CHANGE"
	DIALOG.SET SCRIPT_1  "&SCRIPT1"
	DIALOG.SET SCRIPT_2  "&SCRIPT2"	
	DIALOG.SET SCRIPT_CHECK.0
	DIALOG.SET &CONNECT_TYPE_LAST
	STOP
)
ENDDO	
	
REPROGRAM_SUB:
(	
	IF "&GTM_SELECT"=="GTM_YES"
	(	
	//SYStem.Option PERSTOP OFF
		ON CMD COREGTM GOSUB coreGTM
		GOSUB setup_intercom
		COREGTM SYSTEM.DOWN
	)
	IF "&CONNECT_MODIFY"=="DAP2"
	(
		SYSTEM.CONFIG.DEBUGPORTTYPE DAP2
		SYSTEM.CONFIG.DAP.DAPEN.ON
		SYSTEM.JC 10MHZ
	)
	ELSE IF "&CONNECT_MODIFY"=="JTAG"
	(
		SYSTEM.CONFIG.DEBUGPORTTYPE JTAG
	)
	&CPU_TYPE=CPU()
	&CPU_TYPE_MID=STRING.MID("&CPU_TYPE",0.,4.)
	IF "&CPU_TYPE_MID"=="TC27"
	(
		DO C:\T32\Button\flash\tc27x_Auto.cmm "&PATH_SELECTED"
	)
	ELSE IF "&CPU_TYPE_MID"=="TC21"
	(
		DO C:\T32\Button\flash\tc21x_Auto.cmm "&PATH_SELECTED"
	)
	ELSE IF "&CPU_TYPE_MID"=="TC23"
	(
		DO C:\T32\Button\flash\tc23x_Auto.cmm "&PATH_SELECTED"
	)
	ELSE IF "&CPU_TYPE_MID"=="TC22"
	(
		DO C:\T32\Button\flash\tc22x_Auto.cmm "&PATH_SELECTED"
	)
	ELSE IF "&CPU_TYPE_MID"=="TC26"
	(
		DO C:\T32\Button\flash\tc26x_Auto.cmm "&PATH_SELECTED"
	)
	ELSE IF "&CPU_TYPE_MID"=="TC29"
	(
		DO C:\T32\Button\flash\tc29x_Auto.cmm "&PATH_SELECTED"
	)
	PRINT "&PATH_SELECTED flash complete./&CPU_TYPE"

	IF &CURRENT_PATH_USE==TRUE()
	(
		GOSUB END_PROCESS2_SUB
	)
	ELSE
	(
		GOSUB END_PROCESS1_SUB
	)
)
ENDDO


//-----------------------		END_PROCESS1_SUB		---------------------------	
END_PROCESS1_SUB:
IF DIALOG.BOOLEAN(SCRIPT_CHECK.0)==FALSE()
(
	WINCLEAR
	DO &SCRIPT_SELECTED win
)
SYSTEM.DOWN
SYSTEM.O.DUALPORT.ON
SYSTEM.CA.E
SYSTEM.O.IMASKASM.OFF
SYSTEM.O.IMASKHLL.OFF
SETUP.VAR %SPOTLIGHT
//SYStem.Option PERSTOP OFF
GOSUB END_PROCESS2_SUB
ENDDO

//-----------------------		END_PROCESS2_SUB		---------------------------
END_PROCESS2_SUB:
(
	DIALOG.END
	SYSTEM.DOWN
	IF "&CONNECT_MODIFY"=="DAP2"
	(
		SYSTEM.CONFIG.DEBUGPORTTYPE DAP2
		SYSTEM.CONFIG.DAP.DAPEN.ON
		SYSTEM.JC 20MHZ
	)
	ELSE IF "&CONNECT_MODIFY"=="JTAG"
	(
		SYSTEM.CONFIG.DEBUGPORTTYPE JTAG
	)
	IF ("&CPU_TYPE_MID"!="TC21"&&"&CPU_TYPE_MID"!="TC22"&&"&CPU_TYPE_MID"!="TC23"&&"&CPU_TYPE_MID"!="TC26")
	(
		IF &SINGLE_CORE_T==TRUE()
		(
			Core.assign  1.
		)
		ELSE IF &DOUBLE_CORE_T==TRUE()
		(
			
			Core.assign  1. 2.
			IF &MULTI_CORE_WINDOW_T==TRUE()
			(
				d.l /core 0
				d.l /core 1
			)
			
		)
		ELSE
		(
			Core.assign  1. 2. 3.
			IF &MULTI_CORE_WINDOW_T==TRUE()
			(
				d.l /core 0
				d.l /core 1
				d.l /core 2
			)
		)
	)
	ELSE IF ("&CPU_TYPE_MID"=="TC26")
	(
		IF &SINGLE_CORE_T==TRUE()
		(
			Core.assign  1.
		)
		ELSE IF &DOUBLE_CORE_T==TRUE()
		(
			
			Core.assign  1. 2.
			IF &MULTI_CORE_WINDOW_T==TRUE()
			(
				d.l /core 0
				d.l /core 1
			)
		)
	)

	IF "&MODE"=="COMPLEX"
	(
		SYSTEM.O.DUALPORT.ON
		SYSTEM.CA.E
		SYSTEM.O.IMASKASM.OFF
		SYSTEM.O.IMASKHLL.OFF
		SETUP.VAR %SPOTLIGHT
		//SYStem.Option PERSTOP OFF
	)

	IF &CORE_STATE_T==TRUE()
	(
		IF WINDOW.NAME("B::TargetSystem.state DEFault")==FALSE()
		(
			TargetSystem.state DEFault
		)
		CORE.SHOWACTIVE
	)
	IF "&GTM_SELECT"=="GTM_YES"
	(
		DO C:\T32\Button\GTM.cmm &MCS_CORE &MCS_CORE_CONFIG &MCS_CHANNEL_NUMBER &CPU_TYPE &CONNECT_MODIFY
	)
	ELSE
	(
		SYSTEM.UP
	)
	IF (&FAVORITE_USE==TRUE())&&(&CURRENT_PATH_USE==TRUE())
	(
		OPEN #1 ~~\Button\Env\PREVIOUS_TYPE.txt /CREATE
		WRITE #1 "&CPU_TYPE_FAVORITE"
		WRITE #1 "&CONNECT_TYPE_FAVORITE"
		WRITE #1 "&PATH_SELECTED"
		CLOSE #1
		
		OPEN #1 ~~\Button\Env\Elf_path\ELF_PATH.txt /CREATE
		WRITE #1 "&PATH_SELECTED"	
		CLOSE #1
	)
)
ENDDO
//-----------------------		END OF END_PROCESS2_SUB		---------------------------

//-----------------------		CLOSE_END_SUB		-----------------------------------
CLOSE_END_SUB:
DIALOG.END
ENDDO
//-----------------------		END OF CLOSE_END_SUB		---------------------------

//-----------------------		COMMUNICATION_SUB		-------------------------------
setup_intercom:
(
  &portTC0=FORMAT.DECIMAL(1.,INTERCOM.PORT())
  &portGTM=FORMAT.DECIMAL(1.,INTERCOM.PORT()+1.)
  &addressTC0="127.0.0.1:&portTC0"
  &addressGTM="127.0.0.1:&portGTM"
  RETURN
)
coreGTM:
(
  LOCAL &params
  ENTRY %Line &params
  INTERCOM.execute &addressGTM &params ; execute on remote GUI
  RETURN
)
coreTC0:
(
  LOCAL &params
  ENTRY %Line &params
  &params ; execute on this GUI
  RETURN
)
//-----------------------		END OF COMMUNICATION_SUB		-----------------------

//-----------------------		FAVORITE_SAVE_LOAD_SUB		---------------------------
FAVORITE_SAVE_LOAD_SUB:
(
	LOCAL &SETTING_VALUE &SAVE_LOAD_FAVORITE &APPLY_CHECK_FAV
	ENTRY &SETTING_VALUE &SAVE_LOAD_FAVORITE &APPLY_CHECK_FAV
	
	IF &SAVE_LOAD_FAVORITE=="SAVE"
	(
		&CPU_TYPE_FAVORITE=CPU()
		IF DIALOG.BOOLEAN(PATH_CHECK.1)
		(
			&PATH_SELECTED_NUM_FAVORITE="PATH_CHECK.1"
			&PATH_SELECTED_FAVORITE="&PATH1"
		)
		ELSE IF DIALOG.BOOLEAN(PATH_CHECK.2)
		(
			&PATH_SELECTED_NUM_FAVORITE="PATH_CHECK.2"
			&PATH_SELECTED_FAVORITE="&PATH2"
		)
		ELSE IF DIALOG.BOOLEAN(PATH_CHECK.3)
		(
			&PATH_SELECTED_NUM_FAVORITE="PATH_CHECK.3"
			&PATH_SELECTED_FAVORITE="&PATH3"
		)
		ELSE IF DIALOG.BOOLEAN(PATH_CHECK.4)
		(
			&PATH_SELECTED_NUM_FAVORITE="PATH_CHECK.4"
			&PATH_SELECTED_FAVORITE="&PATH4"
		)

		IF DIALOG.BOOLEAN(Option_Connect.1)
		(
			&CONNECT_TYPE_FAVORITE="DAP2"
		)
		ELSE IF DIALOG.BOOLEAN(Option_Connect.2)
		(
			&CONNECT_TYPE_FAVORITE="JTAG"
		)			
		DO C:\T32\Button\Favorit.cmm &SETTING_VALUE &SAVE_LOAD_FAVORITE &APPLY_CHECK_FAV &CPU_TYPE_FAVORITE &CONNECT_TYPE_FAVORITE &PATH_SELECTED_FAVORITE &PATH_SELECTED_NUM_FAVORITE
		RETURN
	)
	
	IF &SAVE_LOAD_FAVORITE=="LOAD"
	(
		DO C:\T32\Button\Favorit.cmm &SETTING_VALUE &SAVE_LOAD_FAVORITE &APPLY_CHECK_FAV
		
		
		
		IF &APPLY_CHECK_FAV=="APPLY"
		(
			ENTRY &FAVORITE_USE &FAVORITE_VERI_CHECK_PULLDOWN &CPU_TYPE_FAVORITE &CONNECT_TYPE_FAVORITE &PATH_SELECTED_FAVORITE &PATH_SELECTED_NUM_FAVORITE
			IF &FAVORITE_USE==TRUE()
			(	
				&CPU_TYPE="&CPU_TYPE_FAVORITE"
				SYSTEM.CPU &CPU_TYPE
				&CONNECT_TYPE="&CONNECT_TYPE_FAVORITE"
				&PATH_SELECTED="&PATH_SELECTED_FAVORITE"
				PRINT "&CPU_TYPE &CONNECT_TYPE &PATH_SELECTED"
				RETURN &CPU_TYPE_FAVORITE &CONNECT_TYPE_FAVORITE &PATH_SELECTED_FAVORITE
			)
			ELSE
			(
				PRINT "PROBLEM"
				RETURN
			)
			
		)
		ELSE IF &APPLY_CHECK_FAV=="PULLDOWN"
		(
			ENTRY &FAVORITE_USE &FAVORITE_VERI_CHECK_PULLDOWN &CPU_TYPE_FAVORITE &CONNECT_TYPE_FAVORITE &PATH_SELECTED_FAVORITE &PATH_SELECTED_NUM_FAVORITE
			IF &FAVORITE_VERI_CHECK_PULLDOWN==TRUE()
			(	
				RETURN &CPU_TYPE_FAVORITE &CONNECT_TYPE_FAVORITE &PATH_SELECTED_FAVORITE
			)
			ELSE
			(
				PRINT "There is no information"
				RETURN &CPU_TYPE_FAVORITE &CONNECT_TYPE_FAVORITE &PATH_SELECTED_FAVORITE
			)
		)
		ELSE IF &APPLY_CHECK_FAV=="CHANGE"
		(
		ENTRY &FAVORITE_VERI_CHECK_PULLDOWN &CPU_TYPE_FAVORITE &CONNECT_TYPE_FAVORITE &PATH_SELECTED_FAVORITE &PATH_SELECTED_NUM_FAVORITE
			IF &FAVORITE_VERI_CHECK_PULLDOWN==TRUE()
			(	
				RETURN &CPU_TYPE_FAVORITE &CONNECT_TYPE_FAVORITE &PATH_SELECTED_FAVORITE
			)
			ELSE
			(
				PRINT "There is no information"
				RETURN &CPU_TYPE_FAVORITE &CONNECT_TYPE_FAVORITE &PATH_SELECTED_FAVORITE
			)
		)
	)
)
//-----------------------	END OF FAVORITE_SAVE_LOAD_SUB		-------------------

//-----------------------	FAVORITE_DYNA_HANDLE_SUB		---------------------------
FAVORITE_DYNA_HANDLE_SUB:
(
	LOCAL &SETTING_VALUE &PULL_APPLY
	ENTRY &SETTING_VALUE &PULL_APPLY
	GOSUB FAVORITE_SAVE_LOAD_SUB &SETTING_VALUE "LOAD" &PULL_APPLY
	
	ENTRY &CPU_TYPE_FAVORITE_TEMP &CONNECT_TYPE_FAVORITE_TEMP &PATH_SELECTED_FAVORITE_TEMP
	DIALOG.Set Dyna_Favorite	"CPU: &CPU_TYPE_FAVORITE_TEMP"
	DIALOG.Set Dyna_Favorite2	"CONNECT: &CONNECT_TYPE_FAVORITE_TEMP"
	DIALOG.Set Dyna_Favorite3	OS.FILE.NAME("&PATH_SELECTED_FAVORITE_TEMP")
	
	RETURN
)
//-----------------------	END OF FAVORITE_DYNA_HANDLE_SUB		-------------------

//-----------------------	FAVORITE_DYNA_HANDLE_SUB		------------------------
PATH_HANDLE_SUB:
(
	IF "&CPU_TYPE_TEMP"=="TC21x"
	(
		PRINT "hello21x"
		&ELF_PATH_CORE="ELF_PATH_TC21x"
	)
	ELSE IF "&CPU_TYPE_TEMP"=="TC22x"
	(
		PRINT "hello22x"
		&ELF_PATH_CORE="ELF_PATH_TC22x"
	)
	ELSE IF "&CPU_TYPE_TEMP"=="TC23x"
	(
		PRINT "hello23x"
		&ELF_PATH_CORE="ELF_PATH_TC23x"
	)
	ELSE IF "&CPU_TYPE_TEMP"=="TC26x"
	(
		PRINT "hello26x"
		&ELF_PATH_CORE="ELF_PATH_TC26x"
	)
	ELSE IF "&CPU_TYPE_TEMP"=="TC27x"
	(
		PRINT "hello27x"
		&ELF_PATH_CORE="ELF_PATH_TC27x"
	)
	ELSE IF "&CPU_TYPE_TEMP"=="TC29x"
	(
		PRINT "hello29x"
		&ELF_PATH_CORE="ELF_PATH_TC29x"
	)
		
	IF (!os.file(~~\Button\Env\Elf_path\&ELF_PATH_CORE.txt))
	(
		OPEN  #1 ~~\Button\Env\Elf_path\&ELF_PATH_CORE.txt /CREATE
		WRITE #1 "C:"
		WRITE #1 "C:"
		WRITE #1 "C:"
		WRITE #1 "C:"
		WRITE #1 "PATH_CHECK.1"
		WRITE #1 "PATH_1"
		CLOSE #1
	)
	OPEN  #1 ~~\Button\Env\Elf_path\&ELF_PATH_CORE.txt
	READ  #1 %line &PATH1
	READ  #1 %line &PATH2
	READ  #1 %line &PATH3
	READ  #1 %line &PATH4
	READ  #1 %line &PATH_SELECTED_NUM_CHECK
	READ  #1 %line &PATH_SELECTED_NUM_ELF
	CLOSE #1
	
	&PATH_SELECTED_FOLDER=os.file.path("&PATH_SELECTED")
	&PATH_FOLDER1=os.file.path("&PATH1")
	&PATH_FOLDER2=os.file.path("&PATH2")
	&PATH_FOLDER3=os.file.path("&PATH3")
	&PATH_FOLDER4=os.file.path("&PATH4")
	
	LOCAL &TEMP
	&TEMP=OS.FILE.NAME("&PATH1")
	PRINT OS.FILE.NAME("&PATH1")
	DIALOG.Set PATH_1 OS.FILE.NAME("&PATH1")
	DIALOG.Set PATH_2 OS.FILE.NAME("&PATH2")
	DIALOG.Set PATH_3 OS.FILE.NAME("&PATH3")
	DIALOG.Set PATH_4 OS.FILE.NAME("&PATH4")
	
	IF &FAVORITE_USE==TRUE()
	(
		DIALOG.SetFile PATH_5  "&PATH_SELECTED_FAVORITE"
	)
	ELSE
	(
		DIALOG.Set PATH_5  "NO_SELECTED"
	)	
	DIALOG.SET &PATH_SELECTED_NUM_CHECK
	
	RETURN
)
//-----------------------	END OF FAVORITE_DYNA_HANDLE_SUB		--------------------

//-----------------------	PATH_FILE_SAVE_SUB		------------------------
PATH_FILE_SAVE_SUB:
(
	OPEN #1 ~~\Button\Env\Elf_path\&ELF_PATH_CORE.txt /CREATE
	WRITE #1 "&PATH1"
	WRITE #1 "&PATH2"
	WRITE #1 "&PATH3"
	WRITE #1 "&PATH4"
	WRITE #1 "&PATH_SELECTED_NUM_CHECK"
	WRITE #1 "&PATH_SELECTED_NUM_ELF"
	CLOSE #1

	RETURN
	
)
//-----------------------	END OF PATH_FILE_SAVE_SUB		--------------------

//-----------------------	PREVIOUS_INFORMATION_SAVE_SUB		------------------------
PREVIOUS_INFORMATION_SAVE_SUB:
(
			IF DIALOG.BOOLEAN(Option_Connect.1)
			(
				&CONNECT_MODIFY="DAP2"
			)
			ELSE IF DIALOG.BOOLEAN(Option_Connect.2)
			(
				&CONNECT_MODIFY="JTAG"
			)
			OPEN #1 ~~\Button\Env\PREVIOUS_TYPE.txt /CREATE
			WRITE #1 CPU()
			WRITE #1 "&CONNECT_MODIFY"
			WRITE #1 "&PATH_SELECTED"
			CLOSE #1
			

	RETURN
	
)
//-----------------------	END OF PREVIOUS_INFORMATION_SAVE_SUB		--------------------

//-----------------------	FAVORITE_PATH_COPY_SUB		---------------------------
FAVORITE_PATH_COPY_SUB:
(
	IF "&PATH_SELECTED_NUM_CHECK"=="PATH_CHECK.1"
	(
		DIALOG.SetFile &PATH_SELECTED_NUM_ELF "&PATH_SELECTED_FAVORITE"
		&PATH1=DIALOG.STRing("&PATH_SELECTED_NUM_ELF")
		PRINT "&PATH1"
	)
	ELSE IF "&PATH_SELECTED_NUM_CHECK"=="PATH_CHECK.2"
	(
		DIALOG.SetFile &PATH_SELECTED_NUM_ELF "&PATH_SELECTED_FAVORITE"
		&PATH2=DIALOG.STRing("&PATH_SELECTED_NUM_ELF")
		PRINT "&PATH2"
	)
	ELSE IF "&PATH_SELECTED_NUM_CHECK"=="PATH_CHECK.3"
	(
		DIALOG.SetFile &PATH_SELECTED_NUM_ELF "&PATH_SELECTED_FAVORITE"
		&PATH3=DIALOG.STRing("&PATH_SELECTED_NUM_ELF")
		PRINT "&PATH3"
	)
	ELSE IF "&PATH_SELECTED_NUM_CHECK"=="PATH_CHECK.4"
	(
		DIALOG.SetFile &PATH_SELECTED_NUM_ELF "&PATH_SELECTED_FAVORITE"
		&PATH4=DIALOG.STRing("&PATH_SELECTED_NUM_ELF")
		PRINT "&PATH4"
	)
	RETURN
)
//-----------------------	END OF FAVORITE_PATH_COPY_SUB		--------------------