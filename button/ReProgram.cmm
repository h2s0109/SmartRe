B::
SYSTEM.DOWN
LOCAL &portTC0 &portGTM &addressTC0 &addressGTM
GOSUB setup_intercom
ON CMD CORETC0 GOSUB coreTC0
ON CMD COREGTM GOSUB coreGTM

LOCAL &CURRENT_PATH_USE

LOCAL &ELF_PATH_CORE

;Favorite
LOCAL &FAVORITE_USE
&FAVORITE_USE=FALSE()
LOCAL &FAVORITE_VERI_CHECK_PULLDOWN
&FAVORITE_VERI_CHECK_PULLDOWN=FALSE()

;Previous
LOCAL &CONNECT_TYPE_PREVIOUS
LOCAL &CPU_TYPE_PREVIOUS
LOCAL &PATH_SELECTED_PREVIOUS
LOCAL &PATH_BOOT_SELECTED_PREVIOUS
LOCAL &CONNECT_TYPE
LOCAL &CONNECT_TYPE_LAST
LOCAL &CONNECT_MODIFY
LOCAL &PATH_SELECTED &PATH_BOOT_SELECTED
LOCAL &CPU_TYPE
LOCAL &CPU_TYPE_MID
LOCAL &CPU_TYPE_TEMP


LOCAL &CPU_TYPE_MODIFY
LOCAL &APPLY_CPU_TYPE &APPLY_CONNECT_TYPE &APPLY_PATH_SELECTED

//-----------------------		FILE_CHECK&CREATION		-----------------------
//SYStem.Option PERSTOP OFF //prevent halting the GTM via TriCore (chip bug)
LOCAL &CORE_SELECTED_T &MULTI_CORE_WINDOW_T &CORE_STATE_T &RAMFLASH_T &MCS_CORE \
&MCS_CHANNEL_NUMBER &MCS_CORE_CONFIG &GTM_SELECT_T &PC_T &PCADDRESS_T &USEBOOT_T \
&MODE_T &DefaultFolderName &Boot_PC_ADD_T &GTM_OCDS_SELECT_T


Do ~~\Button\Init.cmm
ENTRY &CORE_SELECTED_T &MULTI_CORE_WINDOW_T &CORE_STATE_T &RAMFLASH_T &MCS_CORE \
&MCS_CHANNEL_NUMBER &MCS_CORE_CONFIG &GTM_SELECT_T &PC_T &PCADDRESS_T &USEBOOT_T \
&MODE_T &DefaultFolderName &Boot_PC_ADD_T &GTM_OCDS_SELECT_T

IF &USEBOOT_T==FALSE()
(
	//Previous AND SYSTEM
	IF (!os.file(~~\Button\Env\PREVIOUS_TYPE.txt))
	(
		DIALOG.MESSAGE "Click the CHANGE button,please."\
		"If you have a question, send a email to me."\
		"       	       Steve.han@infineon.com"
		SYSTEM.CPU TC*
		&CPU_TYPE_PREVIOUS=CPU()
		&CONNECT_TYPE_PREVIOUS="JTAG"
		&PATH_SELECTED_PREVIOUS="C:\"
		&PATH_BOOT_SELECTED_PREVIOUS="C:\"
		OPEN  #1 ~~\Button\Env\PREVIOUS_TYPE.txt /CREATE
		WRITE #1 "TC277TF"
		WRITE #1 "JTAG"
		WRITE #1 "C:\"
		CLOSE #1
	)
	ELSE
	(
		OPEN #1 ~~\Button\Env\PREVIOUS_TYPE.txt /READ
		READ  #1 %line &CPU_TYPE_PREVIOUS
		READ  #1 %line &CONNECT_TYPE_PREVIOUS
		READ  #1 %line &PATH_SELECTED_PREVIOUS
		READ  #1 %line &PATH_BOOT_SELECTED_PREVIOUS
		CLOSE #1
		IF "&PATH_SELECTED_PREVIOUS"==""
		(
			&PATH_SELECTED_PREVIOUS="C:\"
		)
		IF "&PATH_BOOT_SELECTED_PREVIOUS"==""
		(
			&PATH_BOOT_SELECTED_PREVIOUS="C:\"
		)
		SYSTEM.CPU &CPU_TYPE_PREVIOUS
	)

	&CONNECT_TYPE="&CONNECT_TYPE_PREVIOUS"
	&CPU_TYPE="&CPU_TYPE_PREVIOUS"

	&PATH_SELECTED="&PATH_SELECTED_PREVIOUS"
	&PATH_BOOT_SELECTED="&PATH_BOOT_SELECTED_PREVIOUS"
	IF "&CONNECT_TYPE"=="DAP2"
	(
		SYSTEM.CONFIG.DEBUGPORTTYPE DAP2
		SYSTEM.CONFIG.DAP.DAPEN.ON
		SYSTEM.JC 20MHZ
		&CONNECT_TYPE_LAST="Option_Connect.1"
	)
	ELSE IF "&CONNECT_TYPE"=="JTAG"
	(
		SYSTEM.CONFIG.DEBUGPORTTYPE JTAG
		&CONNECT_TYPE_LAST="Option_Connect.2"
	)
)
ELSE
(
		//Previous AND SYSTEM
	IF (!os.file(~~\Button\Env\PREVIOUS_TYPE_BOOT.txt))
	(
		SYSTEM.CPU TC*
		&CPU_TYPE_PREVIOUS=CPU()
		&CONNECT_TYPE_PREVIOUS="JTAG"
		&PATH_SELECTED_PREVIOUS="C:\"
		&PATH_BOOT_SELECTED_PREVIOUS="C:\"
		OPEN  #1 ~~\Button\Env\PREVIOUS_TYPE_BOOT.txt /CREATE
		WRITE #1 "TC277TF"
		WRITE #1 "JTAG"
		WRITE #1 "C:\"
		WRITE #1 "C:\"
		CLOSE #1
	)
	ELSE
	(
		OPEN #1 ~~\Button\Env\PREVIOUS_TYPE_BOOT.txt /READ
		READ  #1 %line &CPU_TYPE_PREVIOUS
		READ  #1 %line &CONNECT_TYPE_PREVIOUS
		READ  #1 %line &PATH_SELECTED_PREVIOUS
		READ  #1 %line &PATH_BOOT_SELECTED_PREVIOUS
		CLOSE #1
		SYSTEM.CPU &CPU_TYPE_PREVIOUS
	)

	&CONNECT_TYPE="&CONNECT_TYPE_PREVIOUS"
	&CPU_TYPE="&CPU_TYPE_PREVIOUS"

	&PATH_SELECTED="&PATH_SELECTED_PREVIOUS"
	&PATH_BOOT_SELECTED="&PATH_BOOT_SELECTED_PREVIOUS"
	IF "&CONNECT_TYPE"=="DAP2"
	(
		SYSTEM.CONFIG.DEBUGPORTTYPE DAP2
		SYSTEM.CONFIG.DAP.DAPEN.ON
		SYSTEM.JC 20MHZ
		&CONNECT_TYPE_LAST="Option_Connect.1"
	)
	ELSE IF "&CONNECT_TYPE"=="JTAG"
	(
		SYSTEM.CONFIG.DEBUGPORTTYPE JTAG
		&CONNECT_TYPE_LAST="Option_Connect.2"
	)
)

DIALOG
(
	HEADER "SMART Reprogram V14.1"
	
	POS 0. 0. 33. 3.
	BOX "MCU type select"
	POS 1. 1. 31. 1.
	MCU_TYPE: PULLDOWN "TC21x,TC22x,TC23x,TC26x,TC27x,TC29x,TC32x,TC33x,TC35x,TC36x,TC37x,TC38x,TC39x"
	(
		GOSUB CPU_TYPE_CHECK_SUB
		ENTRY &CPU_TYPE_TEMP
	)
	POS 0. 2. 33. 7.
	BOX "Previous and Favorite configuration"
	POS 1. 4. 31. 1.
	Dyna_Favorite: DYNTEXT ""
	POS 1. 5. 31. 1.
	Dyna_Favorite2: DYNTEXT ""
	POS 1. 6. 31. 1.
	Dyna_Favorite3: DYNTEXT ""
	POS 1. 7. 31. 1.
	Dyna_Favorite4: DYNTEXT ""
	
	POS 1. 3. 18. 1.
	LOAD_CONFIG: PULLDOWN "PREVIOUS_SET,SET_1,SET_2"
	(
		DIALOG.Set Dyna_Favorite	"CPU: &CPU_TYPE_PREVIOUS"
		DIALOG.Set Dyna_Favorite2	"CONNECT: &CONNECT_TYPE_PREVIOUS"
		DIALOG.Set Dyna_Favorite3	OS.FILE.NAME("&PATH_SELECTED_PREVIOUS")
		IF &USEBOOT_T==FALSE()
		(
			DIALOG.Set Dyna_Favorite4 ""				
		)
		ELSE
		(
			DIALOG.Set Dyna_Favorite4 OS.FILE.NAME("&PATH_BOOT_SELECTED_PREVIOUS")
		)
	)
	
	POS 19. 3. 10. 1.
	BUTTON "[:edit]APPLY "
	(
		LOCAL &APPLY_CPU_TYPE &APPLY_CONNECT_TYPE &APPLY_PATH_SELECTED &APPLY_PATH_BOOT_SELECTED
		IF DIALOG.STRing(LOAD_CONFIG)=="PREVIOUS_SET"			
		(
			DIALOG.Set Dyna_Firstwindow "Do you want to use previous configuration?"
			&CPU_TYPE="&CPU_TYPE_PREVIOUS"
			&CONNECT_TYPE="&CONNECT_TYPE_PREVIOUS"
			&PATH_SELECTED="&PATH_SELECTED_PREVIOUS"
			
			IF &USEBOOT_T==FALSE()
			(
				&PATH_BOOT_SELECTED="NONE"				
			)
			ELSE
			(
				&PATH_BOOT_SELECTED="&PATH_BOOT_SELECTED_PREVIOUS"
			)
			
			
			SYSTEM.CPU &CPU_TYPE
		)
		IF DIALOG.STRing(LOAD_CONFIG)=="SET_1"			
		(
			GOSUB FAVORITE_DYNA_HANDLE_SUB "SET_1" "LOAD" "APPLY" &USEBOOT_T
			ENTRY &APPLY_CPU_TYPE &APPLY_CONNECT_TYPE &APPLY_PATH_SELECTED &APPLY_PATH_BOOT_SELECTED
			
			&CPU_TYPE="&APPLY_CPU_TYPE"
			&CONNECT_TYPE="&APPLY_CONNECT_TYPE"
			&PATH_SELECTED="&APPLY_PATH_SELECTED"
			IF &USEBOOT_T==FALSE()
			(
				&PATH_BOOT_SELECTED="NONE"				
			)
			ELSE
			(
				&PATH_BOOT_SELECTED="&APPLY_PATH_BOOT_SELECTED"
			)
			SYSTEM.CPU &CPU_TYPE
			
			DIALOG.Set Dyna_Firstwindow "Do you want to use SET_1?"
		)
		IF DIALOG.STRing(LOAD_CONFIG)=="SET_2"
		(
			GOSUB FAVORITE_DYNA_HANDLE_SUB "SET_2" "LOAD" "APPLY" &USEBOOT_T
			ENTRY &APPLY_CPU_TYPE &APPLY_CONNECT_TYPE &APPLY_PATH_SELECTED &APPLY_PATH_BOOT_SELECTED
			
			&CPU_TYPE="&APPLY_CPU_TYPE"
			&CONNECT_TYPE="&APPLY_CONNECT_TYPE"
			&PATH_SELECTED="&APPLY_PATH_SELECTED"
			IF &USEBOOT_T==FALSE()
			(
				&PATH_BOOT_SELECTED="NONE"				
			)
			ELSE
			(
				&PATH_BOOT_SELECTED="&APPLY_PATH_BOOT_SELECTED"
			)
			SYSTEM.CPU &CPU_TYPE
			DIALOG.Set Dyna_Firstwindow "Do you want to use SET_2?"
		)
		&CPU_CHECK=STRING.MID("&CPU_TYPE",0.,4.)
	)
	POS 10. 9. 10. 0.
	BUTTON "[:edit]AUX "
	(
		LOCAL &USEBOOT_TEMP
		&USEBOOT_TEMP=&USEBOOT_T
		Do ~~\Button\Etc_config.cmm &CPU_TYPE_TEMP &CORE_SELECTED_T &MULTI_CORE_WINDOW_T &CORE_STATE_T \
		&RAMFLASH_T &MCS_CORE &MCS_CHANNEL_NUMBER &MCS_CORE_CONFIG &GTM_SELECT_T &PC_T &PCADDRESS_T &USEBOOT_T &MODE_T &DefaultFolderName \
		&Boot_PC_ADD_T &GTM_OCDS_SELECT_T
		ENTRY &CPU_TYPE &CORE_SELECTED_T &MULTI_CORE_WINDOW_T &CORE_STATE_T &RAMFLASH_T \
		&MCS_CORE &MCS_CHANNEL_NUMBER &MCS_CORE_CONFIG &GTM_SELECT_T &PC_T &PCADDRESS_T &USEBOOT_T &MODE_T &DefaultFolderName
		IF &USEBOOT_TEMP==&USEBOOT_T
		(
			DIALOG.SET LOAD_CONFIG 		"PREVIOUS_SET"
			DIALOG.Set Dyna_Favorite	"CPU: &CPU_TYPE_PREVIOUS"
			DIALOG.Set Dyna_Favorite2	"CONNECT: &CONNECT_TYPE_PREVIOUS"
			DIALOG.Set Dyna_Favorite3	OS.FILE.NAME("&PATH_SELECTED_PREVIOUS")
			IF &USEBOOT_T==FALSE()
			(
				DIALOG.Set Dyna_Favorite4 ""				
			)
			ELSE
			(
				DIALOG.Set Dyna_Favorite4 OS.FILE.NAME("&PATH_BOOT_SELECTED_PREVIOUS")
			)
		)
		ELSE
		(
			IF &USEBOOT_T==FALSE()
			(
				DIALOG.Set Dyna_Favorite4 ""				
			)
			ELSE
			(
				DIALOG.Set Dyna_Favorite4 OS.FILE.NAME("&PATH_BOOT_SELECTED_PREVIOUS")
			)

		)
	)
	POS 1. 10. 30. 0.
	Dyna_Firstwindow: DYNTEXT ""
  
	;buttons OK (Default) and Change
	POS 2. 11. 10.
	BUTTON "Yes"
	(
		IF &USEBOOT_T==FALSE()
		(
			IF FILE.EXIST(&PATH_SELECTED)
			(
				SYSTEM.DOWN

				&CURRENT_PATH_USE=TRUE()
				&CONNECT_MODIFY="&CONNECT_TYPE"

				GOSUB REPROGRAM_SUB &CONNECT_MODIFY &PATH_SELECTED &PATH_BOOT_SELECTED &GTM_SELECT_T &USEBOOT_T			

				ENTRY &CPU_TYPE_MID &CPU_TYPE
				OPEN #1 ~~\Button\Env\PREVIOUS_TYPE.txt /CREATE
				WRITE #1 "&CPU_TYPE"
				WRITE #1 "&CONNECT_TYPE"
				WRITE #1 "&PATH_SELECTED"
				WRITE #1 "&PATH_BOOT_SELECTED"
				CLOSE #1
				GOSUB END_PROCESS2_SUB CONNECT_TYPE &CPU_TYPE_MID &CORE_SELECTED_T &MULTI_CORE_WINDOW_T \
				&MODE_T &CORE_STATE_T &GTM_SELECT_T &MCS_CORE &MCS_CORE_CONFIG &MCS_CHANNEL_NUMBER &CPU_TYPE &RAMFLASH_T
			)
			ELSE
			(
				DIALOG.MESSAGE "There is no path."
			)
		)
		ELSE
		(	
			IF FILE.EXIST(&PATH_SELECTED)&&FILE.EXIST(&PATH_BOOT_SELECTED)
			(
				SYSTEM.DOWN

				&CURRENT_PATH_USE=TRUE()
				&CONNECT_MODIFY="&CONNECT_TYPE"
				
				GOSUB REPROGRAM_SUB &CONNECT_MODIFY &PATH_SELECTED &PATH_BOOT_SELECTED &GTM_SELECT_T &USEBOOT_T		
				
				ENTRY &CPU_TYPE_MID &CPU_TYPE
				OPEN #1 ~~\Button\Env\PREVIOUS_TYPE.txt /CREATE
				WRITE #1 "&CPU_TYPE"
				WRITE #1 "&CONNECT_TYPE"
				WRITE #1 "&PATH_SELECTED"
				WRITE #1 "&PATH_BOOT_SELECTED"
				CLOSE #1
				GOSUB END_PROCESS2_SUB CONNECT_TYPE &CPU_TYPE_MID &CORE_SELECTED_T &MULTI_CORE_WINDOW_T \
				&MODE_T &CORE_STATE_T &GTM_SELECT_T &MCS_CORE &MCS_CORE_CONFIG &MCS_CHANNEL_NUMBER &CPU_TYPE &RAMFLASH_T
			)
			ELSE
			(
				DIALOG.MESSAGE "There is no path."
			)	
		)
	)
	POSX 5.
	BUTTON    "Change"
	(
		GOSUB CPU_MATCH_CHECK_SUB &CPU_TYPE_TEMP
		IF &USEBOOT_T==FALSE()
		(
			GOSUB CHANGE_BUTTON_SUB
		)
		ELSE
		(
			GOSUB CHANGE_BUTTON_SUB2
		)		
	)

POS 5. 12. 20.
	TEXT "Developed by Steve.Han@IFX"
	
;define action when window is closed
	CLOSE "GOTO CLOSE_END_SUB"
)

DIALOG.SET LOAD_CONFIG "PREVIOUS_SET"
DIALOG.Set Dyna_Favorite	"CPU: &CPU_TYPE_PREVIOUS"
DIALOG.Set Dyna_Favorite2	"CONNECT: &CONNECT_TYPE_PREVIOUS"
DIALOG.Set Dyna_Favorite3	OS.FILE.NAME("&PATH_SELECTED_PREVIOUS")
IF &USEBOOT_T==TRUE()
(
	DIALOG.Set Dyna_Favorite4 OS.FILE.NAME("&PATH_BOOT_SELECTED_PREVIOUS")
)
ELSE
(
	DIALOG.Set Dyna_Favorite4 ""
)
DIALOG.Set Dyna_Firstwindow "Do you want to use previous configuration?"
DIALOG.SET MCU_TYPE STRING.MID("&CPU_TYPE",0.,4.)+"x"
GOSUB CPU_TYPE_CHECK_SUB
ENTRY &CPU_TYPE_TEMP
STOP
ENDDO
CHANGE_BUTTON_SUB:
(   
	DIALOG.END
	Do ~~\Button\change1.cmm &CONNECT_TYPE_LAST &CPU_TYPE_TEMP &PATH_SELECTED &PATH_BOOT_SELECTED \
	&CORE_SELECTED_T &MULTI_CORE_WINDOW_T &CORE_STATE_T &RAMFLASH_T &MCS_CORE \
	&MCS_CHANNEL_NUMBER &MCS_CORE_CONFIG &GTM_SELECT_T &PC_T &PCADDRESS_T \
	&USEBOOT_T &MODE_T &DefaultFolderName
	
	ENDDO
)
CHANGE_BUTTON_SUB2:
(   
	DIALOG.END
	Do ~~\Button\change2.cmm &CONNECT_TYPE_LAST &CPU_TYPE_TEMP &PATH_SELECTED &PATH_BOOT_SELECTED \
	&CORE_SELECTED_T &MULTI_CORE_WINDOW_T &CORE_STATE_T &RAMFLASH_T &MCS_CORE \
	&MCS_CHANNEL_NUMBER &MCS_CORE_CONFIG &GTM_SELECT_T &PC_T &PCADDRESS_T \
	&USEBOOT_T &MODE_T &DefaultFolderName

	ENDDO
)
//-----------------------		CPU_TYPE_CHECK_SUB		-----------------------	
CPU_TYPE_CHECK_SUB:
(
	LOCAL &CPU_TYPE_CHECK
	&CPU_TYPE_CHECK=DIALOG.STRing(MCU_TYPE)
	RETURN &CPU_TYPE_CHECK
)
//-----------------------		CPU_MATCH_CHECK_SUB		-----------------------	
CPU_MATCH_CHECK_SUB:
(
	LOCAL &CPU_TYPE_MATCH_CHECK
	ENTRY &CPU_TYPE_MATCH_CHECK
	LOCAL &CPU_SELECTION_RIGHT &CPU_TYPE_MID_TEMP &CPU_TYPE_MATCH_CHECK_STAR

	&CPU_SELECTION_RIGHT=FALSE()
	WHILE &CPU_SELECTION_RIGHT==FALSE()
	(

		&CPU_TYPE_MID_TEMP=STRING.MID(CPU(),0.,4.)
		&CPU_TYPE_MATCH_CHECK_COMPARE=STRING.MID("&CPU_TYPE_MATCH_CHECK",0.,4.)
		&CPU_TYPE_MATCH_CHECK_STAR=STRING.MID("&CPU_TYPE_MATCH_CHECK",0.,4.)+"*"
		IF "&CPU_TYPE_MATCH_CHECK_COMPARE"!="&CPU_TYPE_MID_TEMP"
		(
			SYS.CPU &CPU_TYPE_MATCH_CHECK_STAR
		)
		ELSE IF "&CPU_TYPE_MATCH_CHECK_COMPARE"=="&CPU_TYPE_MID_TEMP"
		(
			&CPU_SELECTION_RIGHT=TRUE()
		)
		ELSE
		(
			&CPU_SELECTION_RIGHT=FALSE()
		)		

	)
	
	RETURN
)
//-----------------------		END OF CPU_MATCH_CHECK_SUB		-----------------------	
//-----------------------	REPROGRAM_SUB		------------------------
REPROGRAM_SUB:
(	
	LOCAL &CPU_TYPE_REPROGRAM &CPU_TYPE_MID_REPROGRAM
	LOCAL &CONNECT_REPROGRAM &PATH_SELECTED_REPROGRAM &PATH_SELECTED_BOOT_REPROGRAM &GTM_SELECT_REPROGRAM &USEBOOT_REPROGRAM
	ENTRY &CONNECT_REPROGRAM &PATH_SELECTED_REPROGRAM &PATH_SELECTED_BOOT_REPROGRAM &GTM_SELECT_REPROGRAM &USEBOOT_REPROGRAM
	IF "&GTM_SELECT_REPROGRAM"=="GTM_YES"
	(	
	//SYStem.Option PERSTOP OFF
		ON CMD COREGTM GOSUB coreGTM
		GOSUB setup_intercom
		COREGTM SYSTEM.DOWN
	)
	IF "&CONNECT_REPROGRAM"=="DAP2"
	(
		SYSTEM.CONFIG.DEBUGPORTTYPE DAP2
		SYSTEM.CONFIG.DAP.DAPEN.ON
		SYSTEM.JC 10MHZ
	)
	ELSE IF "&CONNECT_REPROGRAM"=="JTAG"
	(
		SYSTEM.CONFIG.DEBUGPORTTYPE JTAG
	)
	&CPU_TYPE_REPROGRAM=CPU()
	&CPU_TYPE_MID_REPROGRAM=STRING.MID("&CPU_TYPE_REPROGRAM",0.,4.)
	IF "&CPU_TYPE_MID_REPROGRAM"=="TC27"
	(
		DO ~~\Button\flash\tc27x_Auto.cmm "&PATH_SELECTED_REPROGRAM" "&PATH_SELECTED_BOOT_REPROGRAM" &USEBOOT_REPROGRAM
	)
	ELSE IF "&CPU_TYPE_MID_REPROGRAM"=="TC21"
	(
		DO ~~\Button\flash\tc21x_Auto.cmm "&PATH_SELECTED_REPROGRAM" "&PATH_SELECTED_BOOT_REPROGRAM" &USEBOOT_REPROGRAM
	)
	ELSE IF "&CPU_TYPE_MID_REPROGRAM"=="TC23"
	(
		DO ~~\Button\flash\tc23x_Auto.cmm "&PATH_SELECTED_REPROGRAM" "&PATH_SELECTED_BOOT_REPROGRAM" &USEBOOT_REPROGRAM
	)
	ELSE IF "&CPU_TYPE_MID_REPROGRAM"=="TC22"
	(
		DO ~~\Button\flash\tc22x_Auto.cmm "&PATH_SELECTED_REPROGRAM" "&PATH_SELECTED_BOOT_REPROGRAM" &USEBOOT_REPROGRAM
	)
	ELSE IF "&CPU_TYPE_MID_REPROGRAM"=="TC26"
	(
		DO ~~\Button\flash\tc26x_Auto.cmm "&PATH_SELECTED_REPROGRAM" "&PATH_SELECTED_BOOT_REPROGRAM" &USEBOOT_REPROGRAM
	)
	ELSE IF "&CPU_TYPE_MID_REPROGRAM"=="TC29"
	(
		DO ~~\Button\flash\tc29x_Auto.cmm "&PATH_SELECTED_REPROGRAM" "&PATH_SELECTED_BOOT_REPROGRAM" &USEBOOT_REPROGRAM
	)
	ELSE IF "&CPU_TYPE_MID_REPROGRAM"=="TC32"
	(
		DO ~~\Button\flash\tc32x_Auto.cmm "&PATH_SELECTED_REPROGRAM" "&PATH_SELECTED_BOOT_REPROGRAM" &USEBOOT_REPROGRAM
	)	
	ELSE IF "&CPU_TYPE_MID_REPROGRAM"=="TC33"
	(
		DO ~~\Button\flash\tc33x_Auto.cmm "&PATH_SELECTED_REPROGRAM" "&PATH_SELECTED_BOOT_REPROGRAM" &USEBOOT_REPROGRAM
	)
	ELSE IF "&CPU_TYPE_MID_REPROGRAM"=="TC35"
	(
		DO ~~\Button\flash\tc35x_Auto.cmm "&PATH_SELECTED_REPROGRAM" "&PATH_SELECTED_BOOT_REPROGRAM" &USEBOOT_REPROGRAM
	)
	ELSE IF "&CPU_TYPE_MID_REPROGRAM"=="TC36"
	(
		DO ~~\Button\flash\tc36x_Auto.cmm "&PATH_SELECTED_REPROGRAM" "&PATH_SELECTED_BOOT_REPROGRAM" &USEBOOT_REPROGRAM
	)	
	ELSE IF "&CPU_TYPE_MID_REPROGRAM"=="TC37"
	(
		DO ~~\Button\flash\tc37x_Auto.cmm "&PATH_SELECTED_REPROGRAM" "&PATH_SELECTED_BOOT_REPROGRAM" &USEBOOT_REPROGRAM
	)	
	ELSE IF "&CPU_TYPE_MID_REPROGRAM"=="TC38"
	(
		DO ~~\Button\flash\tc38x_Auto.cmm "&PATH_SELECTED_REPROGRAM" "&PATH_SELECTED_BOOT_REPROGRAM" &USEBOOT_REPROGRAM
	)	
	ELSE IF "&CPU_TYPE_MID_REPROGRAM"=="TC39"
	(
		DO ~~\Button\flash\tc39x_Auto.cmm "&PATH_SELECTED_REPROGRAM" "&PATH_SELECTED_BOOT_REPROGRAM" &USEBOOT_REPROGRAM
	)
	PRINT "&PATH_SELECTED_REPROGRAM flash complete./&CPU_TYPE_REPROGRAM"
	RETURN  &CPU_TYPE_MID_REPROGRAM &CPU_TYPE_REPROGRAM
)
ENDDO
//-----------------------	END OF REPROGRAM_SUB		------------------------

//-----------------------	REPROGRAM_BOOT_SUB		------------------------
REPROGRAM_BOOT_SUB:
(	
	LOCAL &CPU_TYPE_REPROGRAM &CPU_TYPE_MID_REPROGRAM
	LOCAL &CONNECT_REPROGRAM &PATH_SELECTED_REPROGRAM &PATH_SELECTED_BOOT_REPROGRAM &GTM_SELECT_REPROGRAM
	ENTRY &CONNECT_REPROGRAM &PATH_SELECTED_REPROGRAM &PATH_SELECTED_BOOT_REPROGRAM &GTM_SELECT_REPROGRAM
	IF "&GTM_SELECT_REPROGRAM"=="GTM_YES"
	(	
	//SYStem.Option PERSTOP OFF
		ON CMD COREGTM GOSUB coreGTM
		GOSUB setup_intercom
		COREGTM SYSTEM.DOWN
	)
	IF "&CONNECT_REPROGRAM"=="DAP2"
	(
		SYSTEM.CONFIG.DEBUGPORTTYPE DAP2
		SYSTEM.CONFIG.DAP.DAPEN.ON
		SYSTEM.JC 10MHZ
	)
	ELSE IF "&CONNECT_REPROGRAM"=="JTAG"
	(
		SYSTEM.CONFIG.DEBUGPORTTYPE JTAG
	)
	&CPU_TYPE_REPROGRAM=CPU()
	&CPU_TYPE_MID_REPROGRAM=STRING.MID("&CPU_TYPE_REPROGRAM",0.,4.)
	IF "&CPU_TYPE_MID_REPROGRAM"=="TC27"
	(
		DO ~~\Button\flash\tc27x_Auto.cmm "&PATH_SELECTED_REPROGRAM" ;"&PATH_SELECTED_BOOT_REPROGRAM"PLACE HOLDER
	)
	ELSE IF "&CPU_TYPE_MID_REPROGRAM"=="TC21"
	(
		DO ~~\Button\flash\tc21x_Auto.cmm "&PATH_SELECTED_REPROGRAM" ;"&PATH_SELECTED_BOOT_REPROGRAM"PLACE HOLDER
	)
	ELSE IF "&CPU_TYPE_MID_REPROGRAM"=="TC23"
	(
		DO ~~\Button\flash\tc23x_Auto.cmm "&PATH_SELECTED_REPROGRAM" ;"&PATH_SELECTED_BOOT_REPROGRAM"PLACE HOLDER
	)
	ELSE IF "&CPU_TYPE_MID_REPROGRAM"=="TC22"
	(
		DO ~~\Button\flash\tc22x_Auto.cmm "&PATH_SELECTED_REPROGRAM" ;"&PATH_SELECTED_BOOT_REPROGRAM"PLACE HOLDER
	)
	ELSE IF "&CPU_TYPE_MID_REPROGRAM"=="TC26"
	(
		DO ~~\Button\flash\tc26x_Auto.cmm "&PATH_SELECTED_REPROGRAM" ;"&PATH_SELECTED_BOOT_REPROGRAM"PLACE HOLDER
	)
	ELSE IF "&CPU_TYPE_MID_REPROGRAM"=="TC29"
	(
		DO ~~\Button\flash\tc29x_Auto.cmm "&PATH_SELECTED_REPROGRAM" ;"&PATH_SELECTED_BOOT_REPROGRAM"PLACE HOLDER
	)
	ELSE IF "&CPU_TYPE_MID_REPROGRAM"=="TC32"
	(
		DO ~~\Button\flash\tc32x_Auto.cmm "&PATH_SELECTED_REPROGRAM" ;"&PATH_SELECTED_BOOT_REPROGRAM"PLACE HOLDER
	)	
	ELSE IF "&CPU_TYPE_MID_REPROGRAM"=="TC33"
	(
		DO ~~\Button\flash\tc33x_Auto.cmm "&PATH_SELECTED_REPROGRAM" ;"&PATH_SELECTED_BOOT_REPROGRAM"PLACE HOLDER
	)
	ELSE IF "&CPU_TYPE_MID_REPROGRAM"=="TC35"
	(
		DO ~~\Button\flash\tc35x_Auto.cmm "&PATH_SELECTED_REPROGRAM" ;"&PATH_SELECTED_BOOT_REPROGRAM"PLACE HOLDER
	)
	ELSE IF "&CPU_TYPE_MID_REPROGRAM"=="TC36"
	(
		DO ~~\Button\flash\tc36x_Auto.cmm "&PATH_SELECTED_REPROGRAM" ;"&PATH_SELECTED_BOOT_REPROGRAM"PLACE HOLDER
	)	
	ELSE IF "&CPU_TYPE_MID_REPROGRAM"=="TC37"
	(
		DO ~~\Button\flash\tc37x_Auto.cmm "&PATH_SELECTED_REPROGRAM" ;"&PATH_SELECTED_BOOT_REPROGRAM"PLACE HOLDER
	)	
	ELSE IF "&CPU_TYPE_MID_REPROGRAM"=="TC38"
	(
		DO ~~\Button\flash\tc38x_Auto.cmm "&PATH_SELECTED_REPROGRAM" ;"&PATH_SELECTED_BOOT_REPROGRAM"PLACE HOLDER
	)	
	ELSE IF "&CPU_TYPE_MID_REPROGRAM"=="TC39"
	(
		DO ~~\Button\flash\tc39x_Auto.cmm "&PATH_SELECTED_REPROGRAM" ;"&PATH_SELECTED_BOOT_REPROGRAM"PLACE HOLDER
	)
	PRINT "&PATH_SELECTED_REPROGRAM  &PATH_SELECTED_BOOT_REPROGRAM flash complete./&CPU_TYPE_REPROGRAM"
	RETURN  &CPU_TYPE_MID_REPROGRAM &CPU_TYPE_REPROGRAM
)
ENDDO
//-----------------------	END OF REPROGRAM_BOOT_SUB		------------------------

//-----------------------		END_PROCESS2_SUB		---------------------------
END_PROCESS2_SUB:
(
	LOCAL &CONNECT_PROCESS2 &CPU_TYPE_MID_PROCESS2 &CORE_SELECTED_PROCESS2 &MULTI_CORE_WINDOW_PROCESS2 &GENERATION
	LOCAL  &MODE_PROCESS2 &CORE_STATE_PROCESS2 &GTM_SELECT_PROCESS2 &MCS_CORE_PROCESS2 &MCS_CORE_CONFIG_PROCESS2 &MCS_CHANNEL_NUMBER_PROCESS2 &CPU_TYPE_PROCESS2 &RAMFLASH_PROCESS2
	ENTRY &CONNECT_PROCESS2 &CPU_TYPE_MID_PROCESS2 &CORE_SELECTED_PROCESS2 &MULTI_CORE_WINDOW_PROCESS2 \
	&MODE_PROCESS2 &CORE_STATE_PROCESS2 &GTM_SELECT_PROCESS2 &MCS_CORE_PROCESS2 &MCS_CORE_CONFIG_PROCESS2 &MCS_CHANNEL_NUMBER_PROCESS2 &CPU_TYPE_PROCESS2 &RAMFLASH_PROCESS2
	IF &RAMFLASH_PROCESS2==TRUE()
	(
		;SYSTEM.UP
	)
	ELSE
	(
		SYSTEM.DOWN
	)
	IF "&CONNECT_PROCESS2"=="DAP2"
	(
		SYSTEM.CONFIG.DEBUGPORTTYPE DAP2
		SYSTEM.CONFIG.DAP.DAPEN.ON
		SYSTEM.JC 20MHZ
	)
	ELSE IF "&CONNECT_PROCESS2"=="JTAG"
	(
		SYSTEM.CONFIG.DEBUGPORTTYPE JTAG
	)
	
	&GENERATION = STRING.MID("&CPU_TYPE_MID_PROCESS2",0.,3.)
	IF ("&GENERATION"=="TC2")
	(
		IF ("&CPU_TYPE_MID_PROCESS2"!="TC21"&&"&CPU_TYPE_MID_PROCESS2"!="TC22"&&"&CPU_TYPE_MID_PROCESS2"!="TC23"&&"&CPU_TYPE_MID_PROCESS2"!="TC26")
		(
			IF "&CORE_SELECTED_PROCESS2"=="SINGLE"
			(
				Core.assign  1.
			)
			ELSE IF "&CORE_SELECTED_PROCESS2"=="DOUBLE"
			(
				
				Core.assign  1. 2.
				IF &MULTI_CORE_WINDOW_PROCESS2==TRUE()
				(
					d.l /core 0
					d.l /core 1
				)
				
			)
			ELSE
			(
				Core.assign  1. 2. 3.
				IF &MULTI_CORE_WINDOW_PROCESS2==TRUE()
				(
					d.l /core 0
					d.l /core 1
					d.l /core 2
				)
			)
		)
		ELSE IF ("&CPU_TYPE_MID_PROCESS2"=="TC26")
		(
			IF "&CORE_SELECTED_PROCESS2"=="SINGLE"
			(
				Core.assign  1.
			)
			ELSE IF "&CORE_SELECTED_PROCESS2"=="DOUBLE"
			(
				
				Core.assign  1. 2.
				IF &MULTI_CORE_WINDOW_PROCESS2==TRUE()
				(
					d.l /core 0
					d.l /core 1
				)
			)
		)
	)
	ELSE IF ("&GENERATION"=="TC3")
	(
		IF ("&CPU_TYPE_MID_PROCESS2"=="TC38")
		(
			IF "&CORE_SELECTED_PROCESS2"=="SINGLE"
			(
				Core.assign  1.
			)
			ELSE IF "&CORE_SELECTED_PROCESS2"=="DOUBLE"
			(
				
				Core.assign  1. 2.
				IF &MULTI_CORE_WINDOW_PROCESS2==TRUE()
				(
					d.l /core 0
					d.l /core 1
				)
				
			)
			ELSE IF "&CORE_SELECTED_PROCESS2"=="TRIPLE"
			(
				Core.assign  1. 2. 3.
				IF &MULTI_CORE_WINDOW_PROCESS2==TRUE()
				(
					d.l /core 0
					d.l /core 1
					d.l /core 2
				)
			)
			ELSE IF "&CORE_SELECTED_PROCESS2"=="QUAD"
			(
				Core.assign  1. 2. 3. 4.
				IF &MULTI_CORE_WINDOW_PROCESS2==TRUE()
				(
					d.l /core 0
					d.l /core 1
					d.l /core 2
					d.l /core 3
				)
			)
		)
		ELSE IF ("&CPU_TYPE_MID_PROCESS2"=="TC39")
		(
			IF "&CORE_SELECTED_PROCESS2"=="SINGLE"
			(
				Core.assign  1.
			)
			ELSE IF "&CORE_SELECTED_PROCESS2"=="DOUBLE"
			(
				
				Core.assign  1. 2.
				IF &MULTI_CORE_WINDOW_PROCESS2==TRUE()
				(
					d.l /core 0
					d.l /core 1
				)
				
			)
			ELSE IF "&CORE_SELECTED_PROCESS2"=="TRIPLE"
			(
				Core.assign  1. 2. 3.
				IF &MULTI_CORE_WINDOW_PROCESS2==TRUE()
				(
					d.l /core 0
					d.l /core 1
					d.l /core 2
				)
			)
			ELSE IF "&CORE_SELECTED_PROCESS2"=="QUAD"
			(
				Core.assign  1. 2. 3. 4.
				IF &MULTI_CORE_WINDOW_PROCESS2==TRUE()
				(
					d.l /core 0
					d.l /core 1
					d.l /core 2
					d.l /core 3
				)
			)
			ELSE IF "&CORE_SELECTED_PROCESS2"=="PENTA"
			(
				Core.assign  1. 2. 3. 4. 5.
				IF &MULTI_CORE_WINDOW_PROCESS2==TRUE()
				(
					d.l /core 0
					d.l /core 1
					d.l /core 2
					d.l /core 3
					d.l /core 4
				)
			)
			ELSE IF "&CORE_SELECTED_PROCESS2"=="HEXA"
			(
				Core.assign  1. 2. 3. 4. 5. 6.
				IF &MULTI_CORE_WINDOW_PROCESS2==TRUE()
				(
					d.l /core 0
					d.l /core 1
					d.l /core 2
					d.l /core 3
					d.l /core 4
					d.l /core 5
				)
			)
		)


	)

	IF "&MODE_T"=="COMPLEX"
	(
		SYSTEM.O.DUALPORT.ON
		SYSTEM.CA.E
		SYSTEM.O.IMASKASM.OFF
		SYSTEM.O.IMASKHLL.OFF
		SETUP.VAR %SPOTLIGHT
		//SYStem.Option PERSTOP OFF
	)
	ELSE
	(
		;"&MODE_T"=="SIMPLE" NOTHING
	)

	IF &CORE_STATE_PROCESS2==TRUE()
	(
		IF WINDOW.NAME("B::TargetSystem.state DEFault")==FALSE()
		(
			TargetSystem.state DEFault
		)
		CORE.SHOWACTIVE
	)
	IF "&GTM_SELECT_PROCESS2"=="GTM_YES"
	(
		;SYSTEM.UP Will be handle in GTM.cmm
		DO ~~\Button\GTM.cmm &MCS_CORE_PROCESS2 &MCS_CORE_CONFIG_PROCESS2 &MCS_CHANNEL_NUMBER_PROCESS2 &CPU_TYPE_PROCESS2 &CONNECT_PROCESS2
	)
	ELSE
	(
		IF &RAMFLASH_PROCESS2==TRUE()
		(
			;Nothing to do
			;SYSTEM.UP
		)
		ELSE
		(
			SYSTEM.UP
		)
	)
	GOSUB CLOSE_END_SUB
)
ENDDO
//-----------------------		END OF END_PROCESS2_SUB		---------------------------

//-----------------------		CLOSE_END_SUB		-----------------------------------
CLOSE_END_SUB:
	DIALOG.END
ENDDO
//-----------------------		END OF CLOSE_END_SUB		---------------------------

//-----------------------		COMMUNICATION_SUB		-------------------------------
setup_intercom:
(
  &portTC0=FORMAT.DECIMAL(1.,INTERCOM.PORT())
  &portGTM=FORMAT.DECIMAL(1.,INTERCOM.PORT()+1.)
  &addressTC0="127.0.0.1:&portTC0"
  &addressGTM="127.0.0.1:&portGTM"
  RETURN
)
coreGTM:
(
  LOCAL &params
  ENTRY %Line &params
  INTERCOM.execute &addressGTM &params ; execute on remote GUI
  RETURN
)
coreTC0:
(
  LOCAL &params
  ENTRY %Line &params
  &params ; execute on this GUI
  RETURN
)
//-----------------------		END OF COMMUNICATION_SUB		-----------------------


//-----------------------		FAVORITE_SAVE_LOAD_SUB		---------------------------
FAVORITE_SAVE_LOAD_SUB:
(	
	LOCAL &CPU_TYPE_FAVORITE
	LOCAL &CONNECT_TYPE_FAVORITE
	LOCAL &PATH_SELECTED_NUM_FAVORITE &PATH_SELECTED_FAVORITE &PATH_SELECTED_BOOT_FAVORITE
	LOCAL &SET_VALUE_SAVE_LOAD &SAVE_LOAD_FAVORITE &APPLY_CHECK_SAVE_LOAD &USEBOOT_SAVE_LOAD
	ENTRY &SET_VALUE_SAVE_LOAD &SAVE_LOAD_FAVORITE &APPLY_CHECK_SAVE_LOAD &USEBOOT_SAVE_LOAD
	;TO DO: &Path value should be changed from global to local
	&CPU_TYPE_FAVORITE=CPU() 
	IF &SAVE_LOAD_FAVORITE=="SAVE"
	(		
		IF &USEBOOT_SAVE_LOAD==FALSE()
		(
			IF DIALOG.BOOLEAN(PATH_CHECK.1)
			(
				&PATH_SELECTED_NUM_FAVORITE="PATH_CHECK.1"
				&PATH_SELECTED_FAVORITE="&PATH1"
			)
			ELSE IF DIALOG.BOOLEAN(PATH_CHECK.2)
			(
				&PATH_SELECTED_NUM_FAVORITE="PATH_CHECK.2"
				&PATH_SELECTED_FAVORITE="&PATH2"
			)
			ELSE IF DIALOG.BOOLEAN(PATH_CHECK.3)
			(
				&PATH_SELECTED_NUM_FAVORITE="PATH_CHECK.3"
				&PATH_SELECTED_FAVORITE="&PATH3"
			)
			ELSE IF DIALOG.BOOLEAN(PATH_CHECK.4)
			(
				&PATH_SELECTED_NUM_FAVORITE="PATH_CHECK.4"
				&PATH_SELECTED_FAVORITE="&PATH4"
			)
			&PATH_SELECTED_BOOT_FAVORITE="NONE"
		)
		ELSE
		(
			IF DIALOG.BOOLEAN(PATH_CHECK.1)
			(
				&PATH_SELECTED_NUM_FAVORITE="PATH_CHECK.1"
				&PATH_SELECTED_FAVORITE="&PATH1"
				&PATH_SELECTED_BOOT_FAVORITE="&PATH2"
			)
			ELSE IF DIALOG.BOOLEAN(PATH_CHECK.2)
			(
				&PATH_SELECTED_NUM_FAVORITE="PATH_CHECK.2"
				&PATH_SELECTED_FAVORITE="&PATH3"
				&PATH_SELECTED_BOOT_FAVORITE="&PATH4"
			)
		)


		IF DIALOG.BOOLEAN(Option_Connect.1)
		(
			&CONNECT_TYPE_FAVORITE="DAP2"
		)
		ELSE IF DIALOG.BOOLEAN(Option_Connect.2)
		(
			&CONNECT_TYPE_FAVORITE="JTAG"
		)			
		DO ~~\Button\Favorit.cmm &SET_VALUE_SAVE_LOAD &SAVE_LOAD_FAVORITE &APPLY_CHECK_SAVE_LOAD \
		&USEBOOT_SAVE_LOAD &CPU_TYPE_FAVORITE &CONNECT_TYPE_FAVORITE &PATH_SELECTED_FAVORITE &PATH_SELECTED_BOOT_FAVORITE \
		&PATH_SELECTED_NUM_FAVORITE 
		
		RETURN
	)
	; COMING FROM FAVORITE_DYNA_HANDLE_SUB
	IF &SAVE_LOAD_FAVORITE=="LOAD"
	(
		DO ~~\Button\Favorit.cmm &SET_VALUE_SAVE_LOAD &SAVE_LOAD_FAVORITE &APPLY_CHECK_SAVE_LOAD \
		&USEBOOT_SAVE_LOAD 

		IF &APPLY_CHECK_SAVE_LOAD=="APPLY"
		(
			ENTRY &FAVORITE_USE &FAVORITE_VERI_CHECK_PULLDOWN &CPU_TYPE_FAVORITE \
			&CONNECT_TYPE_FAVORITE &PATH_SELECTED_FAVORITE &PATH_SELECTED_BOOT_FAVORITE &PATH_SELECTED_NUM_FAVORITE
			
			IF &FAVORITE_USE==TRUE()
			(	
				PRINT "Favorite LOAD&APPLY success"
				RETURN &CPU_TYPE_FAVORITE &CONNECT_TYPE_FAVORITE &PATH_SELECTED_FAVORITE &PATH_SELECTED_BOOT_FAVORITE
			)
			ELSE
			(
				PRINT "Varification fail APPLY"
				RETURN
			)			
		)
		ELSE IF &APPLY_CHECK_SAVE_LOAD=="PULLDOWN"
		(
			ENTRY &FAVORITE_USE &FAVORITE_VERI_CHECK_PULLDOWN &CPU_TYPE_FAVORITE &CONNECT_TYPE_FAVORITE \
			&PATH_SELECTED_FAVORITE &PATH_SELECTED_BOOT_FAVORITE &PATH_SELECTED_NUM_FAVORITE
			IF &FAVORITE_VERI_CHECK_PULLDOWN==TRUE()
			(	
				PRINT "Favorite LOAD success"
				RETURN &CPU_TYPE_FAVORITE &CONNECT_TYPE_FAVORITE &PATH_SELECTED_FAVORITE &PATH_SELECTED_BOOT_FAVORITE				
			)
			ELSE
			(
				PRINT "Varification fail PULLDOWN"
				RETURN &CPU_TYPE_FAVORITE &CONNECT_TYPE_FAVORITE &PATH_SELECTED_FAVORITE &PATH_SELECTED_BOOT_FAVORITE
			)
		)
		ELSE IF &APPLY_CHECK_SAVE_LOAD=="CHANGE"
		(
			ENTRY &FAVORITE_USE &FAVORITE_VERI_CHECK_PULLDOWN &CPU_TYPE_FAVORITE &CONNECT_TYPE_FAVORITE \
			&PATH_SELECTED_FAVORITE &PATH_SELECTED_BOOT_FAVORITE &PATH_SELECTED_NUM_FAVORITE
			IF &FAVORITE_VERI_CHECK_PULLDOWN==TRUE()
			(	
				PRINT "Favorite LOAD success"
				RETURN &CPU_TYPE_FAVORITE &CONNECT_TYPE_FAVORITE &PATH_SELECTED_FAVORITE &PATH_SELECTED_BOOT_FAVORITE				
			)
			ELSE
			(
				PRINT "Varification fail CHANGE"
				RETURN &CPU_TYPE_FAVORITE &CONNECT_TYPE_FAVORITE &PATH_SELECTED_FAVORITE &PATH_SELECTED_BOOT_FAVORITE
			)
		)
	)
)
//-----------------------	END OF FAVORITE_SAVE_LOAD_SUB		-------------------


//-----------------------	FAVORITE_DYNA_HANDLE_SUB		---------------------------
FAVORITE_DYNA_HANDLE_SUB:
(
	LOCAL &CPU_TYPE_DYNA_HANDLE &CONNECT_TYPE_DYNA_HANDLE &PATH_SELECTED_DYNA_HANDLE &PATH_SELECTED_BOOT_DYNA_HANDLE
	LOCAL &SETTING_VALUE &SAVE_LOAD_FAVORITE &PULL_APPLY &USEBOOT_DYNA_HANDLE
	ENTRY &SETTING_VALUE &SAVE_LOAD_FAVORITE &PULL_APPLY &USEBOOT_DYNA_HANDLE
	GOSUB FAVORITE_SAVE_LOAD_SUB &SETTING_VALUE &SAVE_LOAD_FAVORITE &PULL_APPLY &USEBOOT_DYNA_HANDLE
	
	ENTRY &CPU_TYPE_DYNA_HANDLE &CONNECT_TYPE_DYNA_HANDLE &PATH_SELECTED_DYNA_HANDLE &PATH_SELECTED_BOOT_DYNA_HANDLE
	DIALOG.Set Dyna_Favorite	"CPU: &CPU_TYPE_DYNA_HANDLE"
	DIALOG.Set Dyna_Favorite2	"CONNECT: &CONNECT_TYPE_DYNA_HANDLE"
	DIALOG.Set Dyna_Favorite3	OS.FILE.NAME("&PATH_SELECTED_DYNA_HANDLE")
	IF &USEBOOT_DYNA_HANDLE==FALSE()
	(
		DIALOG.Set Dyna_Favorite4	""
	)
	ELSE
	(
		DIALOG.Set Dyna_Favorite4	OS.FILE.NAME("&PATH_SELECTED_BOOT_DYNA_HANDLE")
	)
	
	RETURN &CPU_TYPE_DYNA_HANDLE &CONNECT_TYPE_DYNA_HANDLE &PATH_SELECTED_DYNA_HANDLE &PATH_SELECTED_BOOT_DYNA_HANDLE
)
//-----------------------	END OF FAVORITE_DYNA_HANDLE_SUB		--------------------