B::
SYSTEM.DOWN
LOCAL &portTC0 &portGTM &addressTC0 &addressGTM
GOSUB setup_intercom
ON CMD CORETC0 GOSUB coreTC0
ON CMD COREGTM GOSUB coreGTM

IF (!os.file(~~\Button\Env\Store_window.cmm))
(
	//MKDIR ~~\Button\Env
	OPEN #1 ~~\Button\Env\Store_window.cmm /CREATE
	WRITE #1 "abc"
	CLOSE #1
)
STORE ~~\Button\Env\Store_window.cmm win
PRINT "Working windows store complete."

LOCAL &FIRST_USER
LOCAL &CURRNENT_PATH_USE

LOCAL &PATH_SELECTED
LOCAL &PATH1
LOCAL &PATH2
LOCAL &PATH3
LOCAL &PATH4
LOCAL &PATH_SELECTED_CHANGE
LOCAL &PATH_CHANGE1
LOCAL &PATH_CHANGE2
LOCAL &PATH_CHANGE3
LOCAL &PATH_CHANGE4
LOCAL &PATH_SELECTED_FOLDER
LOCAL &PATH_FOLDER1
LOCAL &PATH_FOLDER2
LOCAL &PATH_FOLDER3
LOCAL &PATH_FOLDER4
LOCAL &PATH_SELECTED
LOCAL &PATH_SELECTED_NUM

LOCAL &SCRIPT1
LOCAL &SCRIPT2
LOCAL &SCRIPT_SELECTED_CHANGE
LOCAL &SCRIPT_CHANGE1
LOCAL &SCRIPT_CHANGE2
LOCAL &SCRIPT_SELECTED_FOLDER
LOCAL &SCRIPT_FOLDER1
LOCAL &SCRIPT_FOLDER2

LOCAL &CONNECT_TYPE
LOCAL &CONNECT_TYPE_LAST
LOCAL &CONNECT_MODIFY
LOCAL &CPU_TYPE
LOCAL &CPU_TYPE_MODIFY
LOCAL &SINGLE_CORE_T
LOCAL &DOUBLE_CORE_T
LOCAL &TRIPLE_CORE_T

LOCAL &MULTI_CORE_WINDOW_T
LOCAL &CORE_STATE_T
LOCAL &SIMPLE_REPROGRAM_T
LOCAL &CORE_SELECTED
LOCAL &MODE
LOCAL &MCS_CORE
LOCAL &MCS_CHANNEL_NUMBER
LOCAL &MCS_CORE_CONFIG
LOCAL &GTM_SELECT

&SINGLE_CORE_T=FALSE()
&DOUBLE_CORE_T=FALSE()
&TRIPLE_CORE_T=FALSE()

&MULTI_CORE_WINDOW_T=FALSE()
&CORE_STATE_T=FALSE()
&SIMPLE_REPROGRAM_T=FALSE()

&FIRST_USER=FALSE()
//-----------------------		FILE_CHECK&CREATION		-----------------------
IF (!os.file(~~\Button\Env\ETC_PATH.txt))
(
	&FIRST_USER=TRUE()
	OPEN  #1 ~~\Button\Env\ETC_PATH.txt /CREATE
	WRITE #1 "SINGLE"
	WRITE #1 "SIMPLE"
	WRITE #1 "MCS0"
	WRITE #1 "5"
	WRITE #1 "CHANNEL_0"
	WRITE #1 "GTM_YES"
	CLOSE #1
)
	OPEN  #1 ~~\Button\Env\ETC_PATH.txt /READ
	READ  #1 %line &CORE_SELECTED
	READ  #1 %line &MODE
	READ  #1 %line &MCS_CORE
	READ  #1 %line &MCS_CORE_CONFIG
	READ  #1 %line &MCS_CHANNEL_NUMBER
	READ  #1 %line &GTM_SELECT
	CLOSE #1
	
IF (!os.file(~~\Button\Env\ELF_PATH.txt))
(
	&FIRST_USER=TRUE()
	OPEN  #1 ~~\Button\Env\ELF_PATH.txt /CREATE
	WRITE #1 "C:\"
	WRITE #1 "C:\"
	WRITE #1 "C:\"
	WRITE #1 "C:\"
	WRITE #1 "PATH_CHECK.1"
	CLOSE #1
)
	OPEN  #1 ~~\Button\Env\ELF_PATH.txt /READ
	READ  #1 %line &PATH_SELECTED
	READ  #1 %line &PATH1
	READ  #1 %line &PATH2
	READ  #1 %line &PATH3
	READ  #1 %line &PATH4 
	READ  #1 %line &PATH_SELECTED_NUM
	CLOSE #1
	
	IF "&PATH1"==""
	(
		&PATH1="C:\"
	)
	IF "&PATH2"==""
	(
		&PATH2="C:\"
	)
	IF "&PATH3"==""
	(
		&PATH3="C:\"
	)
	IF "&PATH4"==""
	(
		&PATH4="C:\"
	)
	IF "&PATH_SELECTED_NUM"==""
	(
		&PATH_SELECTED_NUM="PATH_CHECK.1"
	)
	
	&PATH_SELECTED_FOLDER=os.file.path("&PATH_SELECTED")
	&PATH_FOLDER1=os.file.path("&PATH1")
	&PATH_FOLDER2=os.file.path("&PATH2")
	&PATH_FOLDER3=os.file.path("&PATH3")
	&PATH_FOLDER4=os.file.path("&PATH4")
	
IF (!os.file(~~\Button\Env\SCRIPT_PATH.txt))
(
	&FIRST_USER=TRUE()
	OPEN  #1 ~~\Button\Env\SCRIPT_PATH.txt /CREATE
	WRITE #1 "C:\"
	WRITE #1 "C:\"
	WRITE #1 "C:\"
	CLOSE #1
)
	OPEN  #1 ~~\Button\Env\SCRIPT_PATH.txt /READ
	READ  #1 %line &SCRIPT_SELECTED
	READ  #1 %line &SCRIPT1
	READ  #1 %line &SCRIPT2
	CLOSE #1
	&SCRIPT_SELECTED_FOLDER=os.file.path("&SCRIPT_SELECTED")
	&SCRIPT_FOLDER1=os.file.path("&SCRIPT1")
	&SCRIPT_FOLDER2=os.file.path("&SCRIPT2")
	
IF (!os.file(~~\Button\Env\CONNECT_TYPE.txt))
(
	&FIRST_USER=TRUE()
	&CONNECT_TYPE="JTAG"
)
ELSE
(
	OPEN  #1 ~~\Button\Env\CONNECT_TYPE.txt /READ
	READ  #1 %line &CONNECT_TYPE
	CLOSE #1
)

IF (!os.file(~~\Button\Env\CPU_TYPE.txt))
(

	&FIRST_USER=TRUE()
)
ELSE
(
	OPEN  #1 ~~\Button\Env\CPU_TYPE.txt /READ
	READ  #1 %line &CPU_TYPE
	CLOSE #1
)

IF &FIRST_USER
(
	DIALOG.MESSAGE "You are first user."\
	"Click the CHANGE button,please."\
	"If you have question, send a email to me."\
	"       	       Steve.han@infineon.com"
	SYSTEM.CPU TC2*
)
ELSE
(
	SYSTEM.CPU &CPU_TYPE
)
IF "&MODE"=="COMPLEX"
(
	IF "&CONNECT_TYPE"=="DAP2"
	(
		SYSTEM.CONFIG.DEBUGPORTTYPE DAP2
		SYSTEM.CONFIG.DAP.DAPEN.ON
		SYSTEM.JC 20MHZ
		&CONNECT_TYPE_LAST="Option_Connect.1"
	)
	ELSE IF "&CONNECT_TYPE"=="JTAG"
	(
		SYSTEM.CONFIG.DEBUGPORTTYPE JTAG
		&CONNECT_TYPE_LAST="Option_Connect.2"
	)
)

//SYStem.Option PERSTOP OFF //prevent halting the GTM via TriCore (chip bug)

DIALOG
(
	HEADER "Power Reprogram V7.0"
	POS 0. 0. 14. 5.
	BOX "CORE"
	POS 1. 1. 10. 1.
	CORE_CHEK.0: 	CHOOSEBOX "1 CORE" ""
	CORE_CHEK.1: 	CHOOSEBOX "2 CORE" ""
	CORE_CHEK.2: 	CHOOSEBOX "3 CORE" ""
	POS 14. 0. 16. 5.
	BOX "ETC"
	POS 15. 1. 14. 1.
	CORE_STATE: CHECKBOX "Core state" ""
	POS 15. 2. 14. 1.
	MULTI_CORE_WINDOW: CHECKBOX "Multicore window" ""
	POS 15. 3. 14. 1.
	SIMPLE_REPROGRAM: CHECKBOX "Simple reprogram" ""
	POS 0. 4. 30. 3.
	BOX "GTM"
	POS 2. 5. 10. 1.
	GTM_DEBUG: CHECKBOX "GTM Debug" ""
	POS 15. 5. 11.
	BUTTON "[:edit]MCS "
	(
		GOSUB MCS_SUB
	)

	POS 1. 7. 29. 0.
	TEXT "Do you want to use current path&setting?"
	POS 1. 9. 27.
	TEXT "Developed by Steve.Han@InfineonKOR"
  
	;buttons OK (Default) and Change
	POS 2. 8. 10.
	BUTTON "Yes"
	(
		IF DIALOG.BOOLEAN(GTM_DEBUG)
		(
			&GTM_SELECT="GTM_YES"
		)
		ELSE
		(
			&GTM_SELECT="GTM_NO"
		)
		&CURRNENT_PATH_USE=TRUE()
		IF DIALOG.BOOLEAN(SIMPLE_REPROGRAM)
		(	
			&SIMPLE_REPROGRAM_T=TRUE()
			&MODE="SIMPLE"
		)
		ELSE
		(	
			&MODE="COMPLEX"
		)
		GOSUB CORE_CHEK_SUB
		GOSUB ENVIRONMENT_SUB
		GOSUB REPROGRAM_SUB
	)
	POS 16. 8. 10.
	BUTTON    "Change"
	(
			IF DIALOG.BOOLEAN(GTM_DEBUG)
			(
				&GTM_SELECT="GTM_YES"
			)
			ELSE
			(
				&GTM_SELECT="GTM_NO"
			)
		GOSUB ENVIRONMENT_SUB
		GOSUB CORE_CHEK_SUB
		GOSUB Change
	)
;define action when window is closed
	CLOSE "GOTO CLOSE_END"
)
;default core
IF "&CORE_SELECTED"=="SINGLE"
(
	DIALOG.SET CORE_CHEK.0
)
ELSE IF "&CORE_SELECTED"=="DOUBLE"
(
	DIALOG.SET CORE_CHEK.1
)
ELSE IF "&CORE_SELECTED"=="TRIPLE"
(
	DIALOG.SET CORE_CHEK.2
)

IF "&MODE"=="SIMPLE"
(
	DIALOG.SET SIMPLE_REPROGRAM
)
IF "&GTM_SELECT"=="GTM_YES"
(
	DIALOG.SET GTM_DEBUG
)
STOP

MCS_SUB:
(
	DIALOG
	(
		HEADER "MCS"
		POS 0. 0. 8. 6.
		BOX "CORE"
		POS 1. 1. 5. 1.
		MCS_CORE.0: 	CHOOSEBOX "MCS0" ""
		MCS_CORE.1: 	CHOOSEBOX "MCS1" ""
		MCS_CORE.2: 	CHOOSEBOX "MCS2" ""
		MCS_CORE.3: 	CHOOSEBOX "MCS3" ""
		POS 0. 6. 8.
		BUTTON    "APPLY"
		(
			IF DIALOG.BOOLEAN(MCS_CORE.0)
			(
				&MCS_CORE="MCS0"
				&MCS_CORE_CONFIG="5"
			)
			ELSE IF DIALOG.BOOLEAN(MCS_CORE.1)
			(
				&MCS_CORE="MCS1"
				&MCS_CORE_CONFIG="6"
			)
			ELSE IF DIALOG.BOOLEAN(MCS_CORE.2)
			(
				&MCS_CORE="MCS2"
				&MCS_CORE_CONFIG="7"
			)
			ELSE IF DIALOG.BOOLEAN(MCS_CORE.3)
			(
				&MCS_CORE="MCS3"
				&MCS_CORE_CONFIG="8"
			)
			
			IF DIALOG.BOOLEAN(MCS_CHANNEL.0)
			(
				&MCS_CHANNEL_NUMBER="0"
			)
			ELSE IF DIALOG.BOOLEAN(MCS_CHANNEL.1)
			(
				&MCS_CHANNEL_NUMBER="1"
			)
			ELSE IF DIALOG.BOOLEAN(MCS_CHANNEL.2)
			(
				&MCS_CHANNEL_NUMBER="2"
			)
			ELSE IF DIALOG.BOOLEAN(MCS_CHANNEL.3)
			(
				&MCS_CHANNEL_NUMBER="3"
			)
			ELSE IF DIALOG.BOOLEAN(MCS_CHANNEL.4)
			(
				&MCS_CHANNEL_NUMBER="4"
			)
			ELSE IF DIALOG.BOOLEAN(MCS_CHANNEL.5)
			(
				&MCS_CHANNEL_NUMBER="5"
			)
			ELSE IF DIALOG.BOOLEAN(MCS_CHANNEL.6)
			(
				&MCS_CHANNEL_NUMBER="6"
			)
			ELSE IF DIALOG.BOOLEAN(MCS_CHANNEL.7)
			(
				&MCS_CHANNEL_NUMBER="7"
			)
			
			DIALOG.END
		)
		POS 8. 0. 8. 10.
		BOX "CHANNEL"
		POS 10. 1. 3. 1.
		MCS_CHANNEL.0: 	CHOOSEBOX "0" ""
		MCS_CHANNEL.1: 	CHOOSEBOX "1" ""
		MCS_CHANNEL.2: 	CHOOSEBOX "2" ""
		MCS_CHANNEL.3: 	CHOOSEBOX "3" ""
		MCS_CHANNEL.4: 	CHOOSEBOX "4" ""
		MCS_CHANNEL.5: 	CHOOSEBOX "5" ""
		MCS_CHANNEL.6: 	CHOOSEBOX "6" ""
		MCS_CHANNEL.7: 	CHOOSEBOX "7" ""
	)
	
	
	IF	"&MCS_CORE"=="MCS0"
	(
		DIALOG.SET MCS_CORE.0
	)
	ELSE IF	"&MCS_CORE"=="MCS1"
	(
		DIALOG.SET MCS_CORE.1
	)
	ELSE IF	"&MCS_CORE"=="MCS2"
	(
		DIALOG.SET MCS_CORE.2
	)
	ELSE IF	"&MCS_CORE"=="MCS3"
	(
		DIALOG.SET MCS_CORE.3
	)

	IF "&MCS_CHANNEL_NUMBER"=="0"
	(
		DIALOG.SET MCS_CHANNEL.0
	)
	ELSE IF "&MCS_CHANNEL_NUMBER"=="1"
	(
		DIALOG.SET MCS_CHANNEL.1
	)
	ELSE IF "&MCS_CHANNEL_NUMBER"=="2"
	(
		DIALOG.SET MCS_CHANNEL.2
	)	
	ELSE IF "&MCS_CHANNEL_NUMBER"=="3"
	(
		DIALOG.SET MCS_CHANNEL.3
	)
	ELSE IF "&MCS_CHANNEL_NUMBER"=="4"
	(
		DIALOG.SET MCS_CHANNEL.4
	)
	ELSE IF "&MCS_CHANNEL_NUMBER"=="5"
	(
		DIALOG.SET MCS_CHANNEL.5
	)
	ELSE IF "&MCS_CHANNEL_NUMBER"=="6"
	(
		DIALOG.SET MCS_CHANNEL.6
	)
	ELSE IF "&MCS_CHANNEL_NUMBER"=="7"
	(
		DIALOG.SET MCS_CHANNEL.7
	)	
	
STOP
)

CORE_CHEK_SUB:
(
	IF DIALOG.BOOLEAN(CORE_CHEK.0)
	(
		&SINGLE_CORE_T=TRUE()
		&CORE_SELECTED="SINGLE"
	)
	ELSE IF DIALOG.BOOLEAN(CORE_CHEK.1)
	(	
		&DOUBLE_CORE_T=TRUE()
		&CORE_SELECTED="DOUBLE"
		IF DIALOG.BOOLEAN(MULTI_CORE_WINDOW)
		(	
			&MULTI_CORE_WINDOW_T=TRUE()
		)
	)
	ELSE IF DIALOG.BOOLEAN(CORE_CHEK.2)
	(
		&TRIPLE_CORE_T=TRUE()
		&CORE_SELECTED="TRIPLE"
		IF DIALOG.BOOLEAN(MULTI_CORE_WINDOW)
		(	
			&MULTI_CORE_WINDOW_T=TRUE()
		)
	)
	
	IF DIALOG.BOOLEAN(CORE_STATE)
	(
		&CORE_STATE_T=TRUE()
	)
	RETURN
)
ENVIRONMENT_SUB:
(
	OPEN #1 ~~\Button\Env\ETC_PATH.txt /CREATE
	WRITE #1 "&CORE_SELECTED"
	WRITE #1 "&MODE"
	WRITE #1 "&MCS_CORE"
	WRITE #1 "&MCS_CORE_CONFIG"
	WRITE #1 "&MCS_CHANNEL_NUMBER"
	WRITE #1 "&GTM_SELECT"
	CLOSE #1	
	RETURN
)

REPROGRAM_SUB:
(	
	IF "&GTM_SELECT"=="GTM_YES"
	(	
	//SYStem.Option PERSTOP OFF
		ON CMD COREGTM GOSUB coreGTM
		GOSUB setup_intercom
		COREGTM SYSTEM.DOWN
	)
	&CPU_TYPE=CPU()
	&CPU_TYPE_MID=STRING.MID("&CPU_TYPE",0.,4.)
	IF "&CPU_TYPE_MID"=="TC27"
	(
		DO C:\T32\Button\flash\tc27x_Auto.cmm "&PATH_SELECTED"
	)
	ELSE IF "&CPU_TYPE_MID"=="TC23"
	(
		DO C:\T32\Button\flash\tc23x_Auto.cmm "&PATH_SELECTED"
	)
	ELSE IF "&CPU_TYPE_MID"=="TC26"
	(
		DO C:\T32\Button\flash\tc26x_Auto.cmm "&PATH_SELECTED"
	)
	ELSE IF "&CPU_TYPE_MID"=="TC29"
	(
		DO C:\T32\Button\flash\tc29x_Auto.cmm "&PATH_SELECTED"
	)
	PRINT "&PATH_SELECTED flash complete./&CPU_TYPE"

	IF &CURRNENT_PATH_USE==TRUE()
	(
		GOSUB END_PROCESS2
	)
	ELSE
	(
		GOSUB END_PROCESS1
	)
)

	
Change:
	DIALOG.END
	&CURRNENT_PATH_USE=FALSE()
	DIALOG
	(
//-----------------------		PATH_SELECT		-----------------------	
		POS 1. 0. 11.
		LINE "PATH_SELECT"
		HEADER "Change with reprogram"
		POS 1. 1. 6.
		PATH_CHECK.1: CHOOSEBOX "PATH_1" ""
		PATH_CHECK.2: CHOOSEBOX "PATH_2" ""
		PATH_CHECK.3: CHOOSEBOX "PATH_3" ""
		PATH_CHECK.4: CHOOSEBOX "PATH_4" ""
		
		POS 8. 1. 35.
		PATH_1:   EDIT "*.elf"
		(;get the user input when the cursor leaves the EDIT control
			&PATH_CHANGE1=DIALOG.STRing(PATH_1)
		)
		POS 8. 2. 35.
		PATH_2:   EDIT "*.elf"
		(;get the user input when the cursor leaves the EDIT control
			&PATH_CHANGE2=DIALOG.STRing(PATH_2)
		)
		POS 8. 3. 35.
		PATH_3:   EDIT "*.elf"
		(;get the user input when the cursor leaves the EDIT control
			&PATH_CHANGE3=DIALOG.STRing(PATH_3)
		)
		POS 8. 4. 35.
		PATH_4:   EDIT "*.elf"
		(;get the user input when the cursor leaves the EDIT control
			&PATH_CHANGE4=DIALOG.STRing(PATH_4)
		)
		
		POS 45. 1. 11.
		BUTTON "[:edit]PATH1_CHANGE "
		(
			
			DIALOG.SetFile PATH_1  &PATH_FOLDER1\*.elf
			DIALOG.SET PATH_CHECK.1
		)
		POS 45. 2. 11.
		BUTTON "[:edit]PATH2_CHANGE "
		(
			
			DIALOG.SetFile PATH_2  &PATH_FOLDER2\*.elf
			DIALOG.SET PATH_CHECK.2
		)
		POS 45. 3. 11.
		BUTTON "[:edit]PATH3_CHANGE "
		(
			
			DIALOG.SetFile PATH_3  &PATH_FOLDER3\*.elf
			DIALOG.SET PATH_CHECK.3
		)
		POS 45. 4. 11.
		BUTTON "[:edit]PATH4_CHANGE "
		(
			
			DIALOG.SetFile PATH_4  &PATH_FOLDER4\*.elf
			DIALOG.SET PATH_CHECK.4
		)
//-----------------------		SCRIPT_SELECT		-----------------------
		POS 1. 5. 15.
		LINE "WINDOW_SCRIPT_SELECT"
		POS 1. 6. 6.
		SCRIPT_CHECK.0: CHOOSEBOX "CURRENT" ""
		SCRIPT_CHECK.1: CHOOSEBOX "SCRIPT_1" ""
		SCRIPT_CHECK.2: CHOOSEBOX "SCRIPT_2" ""
		
		POS 8. 7. 35.
		SCRIPT_1:   EDIT "*.elf"
		(;get the user input when the cursor leaves the EDIT control
			&SCRIPT_CHANGE1=DIALOG.STRing(SCRIPT_1)
		)
		POS 8. 8. 35.
		SCRIPT_2:   EDIT "*.elf"
		(;get the user input when the cursor leaves the EDIT control
			&SCRIPT_CHANGE2=DIALOG.STRing(SCRIPT_2)
		)
		
		POS 45. 7. 11.
		BUTTON "[:edit]SCRIPT1_CHANGE "
		(
			
			DIALOG.SetFile SCRIPT_1  &SCRIPT_FOLDER1\*.cmm
			DIALOG.SET SCRIPT_CHECK.1
		)
		POS 45. 8. 11.
		BUTTON "[:edit]SCRIPT2_CHANGE "
		(
			
			DIALOG.SetFile SCRIPT_2  &SCRIPT_FOLDER2\*.cmm
			DIALOG.SET SCRIPT_CHECK.2
		)	
//-----------------------		CONNECTOR_SELECT		-----------------------
		;choosebox group for Connector 
		POS 1. 9. 15.
		LINE "CONNECTOR_SELECT"
		POS 1. 10. 10.
		Option_Connect.1: CHOOSEBOX "DAP2" ""
		Option_Connect.2: CHOOSEBOX "JTAG" ""
//-----------------------		CPU_SELECT		-----------------------
		POS 45. 9. 11.
		BUTTON "[:edit]CPU_CHANGE "
		(
			SYS.CPU *
		)
//-----------------------		OK_SELECT		-----------------------		
		POS 45. 10. 11.
		DEFBUTTON "OK" 
		(		
			//**********************		PATH_CREATION		**********************
			IF (STRING.FIND("elf","&PATH_CHANGE1")||STRING.FIND("elf","&PATH_CHANGE2")||STRING.FIND("elf","&PATH_CHANGE3")||STRING.FIND("elf","&PATH_CHANGE4"))
			(
				IF DIALOG.BOOLEAN(PATH_CHECK.1)
				(
					&PATH_SELECTED="&PATH_CHANGE1"
					OPEN #1 ~~\Button\Env\ELF_PATH.txt /CREATE
					WRITE #1 "&PATH_SELECTED"
					WRITE #1 "&PATH_CHANGE1"
					WRITE #1 "&PATH2"
					WRITE #1 "&PATH3"
					WRITE #1 "&PATH4"
					WRITE #1 "PATH_CHECK.1"
					CLOSE #1
				)
				ELSE IF DIALOG.BOOLEAN(PATH_CHECK.2)
				(
					&PATH_SELECTED="&PATH_CHANGE2"
					OPEN #1 ~~\Button\Env\ELF_PATH.txt /CREATE
					WRITE #1 "&PATH_SELECTED"
					WRITE #1 "&PATH1"
					WRITE #1 "&PATH_CHANGE2"
					WRITE #1 "&PATH3"
					WRITE #1 "&PATH4"
					WRITE #1 "PATH_CHECK.2"					
					CLOSE #1
				)
				ELSE IF DIALOG.BOOLEAN(PATH_CHECK.3)
				(
					&PATH_SELECTED="&PATH_CHANGE3"
					OPEN #1 ~~\Button\Env\ELF_PATH.txt /CREATE
					WRITE #1 "&PATH_SELECTED"				
					WRITE #1 "&PATH1"
					WRITE #1 "&PATH2"
					WRITE #1 "&PATH_CHANGE3"
					WRITE #1 "&PATH4"
					WRITE #1 "PATH_CHECK.3"
					CLOSE #1
				)
				ELSE IF DIALOG.BOOLEAN(PATH_CHECK.4)
				(
					&PATH_SELECTED="&PATH_CHANGE4"
					OPEN #1 ~~\Button\Env\ELF_PATH.txt /CREATE
					WRITE #1 "&PATH_SELECTED"
					WRITE #1 "&PATH1"
					WRITE #1 "&PATH2"
					WRITE #1 "&PATH3"
					WRITE #1 "&PATH_CHANGE4"
					WRITE #1 "PATH_CHECK.4"
					CLOSE #1
				)				
			)
			
			IF (STRING.FIND("cmm","&SCRIPT_CHANGE1")||STRING.FIND("cmm","&SCRIPT_CHANGE2"))
			(
				IF DIALOG.BOOLEAN(SCRIPT_CHECK.1)
				(
					&SCRIPT_SELECTED="&SCRIPT_CHANGE1"
					OPEN #1 ~~\Button\Env\SCRIPT_PATH.txt /CREATE
					WRITE #1 "&SCRIPT_SELECTED"
					WRITE #1 "&SCRIPT_CHANGE1"
					WRITE #1 "&SCRIPT2"
					CLOSE #1
				)
				ELSE IF DIALOG.BOOLEAN(SCRIPT_CHECK.2)
				(
					&SCRIPT_SELECTED="&SCRIPT_CHANGE2"
					OPEN #1 ~~\Button\Env\SCRIPT_PATH.txt /CREATE
					WRITE #1 "&SCRIPT_SELECTED"
					WRITE #1 "&SCRIPT1"
					WRITE #1 "&SCRIPT_CHANGE2"
					CLOSE #1
				)
			)
			IF DIALOG.BOOLEAN(Option_Connect.1)
			(
				&CONNECT_MODIFY="DAP2"
			)
			ELSE IF DIALOG.BOOLEAN(Option_Connect.2)
			(
				&CONNECT_MODIFY="JTAG"
			)
			IF (("&CPU_TYPE_MODIFY"!="&CPU_TYPE")||(!os.file(~~\Button\Env\CPU_TYPE.txt)))
			(		
				OPEN #1 ~~\Button\Env\CPU_TYPE.txt /CREATE
				WRITE #1 CPU()
				CLOSE #1
			)			
		
			IF ("&CONNECT_TYPE"!="&CONNECT_MODIFY")||(!os.file(~~\Button\Env\CONNECT_TYPE.txt))
			(
				OPEN  #1 ~~\Button\Env\CONNECT_TYPE.txt /CREATE
				WRITE  #1 "&CONNECT_MODIFY"
				CLOSE #1
			)
			GOSUB REPROGRAM_SUB
		)
//-----------------------		CLOSE_SELECT		-----------------------		
	  ;define action when window is closed
		CLOSE "GOTO CLOSE_END"
	)
//-----------------------		DEFAULT_ACTION		-----------------------			
	DIALOG.SetFile PATH_1  "&PATH1"
	DIALOG.SetFile PATH_2  "&PATH2"
	DIALOG.SetFile PATH_3  "&PATH3"
	DIALOG.SetFile PATH_4  "&PATH4"
	DIALOG.SetFile SCRIPT_1  "&SCRIPT1"
	DIALOG.SetFile SCRIPT_2  "&SCRIPT2"	
	DIALOG.SET &PATH_SELECTED_NUM
	DIALOG.SET SCRIPT_CHECK.0
	DIALOG.SET &CONNECT_TYPE_LAST
	STOP
//-----------------------		END_PROCESS1		---------------------------	
END_PROCESS1:
IF DIALOG.BOOLEAN(SCRIPT_CHECK.0)==FALSE()
(
	WINCLEAR
	DO &SCRIPT_SELECTED win
)
SYSTEM.DOWN

SYSTEM.O.DUALPORT.ON
SYSTEM.O.IMASKASM.ON
SYSTEM.O.IMASKHLL.ON
SETUP.VAR %SPOTLIGHT
//SYStem.Option PERSTOP OFF


GOSUB END_PROCESS2
ENDDO

//-----------------------		END_PROCESS2		---------------------------
END_PROCESS2:
DIALOG.END
SYSTEM.DOWN
IF "&CONNECT_MODIFY"=="DAP2"
(
	SYSTEM.CONFIG.DEBUGPORTTYPE DAP2
	SYSTEM.CONFIG.DAP.DAPEN.ON
	SYSTEM.JC 10MHZ
)
ELSE IF "&CONNECT_MODIFY"=="JTAG"
(
	SYSTEM.CONFIG.DEBUGPORTTYPE JTAG
)
IF "&CPU_TYPE_MID"!="TC23"
(
	IF &SINGLE_CORE_T==TRUE()
	(
		Core.assign  1.
	)
	ELSE IF &DOUBLE_CORE_T==TRUE()
	(
		
		Core.assign  1. 2.
		IF &MULTI_CORE_WINDOW_T==TRUE()
		(
			d.l /core 0
			d.l /core 1
		)
		
	)
	ELSE
	(
		Core.assign  1. 2. 3.
		IF &MULTI_CORE_WINDOW_T==TRUE()
		(
			d.l /core 0
			d.l /core 1
			d.l /core 2
		)
	)
)

IF "&MODE"=="COMPLEX"
(
	SYSTEM.O.DUALPORT.ON
	SYSTEM.O.IMASKASM.ON
	SYSTEM.O.IMASKHLL.ON
	SETUP.VAR %SPOTLIGHT
	//SYStem.Option PERSTOP OFF
)

IF &CORE_STATE_T==TRUE()
(
	IF WINDOW.NAME("B::TargetSystem.state DEFault")==FALSE()
	(
		TargetSystem.state DEFault
	)
	CORE.SHOWACTIVE
)
IF "&GTM_SELECT"=="GTM_YES"
(
	DO C:\T32\Button\GTM.cmm &MCS_CORE &MCS_CORE_CONFIG &MCS_CHANNEL_NUMBER &CPU_TYPE &CONNECT_TYPE
)
ELSE
(
	SYSTEM.UP
)
ENDDO
//-----------------------		CLOSE_END		---------------------------
CLOSE_END:
DIALOG.END
ENDDO


setup_intercom:
(
  &portTC0=FORMAT.DECIMAL(1.,INTERCOM.PORT())
  &portGTM=FORMAT.DECIMAL(1.,INTERCOM.PORT()+1.)
  &addressTC0="127.0.0.1:&portTC0"
  &addressGTM="127.0.0.1:&portGTM"
  RETURN
)
coreGTM:
(
  LOCAL &params
  ENTRY %Line &params
  INTERCOM.execute &addressGTM &params ; execute on remote GUI
  RETURN
)
coreTC0:
(
  LOCAL &params
  ENTRY %Line &params
  &params ; execute on this GUI
  RETURN
)

