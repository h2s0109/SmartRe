;Core
LOCAL &CORE_SELECTED_T
LOCAL &SINGLE_CORE_T
LOCAL &DOUBLE_CORE_T
LOCAL &TRIPLE_CORE_T
&CORE_SELECTED_T="SINGLE"
&SINGLE_CORE_T=FALSE()
&DOUBLE_CORE_T=FALSE()
&TRIPLE_CORE_T=FALSE()


;ETC Functionality
LOCAL &MULTI_CORE_WINDOW_T
LOCAL &CORE_STATE_T
LOCAL &MODE_T
LOCAL &RAMFLASH_T
LOCAL &PC_T
LOCAL &PCADDRESS_T
LOCAL &USEBOOT_T
LOCAL &Boot_PC_ADD_T
&MODE_T="COMPLEX"
&MULTI_CORE_WINDOW_T=FALSE()
&CORE_STATE_T=FALSE()
&RAMFLASH_T=FALSE()
&PC_T=FALSE()
&PCADDRESS_T=FALSE()
&USEBOOT_T=FALSE()
&Boot_PC_ADD_T="0XA0000020"
LOCAL &MCS_CORE
LOCAL &MCS_CHANNEL_NUMBER
LOCAL &MCS_CORE_CONFIG
LOCAL &GTM_SELECT_T
LOCAL &GTM_OCDS_SELECT_T
&MCS_CORE="MCS0"
&MCS_CHANNEL_NUMBER="5"
&MCS_CORE_CONFIG="CHANNEL_0"
&GTM_SELECT_T="GTM_NO"
&GTM_OCDS_SELECT_T="A2GGTMOCDS"
LOCAL &DefaultFolderName
&DefaultFolderName="C:"

//ETC
IF (!os.file(~~\Button\Env\ETC_PATH.txt))
(
	GOSUB ENVIRONMENT_WRITE_SUB
)
GOSUB ENVIRONMENT_READ_SUB
ENDDO &CORE_SELECTED_T &MULTI_CORE_WINDOW_T &CORE_STATE_T &RAMFLASH_T &MCS_CORE &MCS_CHANNEL_NUMBER &MCS_CORE_CONFIG &GTM_SELECT_T &PC_T &PCADDRESS_T &USEBOOT_T &MODE_T "&DefaultFolderName" &Boot_PC_ADD_T &GTM_OCDS_SELECT_T
//-----------------------		ENVIRONMENT_WRITE_SUB		-----------------------	
ENVIRONMENT_WRITE_SUB:
(
	MKDIR ~~\Button\Env
	MKDIR ~~\Button\Env\Elf_path
	OPEN #1 ~~\Button\Env\ETC_PATH.txt /CREATE
	WRITE #1 "&CORE_SELECTED_T"
	WRITE #1 "&MODE_T"
	WRITE #1 "&MCS_CORE"
	WRITE #1 "&MCS_CORE_CONFIG"
	WRITE #1 "&MCS_CHANNEL_NUMBER"
	WRITE #1 "&GTM_SELECT_T"
	WRITE #1 "&CORE_STATE_T"
	WRITE #1 "&RAMFLASH_T"
	WRITE #1 "&MULTI_CORE_WINDOW_T"
	WRITE #1 "&PC_T"
	WRITE #1 "&PCADDRESS_T"
	WRITE #1 "&USEBOOT_T"
	WRITE #1 "&DefaultFolderName"
	WRITE #1 "&Boot_PC_ADD_T"
	WRITE #1 "&GTM_OCDS_SELECT_T"
	CLOSE #1	
	RETURN
)
//-----------------------		ENVIRONMENT_READ_SUB		-----------------------	
ENVIRONMENT_READ_SUB:
(
	OPEN  #1 ~~\Button\Env\ETC_PATH.txt /READ
	READ  #1 %line &CORE_SELECTED_T
	READ  #1 %line &MODE_T
	READ  #1 %line &MCS_CORE
	READ  #1 %line &MCS_CORE_CONFIG
	READ  #1 %line &MCS_CHANNEL_NUMBER
	READ  #1 %line &GTM_SELECT_T
	READ  #1 %line &CORE_STATE_T
	READ  #1 %line &RAMFLASH_T
	READ  #1 %line &MULTI_CORE_WINDOW_T
	READ  #1 %line &PC_T
	READ  #1 %line &PCADDRESS_T
	READ  #1 %line &USEBOOT_T
	READ  #1 %line &DefaultFolderName
	READ  #1 %line &Boot_PC_ADD_T	
	READ  #1 %line &GTM_OCDS_SELECT_T	
	CLOSE #1
	RETURN
)