B::
LOCAL &CONNECT_TYPE_LAST_CHANGE &CPU_TYPE_TEMP_CHANGE &PATH_SELECTED_CHANGE1 &PATH_SELECTED_CHANGE2
LOCAL &CORE_SELECTED_CHANGE &MULTI_CORE_WINDOW_CHANGE &CORE_STATE_CHANGE &RAMFLASH_CHANGE
LOCAL &MCS_CORE_CHANGE &MCS_CHANNEL_NUMBER_CHANGE &MCS_CORE_CONFIG_CHANGE &GTM_SELECT_CHANGE &PC_CHANGE &PCADDRESS_CHANGE &USEBOOT_CHANGE &MODE_CHANGE &DefaultFolderName_CHANGE &APPLY_PATH_SELECTED

ENTRY &CONNECT_TYPE_LAST_CHANGE &CPU_TYPE_TEMP_CHANGE &PATH_SELECTED_CHANGE1 &PATH_SELECTED_CHANGE2 \
&CORE_SELECTED_CHANGE &MULTI_CORE_WINDOW_CHANGE &CORE_STATE_CHANGE &RAMFLASH_CHANGE &MCS_CORE_CHANGE \
&MCS_CHANNEL_NUMBER_CHANGE &MCS_CORE_CONFIG_CHANGE &GTM_SELECT_CHANGE &PC_CHANGE &PCADDRESS_CHANGE \
&USEBOOT_CHANGE &MODE_CHANGE &DefaultFolderName_CHANGE
//-----------------------		CHANGE_BUTTON		-----------------------	

	LOCAL &PATH1
	LOCAL &PATH2
	LOCAL &PATH3
	LOCAL &PATH4
	LOCAL &PATH_SELECTED_NUM_CHECK
	
	LOCAL &PATH_FOLDER1
	LOCAL &PATH_FOLDER2
	LOCAL &PATH_FOLDER3
	LOCAL &PATH_FOLDER4
	
	;Window save script
	LOCAL &SCRIPT1
	LOCAL &SCRIPT2
	LOCAL &SCRIPT_CHANGE1
	LOCAL &SCRIPT_CHANGE2
	LOCAL &SCRIPT_SELECTED_FOLDER
	LOCAL &SCRIPT_FOLDER1
	LOCAL &SCRIPT_FOLDER2
	
	LOCAL &CONNECT_CHANGE
	LOCAL &CPU_TYPE_MID_CHANGE
	LOCAL &CPU_TYPE_CHANGE
	LOCAL &ELF_PATH_CORE_CHANGE
	LOCAL &DEFAULT_PATH_CHECK_CHANGE
	
	IF (!os.file(~~\Button\Env\SCRIPT_PATH.txt))
	(
		OPEN  #1 ~~\Button\Env\SCRIPT_PATH.txt /CREATE
		WRITE #1 "C:"
		WRITE #1 "C:"
		WRITE #1 "C:"
		CLOSE #1
	)
		OPEN  #1 ~~\Button\Env\SCRIPT_PATH.txt /READ
		READ  #1 %line &SCRIPT_SELECTED
		READ  #1 %line &SCRIPT1
		READ  #1 %line &SCRIPT2
		CLOSE #1
		&SCRIPT_SELECTED_FOLDER=os.file.path("&SCRIPT_SELECTED")
		&SCRIPT_FOLDER1=os.file.path("&SCRIPT1")
		&SCRIPT_FOLDER2=os.file.path("&SCRIPT2")

	&CURRENT_PATH_USE=FALSE()
	DIALOG
	(
//-----------------------		PATH_SELECT		-----------------------	
		POS 1. 0. 11.
		LINE "PATH_SELECT"
		HEADER "SMART Reprogram V13.0-HanSungsu"
		POS 1. 1. 6.
		PATH_CHECK.1: CHOOSEBOX "PATH_1"
		(
			&PATH_SELECTED_NUM_CHECK="PATH_CHECK.1"			
			PRINT "&PATH_SELECTED_NUM_CHECK selected"
		)
		POS 1. 3. 6.
		PATH_CHECK.2: CHOOSEBOX "PATH_2"
		(
			&PATH_SELECTED_NUM_CHECK="PATH_CHECK.2"
			PRINT "&PATH_SELECTED_NUM_CHECK selected"
		)
	
		POS 8. 1. 35.
		PATH_1:   EDIT "*.elf"
		(;get the user input when the cursor leaves the EDIT control
			&PATH1=DIALOG.STRing(PATH_1)
		)
		POS 8. 2. 35.
		PATH_2:   EDIT "*.elf"
		(;get the user input when the cursor leaves the EDIT control
			&PATH2=DIALOG.STRing(PATH_2)
		)
		POS 8. 3. 35.
		PATH_3:   EDIT "*.elf"
		(;get the user input when the cursor leaves the EDIT control
			&PATH3=DIALOG.STRing(PATH_3)
		)
		POS 8. 4. 35.
		PATH_4:   EDIT "*.elf"
		(;get the user input when the cursor leaves the EDIT control
			&PATH4=DIALOG.STRing(PATH_4)
		)
		POS 45. 1. 11.
		BUTTON "[:edit]PATH1_CHANGE "
		(
			
			DIALOG.SetFile PATH_1  "&PATH_FOLDER1"\*.elf
			DIALOG.SET PATH_CHECK.1
		)
		POS 45. 2. 11.
		BUTTON "[:edit]PATH2_CHANGE "
		(
			
			DIALOG.SetFile PATH_2 "&PATH_FOLDER2"\*.elf
			DIALOG.SET PATH_CHECK.1
		)
		POS 45. 3. 11.
		BUTTON "[:edit]PATH3_CHANGE "
		(
			
			DIALOG.SetFile PATH_3  "&PATH_FOLDER3"\*.elf
			DIALOG.SET PATH_CHECK.2
		)
		POS 45. 4. 11.
		BUTTON "[:edit]PATH4_CHANGE "
		(
			
			DIALOG.SetFile PATH_4  "&PATH_FOLDER4"\*.elf
			DIALOG.SET PATH_CHECK.2
		)
		POS 45. 5. 11.
		DEFAULT_PATH_CHECK: CHECKBOX "DEFAULT_PATH"
		(			
			GOSUB PATH_HANDLE_DEFAULT_SUB &DEFAULT_PATH_CHECK_CHANGE &DefaultFolderName_CHANGE
			ENTRY &DEFAULT_PATH_CHECK_CHANGE		
		)
//-----------------------		SCRIPT_SELECT		-----------------------
		POS 1. 6. 15.
		LINE "WINDOW_SCRIPT_SELECT"
		POS 1. 7. 6.
		SCRIPT_CHECK.0: CHOOSEBOX "CURRENT" ""
		SCRIPT_CHECK.1: CHOOSEBOX "SCRIPT_1" ""
		SCRIPT_CHECK.2: CHOOSEBOX "SCRIPT_2" ""
		
		POS 8. 8. 35.
		SCRIPT_1:   EDIT "*.cmm"
		(;get the user input when the cursor leaves the EDIT control
			&SCRIPT_CHANGE1=DIALOG.STRing(SCRIPT_1)
		)
		POS 8. 9. 35.
		SCRIPT_2:   EDIT "*.cmm"
		(;get the user input when the cursor leaves the EDIT control
			&SCRIPT_CHANGE2=DIALOG.STRing(SCRIPT_2)
		)
		
		POS 45. 8. 11.
		BUTTON "[:edit]SCRIPT1_CHANGE "
		(
			
			DIALOG.SetFile SCRIPT_1  &SCRIPT_FOLDER1\*.cmm
			DIALOG.SET SCRIPT_CHECK.1
		)
		POS 45. 9. 11.
		BUTTON "[:edit]SCRIPT2_CHANGE "
		(
			
			DIALOG.SetFile SCRIPT_2  &SCRIPT_FOLDER2\*.cmm
			DIALOG.SET SCRIPT_CHECK.2
		)	
//-----------------------		CONNECTOR_SELECT		-----------------------
		;choosebox group for Connector 
		POS 1. 10. 15.
		LINE "CONNECTOR_SELECT"
		POS 1. 11. 10.
		Option_Connect.1: CHOOSEBOX "DAP2" ""
		Option_Connect.2: CHOOSEBOX "JTAG" ""
//-----------------------		FAVORITE_SAVE		-----------------------		
		POS 45. 14. 11.
		BUTTON "[:edit]SAVE "
		(
			IF DIALOG.STRing(SAVED_CONFIG)=="SET_1"			
			(
				GOSUB FAVORITE_SAVE_LOAD_SUB "SET_1" "SAVE" "APPLY" &USEBOOT_CHANGE
				GOSUB FAVORITE_DYNA_HANDLE_SUB "SET_1" "LOAD" "CHANGE" &USEBOOT_CHANGE

			)
			IF DIALOG.STRing(SAVED_CONFIG)=="SET_2"
			(
				GOSUB FAVORITE_SAVE_LOAD_SUB "SET_2" "SAVE" "APPLY" &USEBOOT_CHANGE
				GOSUB FAVORITE_DYNA_HANDLE_SUB "SET_2" "LOAD" "CHANGE" &USEBOOT_CHANGE
			)
		)
		POS 8. 13. 35. 7.
		BOX "FAVORITE_SAVE"
		POS 9. 15. 33. 1.
		Dyna_Favorite: DYNTEXT ""
		POS 9. 16. 33. 1.
		Dyna_Favorite2: DYNTEXT ""
		POS 9. 17. 33. 1.
		Dyna_Favorite3: DYNTEXT ""
		POS 9. 18. 33. 1.
		Dyna_Favorite4: DYNTEXT ""
		
		POS 9. 14. 33. 1.
		SAVED_CONFIG: PULLDOWN "SET_1,SET_2"
		(
			IF DIALOG.STRing(SAVED_CONFIG)=="SET_1"			
			(
				GOSUB FAVORITE_DYNA_HANDLE_SUB "SET_1" "LOAD" "CHANGE" &USEBOOT_CHANGE
			)
			IF DIALOG.STRing(SAVED_CONFIG)=="SET_2"
			(
				GOSUB FAVORITE_DYNA_HANDLE_SUB "SET_2" "LOAD" "CHANGE" &USEBOOT_CHANGE
			)
		)
		
//-----------------------		CPU_SELECT		-----------------------
		POS 45. 10. 11.
		BUTTON "[:edit]CPU_CHANGE "
		(
			GOSUB CPU_MATCH_CHECK_SUB &CPU_TYPE_TEMP_CHANGE
			&CPU_TYPE_MODIFY=CPU()
		)		
//-----------------------		OK_SELECT		-----------------------		
		POS 45. 12. 11.
		DEFBUTTON "OK" 
		(	
			LOCAL &EXIST
			&EXIST=FALSE()
			SYSTEM.DOWN
			//**********************		PATH_CREATION		**********************
			IF DIALOG.BOOLEAN(PATH_CHECK.1)==TRUE()
			(
				IF STRING.FIND("elf","&PATH1")==TRUE()&&FILE.EXIST(&PATH1)&&STRING.FIND("elf","&PATH2")==TRUE()&&FILE.EXIST(&PATH2)
				(
					&PATH_SELECTED_CHANGE1="&PATH1"
					&PATH_SELECTED_CHANGE2="&PATH2"
					GOSUB PATH_FILE_SAVE_SUB &ELF_PATH_CORE_CHANGE &DEFAULT_PATH_CHECK_CHANGE
					GOSUB PREVIOUS_INFORMATION_SAVE_SUB
					ENTRY &CONNECT_CHANGE
					&EXIST=TRUE()
				)
				ELSE
				(
					&EXIST=FALSE()
				)

			)
			ELSE IF DIALOG.BOOLEAN(PATH_CHECK.2)==TRUE()
			(
				IF STRING.FIND("elf","&PATH3")==TRUE()&&FILE.EXIST(&PATH3)&&STRING.FIND("elf","&PATH4")==TRUE()&&FILE.EXIST(&PATH4)
				(
					
					GOSUB PATH_FILE_SAVE_SUB &ELF_PATH_CORE_CHANGE &DEFAULT_PATH_CHECK_CHANGE
					GOSUB PREVIOUS_INFORMATION_SAVE_SUB
					ENTRY &CONNECT_CHANGE
					&EXIST=TRUE()
				)
				ELSE
				(
					&EXIST=FALSE()
				)

			)
			ELSE
			(
				&EXIST=FALSE()
			)
			//**********************		SCRIPT_PATH_CREATION		**********************
			IF (STRING.FIND("cmm","&SCRIPT_CHANGE1")||STRING.FIND("cmm","&SCRIPT_CHANGE2"))
			(
				IF DIALOG.BOOLEAN(SCRIPT_CHECK.1)
				(
					&SCRIPT_SELECTED="&SCRIPT_CHANGE1"
					OPEN #1 ~~\Button\Env\SCRIPT_PATH.txt /CREATE
					WRITE #1 "&SCRIPT_SELECTED"
					WRITE #1 "&SCRIPT_CHANGE1"
					WRITE #1 "&SCRIPT2"
					CLOSE #1
				)
				ELSE IF DIALOG.BOOLEAN(SCRIPT_CHECK.2)
				(
					&SCRIPT_SELECTED="&SCRIPT_CHANGE2"
					OPEN #1 ~~\Button\Env\SCRIPT_PATH.txt /CREATE
					WRITE #1 "&SCRIPT_SELECTED"
					WRITE #1 "&SCRIPT1"
					WRITE #1 "&SCRIPT_CHANGE2"
					CLOSE #1
				)
			)
			ELSE
			(
				IF DIALOG.BOOLEAN(SCRIPT_CHECK.1)
				(
					&SCRIPT_SELECTED="&SCRIPT1"
				)
				ELSE IF DIALOG.BOOLEAN(SCRIPT_CHECK.2)
				(
					&SCRIPT_SELECTED="&SCRIPT2"
				)
			)
			IF &EXIST==TRUE()
			(
				OPEN #1 ~~\Button\Env\PREVIOUS_TYPE_BOOT.txt /CREATE
				WRITE #1 CPU()
				WRITE #1 "&CONNECT_CHANGE"
				WRITE #1 "&PATH_SELECTED_CHANGE1"
				WRITE #1 "&PATH_SELECTED_CHANGE2"
				CLOSE #1
				GOSUB REPROGRAM_SUB &CONNECT_CHANGE &PATH_SELECTED_CHANGE1 &PATH_SELECTED_CHANGE2 &GTM_SELECT_CHANGE &USEBOOT_CHANGE
				
				ENTRY &CPU_TYPE_MID_CHANGE &CPU_TYPE_CHANGE
				GOSUB END_PROCESS1_SUB &RAMFLASH_CHANGE &SCRIPT_SELECTED
				GOSUB END_PROCESS2_SUB &CONNECT_CHANGE &CPU_TYPE_MID_CHANGE &CORE_SELECTED_CHANGE &MULTI_CORE_WINDOW_CHANGE &MODE_CHANGE &CORE_STATE_CHANGE &GTM_SELECT_CHANGE &MCS_CORE_CHANGE &MCS_CORE_CONFIG_CHANGE &MCS_CHANNEL_NUMBER_CHANGE &CPU_TYPE_CHANGE &RAMFLASH_CHANGE
			)
			ELSE
			(
				DIALOG.MESSAGE "There is no path."
			)
		)
//-----------------------		CLOSE_SELECT		-----------------------		
	  ;define action when window is closed
		CLOSE "GOTO CLOSE_END_SUB"
	)
//-----------------------		DEFAULT_ACTION		-----------------------			
	DIALOG.SET SCRIPT_1  "&SCRIPT1"
	DIALOG.SET SCRIPT_2  "&SCRIPT2"	
	DIALOG.SET SCRIPT_CHECK.0
	DIALOG.SET &CONNECT_TYPE_LAST_CHANGE			
	GOSUB PATH_HANDLE_SUB &CPU_TYPE_TEMP_CHANGE &DefaultFolderName_CHANGE
	ENTRY &ELF_PATH_CORE_CHANGE &DEFAULT_PATH_CHECK_CHANGE
	IF &DEFAULT_PATH_CHECK_CHANGE==TRUE()
	(
		DIALOG.SET DEFAULT_PATH_CHECK
	)
	GOSUB FAVORITE_DYNA_HANDLE_SUB "SET_1" "LOAD" "CHANGE" &USEBOOT_CHANGE
	
	STOP

ENDDO
//-----------------------	END OF CHANGE_BUTTON -----------------------	

//-----------------------		CPU_MATCH_CHECK_SUB		-----------------------	
CPU_MATCH_CHECK_SUB:
(
	LOCAL &CPU_TYPE_MATCH_CHECK
	ENTRY &CPU_TYPE_MATCH_CHECK
	LOCAL &CPU_SELECTION_RIGHT &CPU_TYPE_MID_TEMP &CPU_TYPE_MATCH_CHECK_STAR

	&CPU_SELECTION_RIGHT=FALSE()
	WHILE &CPU_SELECTION_RIGHT==FALSE()
	(
		
		&CPU_TYPE_MATCH_CHECK_COMPARE=STRING.MID("&CPU_TYPE_MATCH_CHECK",0.,4.)
		&CPU_TYPE_MATCH_CHECK_STAR=STRING.MID("&CPU_TYPE_MATCH_CHECK",0.,4.)+"*"
		SYS.CPU &CPU_TYPE_MATCH_CHECK_STAR
		&CPU_TYPE_MID_TEMP=STRING.MID(CPU(),0.,4.)
		IF "&CPU_TYPE_MATCH_CHECK_COMPARE"!="&CPU_TYPE_MID_TEMP"
		(
			SYS.CPU &CPU_TYPE_MATCH_CHECK_STAR
		)
		ELSE IF "&CPU_TYPE_MATCH_CHECK_COMPARE"=="&CPU_TYPE_MID_TEMP"
		(
			&CPU_SELECTION_RIGHT=TRUE()
		)
		ELSE
		(
			&CPU_SELECTION_RIGHT=FALSE()
		)		

	)
	
	RETURN
)
//-----------------------		END OF CPU_MATCH_CHECK_SUB		-----------------------
//-----------------------	REPROGRAM_SUB		------------------------
REPROGRAM_SUB:
(	
	LOCAL &CPU_TYPE_REPROGRAM &CPU_TYPE_MID_REPROGRAM
	LOCAL &CONNECT_REPROGRAM &PATH_SELECTED_REPROGRAM &PATH_SELECTED_BOOT_REPROGRAM &GTM_SELECT_REPROGRAM &USEBOOT_REPROGRAM
	ENTRY &CONNECT_REPROGRAM &PATH_SELECTED_REPROGRAM &PATH_SELECTED_BOOT_REPROGRAM &GTM_SELECT_REPROGRAM &USEBOOT_REPROGRAM
	IF "&GTM_SELECT_REPROGRAM"=="GTM_YES"
	(	
	//SYStem.Option PERSTOP OFF
		ON CMD COREGTM GOSUB coreGTM
		GOSUB setup_intercom
		COREGTM SYSTEM.DOWN
	)
	IF "&CONNECT_REPROGRAM"=="DAP2"
	(
		SYSTEM.CONFIG.DEBUGPORTTYPE DAP2
		SYSTEM.CONFIG.DAP.DAPEN.ON
		SYSTEM.JC 10MHZ
	)
	ELSE IF "&CONNECT_REPROGRAM"=="JTAG"
	(
		SYSTEM.CONFIG.DEBUGPORTTYPE JTAG
	)
	&CPU_TYPE_REPROGRAM=CPU()
	&CPU_TYPE_MID_REPROGRAM=STRING.MID("&CPU_TYPE_REPROGRAM",0.,4.)
	IF "&CPU_TYPE_MID_REPROGRAM"=="TC27"
	(
		DO ~~\Button\flash\tc27x_Auto.cmm "&PATH_SELECTED_REPROGRAM" "&PATH_SELECTED_BOOT_REPROGRAM" &USEBOOT_REPROGRAM
	)
	ELSE IF "&CPU_TYPE_MID_REPROGRAM"=="TC21"
	(
		DO ~~\Button\flash\tc21x_Auto.cmm "&PATH_SELECTED_REPROGRAM" "&PATH_SELECTED_BOOT_REPROGRAM" &USEBOOT_REPROGRAM
	)
	ELSE IF "&CPU_TYPE_MID_REPROGRAM"=="TC23"
	(
		DO ~~\Button\flash\tc23x_Auto.cmm "&PATH_SELECTED_REPROGRAM" "&PATH_SELECTED_BOOT_REPROGRAM" &USEBOOT_REPROGRAM
	)
	ELSE IF "&CPU_TYPE_MID_REPROGRAM"=="TC22"
	(
		DO ~~\Button\flash\tc22x_Auto.cmm "&PATH_SELECTED_REPROGRAM" "&PATH_SELECTED_BOOT_REPROGRAM" &USEBOOT_REPROGRAM
	)
	ELSE IF "&CPU_TYPE_MID_REPROGRAM"=="TC26"
	(
		DO ~~\Button\flash\tc26x_Auto.cmm "&PATH_SELECTED_REPROGRAM" "&PATH_SELECTED_BOOT_REPROGRAM" &USEBOOT_REPROGRAM
	)
	ELSE IF "&CPU_TYPE_MID_REPROGRAM"=="TC29"
	(
		DO ~~\Button\flash\tc29x_Auto.cmm "&PATH_SELECTED_REPROGRAM" "&PATH_SELECTED_BOOT_REPROGRAM" &USEBOOT_REPROGRAM
	)
	ELSE IF "&CPU_TYPE_MID_REPROGRAM"=="TC38"
	(
		DO ~~\Button\flash\tc38x_Auto.cmm "&PATH_SELECTED_REPROGRAM" "&PATH_SELECTED_BOOT_REPROGRAM" &USEBOOT_REPROGRAM
	)	
	ELSE IF "&CPU_TYPE_MID_REPROGRAM"=="TC39"
	(
		DO ~~\Button\flash\tc39x_Auto.cmm "&PATH_SELECTED_REPROGRAM" "&PATH_SELECTED_BOOT_REPROGRAM" &USEBOOT_REPROGRAM
	)
	PRINT "&PATH_SELECTED_REPROGRAM flash complete./&CPU_TYPE_REPROGRAM"
	RETURN  &CPU_TYPE_MID_REPROGRAM &CPU_TYPE_REPROGRAM
)
ENDDO
//-----------------------	END OF REPROGRAM_SUB		------------------------

//-----------------------	REPROGRAM_BOOT_SUB		------------------------
REPROGRAM_BOOT_SUB:
(	
	LOCAL &CPU_TYPE_REPROGRAM &CPU_TYPE_MID_REPROGRAM
	LOCAL &CONNECT_REPROGRAM &PATH_SELECTED_REPROGRAM &PATH_SELECTED_BOOT_REPROGRAM &GTM_SELECT_REPROGRAM &USEBOOT_REPROGRAM
	ENTRY &CONNECT_REPROGRAM &PATH_SELECTED_REPROGRAM &PATH_SELECTED_BOOT_REPROGRAM &GTM_SELECT_REPROGRAM &USEBOOT_REPROGRAM
	IF "&GTM_SELECT_REPROGRAM"=="GTM_YES"
	(	
	//SYStem.Option PERSTOP OFF
		ON CMD COREGTM GOSUB coreGTM
		GOSUB setup_intercom
		COREGTM SYSTEM.DOWN
	)
	IF "&CONNECT_REPROGRAM"=="DAP2"
	(
		SYSTEM.CONFIG.DEBUGPORTTYPE DAP2
		SYSTEM.CONFIG.DAP.DAPEN.ON
		SYSTEM.JC 10MHZ
	)
	ELSE IF "&CONNECT_REPROGRAM"=="JTAG"
	(
		SYSTEM.CONFIG.DEBUGPORTTYPE JTAG
	)
	&CPU_TYPE_REPROGRAM=CPU()
	&CPU_TYPE_MID_REPROGRAM=STRING.MID("&CPU_TYPE_REPROGRAM",0.,4.)
	IF "&CPU_TYPE_MID_REPROGRAM"=="TC27"
	(
		DO ~~\Button\flash\tc27x_Auto.cmm "&PATH_SELECTED_REPROGRAM" ;"&PATH_SELECTED_BOOT_REPROGRAM"PLACE HOLDER
	)
	ELSE IF "&CPU_TYPE_MID_REPROGRAM"=="TC21"
	(
		DO ~~\Button\flash\tc21x_Auto.cmm "&PATH_SELECTED_REPROGRAM" ;"&PATH_SELECTED_BOOT_REPROGRAM"PLACE HOLDER
	)
	ELSE IF "&CPU_TYPE_MID_REPROGRAM"=="TC23"
	(
		DO ~~\Button\flash\tc23x_Auto.cmm "&PATH_SELECTED_REPROGRAM" ;"&PATH_SELECTED_BOOT_REPROGRAM"PLACE HOLDER
	)
	ELSE IF "&CPU_TYPE_MID_REPROGRAM"=="TC22"
	(
		DO ~~\Button\flash\tc22x_Auto.cmm "&PATH_SELECTED_REPROGRAM" ;"&PATH_SELECTED_BOOT_REPROGRAM"PLACE HOLDER
	)
	ELSE IF "&CPU_TYPE_MID_REPROGRAM"=="TC26"
	(
		DO ~~\Button\flash\tc26x_Auto.cmm "&PATH_SELECTED_REPROGRAM" ;"&PATH_SELECTED_BOOT_REPROGRAM"PLACE HOLDER
	)
	ELSE IF "&CPU_TYPE_MID_REPROGRAM"=="TC29"
	(
		DO ~~\Button\flash\tc29x_Auto.cmm "&PATH_SELECTED_REPROGRAM" ;"&PATH_SELECTED_BOOT_REPROGRAM"PLACE HOLDER
	)
	ELSE IF "&CPU_TYPE_MID_REPROGRAM"=="TC38"
	(
		DO ~~\Button\flash\tc38x_Auto.cmm "&PATH_SELECTED_REPROGRAM" "&PATH_SELECTED_BOOT_REPROGRAM" &USEBOOT_REPROGRAM
	)		
	ELSE IF "&CPU_TYPE_MID_REPROGRAM"=="TC39"
	(
		DO ~~\Button\flash\tc39x_Auto.cmm "&PATH_SELECTED_REPROGRAM" ;"&PATH_SELECTED_BOOT_REPROGRAM"PLACE HOLDER
	)
	PRINT "&PATH_SELECTED_REPROGRAM  &PATH_SELECTED_BOOT_REPROGRAM flash complete./&CPU_TYPE_REPROGRAM"
	RETURN  &CPU_TYPE_MID_REPROGRAM &CPU_TYPE_REPROGRAM
)
ENDDO
//-----------------------	END OF REPROGRAM_BOOT_SUB		------------------------

//-----------------------		END_PROCESS1_SUB		---------------------------	
END_PROCESS1_SUB:
(
	LOCAL &RAMFLASH_PROCESS1 &SCRIPT_SELECTED_PROCESS1
	ENTRY &RAMFLASH_PROCESS1 &SCRIPT_SELECTED_PROCESS1
	IF DIALOG.BOOLEAN(SCRIPT_CHECK.0)==FALSE()
	(
		WINCLEAR
		DO &SCRIPT_SELECTED_PROCESS1 win
	)
	
	IF &RAMFLASH_PROCESS1==TRUE()
	(
		;SYSTEM.UP
	)
	ELSE
	(
		SYSTEM.DOWN
	)
	
	SYSTEM.O.DUALPORT.ON
	SYSTEM.CA.E
	SYSTEM.O.IMASKASM.OFF
	SYSTEM.O.IMASKHLL.OFF
	SETUP.VAR %SPOTLIGHT
	//SYStem.Option PERSTOP OFF
	RETURN
)
//-----------------------		END OF END_PROCESS1_SUB		----------------

//-----------------------		END_PROCESS2_SUB		---------------------------
END_PROCESS2_SUB:
(
	LOCAL &GENERATION
	LOCAL &CONNECT_PROCESS2 &CPU_TYPE_MID_PROCESS2 &CORE_SELECTED_PROCESS2 &MULTI_CORE_WINDOW_PROCESS2 &MODE_PROCESS2 &CORE_STATE_PROCESS2 &GTM_SELECT_PROCESS2 &MCS_CORE_PROCESS2 &MCS_CORE_CONFIG_PROCESS2 &MCS_CHANNEL_NUMBER_PROCESS2 &CPU_TYPE_PROCESS2 &RAMFLASH_PROCESS2
	ENTRY &CONNECT_PROCESS2 &CPU_TYPE_MID_PROCESS2 &CORE_SELECTED_PROCESS2 &MULTI_CORE_WINDOW_PROCESS2 &MODE_PROCESS2 &CORE_STATE_PROCESS2 &GTM_SELECT_PROCESS2 &MCS_CORE_PROCESS2 &MCS_CORE_CONFIG_PROCESS2 &MCS_CHANNEL_NUMBER_PROCESS2 &CPU_TYPE_PROCESS2 &RAMFLASH_PROCESS2
	IF &RAMFLASH_PROCESS2==TRUE()
	(
		;SYSTEM.UP
	)
	ELSE
	(
		SYSTEM.DOWN
	)
	IF "&CONNECT_PROCESS2"=="DAP2"
	(
		SYSTEM.CONFIG.DEBUGPORTTYPE DAP2
		SYSTEM.CONFIG.DAP.DAPEN.ON
		SYSTEM.JC 20MHZ
	)
	ELSE IF "&CONNECT_PROCESS2"=="JTAG"
	(
		SYSTEM.CONFIG.DEBUGPORTTYPE JTAG
	)
	&GENERATION = STRING.MID("&CPU_TYPE_MID_PROCESS2",0.,3.)
	IF ("&GENERATION"=="TC2")
	(
		IF ("&CPU_TYPE_MID_PROCESS2"!="TC21"&&"&CPU_TYPE_MID_PROCESS2"!="TC22"&&"&CPU_TYPE_MID_PROCESS2"!="TC23"&&"&CPU_TYPE_MID_PROCESS2"!="TC26")
		(
			IF "&CORE_SELECTED_PROCESS2"=="SINGLE"
			(
				Core.assign  1.
			)
			ELSE IF "&CORE_SELECTED_PROCESS2"=="DOUBLE"
			(
				
				Core.assign  1. 2.
				IF &MULTI_CORE_WINDOW_PROCESS2==TRUE()
				(
					d.l /core 0
					d.l /core 1
				)
				
			)
			ELSE
			(
				Core.assign  1. 2. 3.
				IF &MULTI_CORE_WINDOW_PROCESS2==TRUE()
				(
					d.l /core 0
					d.l /core 1
					d.l /core 2
				)
			)
		)
		ELSE IF ("&CPU_TYPE_MID_PROCESS2"=="TC26")
		(
			IF "&CORE_SELECTED_PROCESS2"=="SINGLE"
			(
				Core.assign  1.
			)
			ELSE IF "&CORE_SELECTED_PROCESS2"=="DOUBLE"
			(
				
				Core.assign  1. 2.
				IF &MULTI_CORE_WINDOW_PROCESS2==TRUE()
				(
					d.l /core 0
					d.l /core 1
				)
			)
		)
	)
	ELSE IF ("&GENERATION"=="TC3")
	(
		IF ("&CPU_TYPE_MID_PROCESS2"=="TC38")
		(
			IF "&CORE_SELECTED_PROCESS2"=="SINGLE"
			(
				Core.assign  1.
			)
			ELSE IF "&CORE_SELECTED_PROCESS2"=="DOUBLE"
			(
				
				Core.assign  1. 2.
				IF &MULTI_CORE_WINDOW_PROCESS2==TRUE()
				(
					d.l /core 0
					d.l /core 1
				)
				
			)
			ELSE IF "&CORE_SELECTED_PROCESS2"=="TRIPLE"
			(
				Core.assign  1. 2. 3.
				IF &MULTI_CORE_WINDOW_PROCESS2==TRUE()
				(
					d.l /core 0
					d.l /core 1
					d.l /core 2
				)
			)
			ELSE IF "&CORE_SELECTED_PROCESS2"=="QUAD"
			(
				Core.assign  1. 2. 3. 4.
				IF &MULTI_CORE_WINDOW_PROCESS2==TRUE()
				(
					d.l /core 0
					d.l /core 1
					d.l /core 2
					d.l /core 3
				)
			)
		)
		ELSE IF ("&CPU_TYPE_MID_PROCESS2"=="TC39")
		(
			IF "&CORE_SELECTED_PROCESS2"=="SINGLE"
			(
				Core.assign  1.
			)
			ELSE IF "&CORE_SELECTED_PROCESS2"=="DOUBLE"
			(
				
				Core.assign  1. 2.
				IF &MULTI_CORE_WINDOW_PROCESS2==TRUE()
				(
					d.l /core 0
					d.l /core 1
				)
				
			)
			ELSE IF "&CORE_SELECTED_PROCESS2"=="TRIPLE"
			(
				Core.assign  1. 2. 3.
				IF &MULTI_CORE_WINDOW_PROCESS2==TRUE()
				(
					d.l /core 0
					d.l /core 1
					d.l /core 2
				)
			)
			ELSE IF "&CORE_SELECTED_PROCESS2"=="QUAD"
			(
				Core.assign  1. 2. 3. 4.
				IF &MULTI_CORE_WINDOW_PROCESS2==TRUE()
				(
					d.l /core 0
					d.l /core 1
					d.l /core 2
					d.l /core 3
				)
			)
			ELSE IF "&CORE_SELECTED_PROCESS2"=="PENTA"
			(
				Core.assign  1. 2. 3. 4. 5.
				IF &MULTI_CORE_WINDOW_PROCESS2==TRUE()
				(
					d.l /core 0
					d.l /core 1
					d.l /core 2
					d.l /core 3
					d.l /core 4
				)
			)
			ELSE IF "&CORE_SELECTED_PROCESS2"=="HEXA"
			(
				Core.assign  1. 2. 3. 4. 5. 6.
				IF &MULTI_CORE_WINDOW_PROCESS2==TRUE()
				(
					d.l /core 0
					d.l /core 1
					d.l /core 2
					d.l /core 3
					d.l /core 4
					d.l /core 5
				)
			)
		)


	)

	IF "&MODE_T"=="COMPLEX"
	(
		SYSTEM.O.DUALPORT.ON
		SYSTEM.CA.E
		SYSTEM.O.IMASKASM.OFF
		SYSTEM.O.IMASKHLL.OFF
		SETUP.VAR %SPOTLIGHT
		//SYStem.Option PERSTOP OFF
	)
	ELSE
	(
		;"&MODE_T"=="SIMPLE" NOTHING
	)

	IF &CORE_STATE_PROCESS2==TRUE()
	(
		IF WINDOW.NAME("B::TargetSystem.state DEFault")==FALSE()
		(
			TargetSystem.state DEFault
		)
		CORE.SHOWACTIVE
	)
	IF "&GTM_SELECT_PROCESS2"=="GTM_YES"
	(
		;SYSTEM.UP Will be handle in GTM.cmm
		DO ~~\Button\GTM.cmm &MCS_CORE_PROCESS2 &MCS_CORE_CONFIG_PROCESS2 &MCS_CHANNEL_NUMBER_PROCESS2 &CPU_TYPE_PROCESS2 &CONNECT_PROCESS2
	)
	ELSE
	(
		IF &RAMFLASH_PROCESS2==TRUE()
		(
			;Nothing to do
			;SYSTEM.UP
		)
		ELSE
		(
			SYSTEM.UP
		)
	)
	GOSUB CLOSE_END_SUB
)
ENDDO
//-----------------------		END OF END_PROCESS2_SUB		---------------------------

//-----------------------		CLOSE_END_SUB		-----------------------------------
CLOSE_END_SUB:
	DIALOG.END
ENDDO
//-----------------------		END OF CLOSE_END_SUB		---------------------------

//-----------------------		FAVORITE_SAVE_LOAD_SUB		---------------------------
FAVORITE_SAVE_LOAD_SUB:
(	
	LOCAL &CPU_TYPE_FAVORITE
	LOCAL &CONNECT_TYPE_FAVORITE
	LOCAL &PATH_SELECTED_NUM_FAVORITE &PATH_SELECTED_FAVORITE &PATH_SELECTED_BOOT_FAVORITE
	LOCAL &SET_VALUE_SAVE_LOAD &SAVE_LOAD_FAVORITE &APPLY_CHECK_SAVE_LOAD &USEBOOT_SAVE_LOAD
	ENTRY &SET_VALUE_SAVE_LOAD &SAVE_LOAD_FAVORITE &APPLY_CHECK_SAVE_LOAD &USEBOOT_SAVE_LOAD
	;TO DO: &Path value should be changed from global to local
	&CPU_TYPE_FAVORITE=CPU() 
	IF &SAVE_LOAD_FAVORITE=="SAVE"
	(		
		IF &USEBOOT_SAVE_LOAD==FALSE()
		(
			IF DIALOG.BOOLEAN(PATH_CHECK.1)
			(
				&PATH_SELECTED_NUM_FAVORITE="PATH_CHECK.1"
				&PATH_SELECTED_FAVORITE="&PATH1"
			)
			ELSE IF DIALOG.BOOLEAN(PATH_CHECK.2)
			(
				&PATH_SELECTED_NUM_FAVORITE="PATH_CHECK.2"
				&PATH_SELECTED_FAVORITE="&PATH2"
			)
			ELSE IF DIALOG.BOOLEAN(PATH_CHECK.3)
			(
				&PATH_SELECTED_NUM_FAVORITE="PATH_CHECK.3"
				&PATH_SELECTED_FAVORITE="&PATH3"
			)
			ELSE IF DIALOG.BOOLEAN(PATH_CHECK.4)
			(
				&PATH_SELECTED_NUM_FAVORITE="PATH_CHECK.4"
				&PATH_SELECTED_FAVORITE="&PATH4"
			)
			IF DIALOG.BOOLEAN(Option_Connect.1)
			(
				&CONNECT_TYPE_FAVORITE="DAP2"
			)
			ELSE IF DIALOG.BOOLEAN(Option_Connect.2)
			(
				&CONNECT_TYPE_FAVORITE="JTAG"
			)
			&PATH_SELECTED_BOOT_FAVORITE="NONE"			
			DO ~~\Button\Favorit.cmm &SET_VALUE_SAVE_LOAD &SAVE_LOAD_FAVORITE &APPLY_CHECK_SAVE_LOAD \
			&USEBOOT_SAVE_LOAD &CPU_TYPE_FAVORITE &CONNECT_TYPE_FAVORITE &PATH_SELECTED_FAVORITE &PATH_SELECTED_BOOT_FAVORITE \
			&PATH_SELECTED_NUM_FAVORITE 
		)
		ELSE
		(
			IF DIALOG.BOOLEAN(PATH_CHECK.1)
			(
				&PATH_SELECTED_NUM_FAVORITE="PATH_CHECK.1"
				&PATH_SELECTED_FAVORITE="&PATH1"
				&PATH_SELECTED_BOOT_FAVORITE="&PATH2"
			)
			ELSE IF DIALOG.BOOLEAN(PATH_CHECK.2)
			(
				&PATH_SELECTED_NUM_FAVORITE="PATH_CHECK.2"
				&PATH_SELECTED_FAVORITE="&PATH3"
				&PATH_SELECTED_BOOT_FAVORITE="&PATH4"
			)


		IF DIALOG.BOOLEAN(Option_Connect.1)
		(
			&CONNECT_TYPE_FAVORITE="DAP2"
		)
		ELSE IF DIALOG.BOOLEAN(Option_Connect.2)
		(
			&CONNECT_TYPE_FAVORITE="JTAG"
		)			
		DO ~~\Button\Favorit.cmm &SET_VALUE_SAVE_LOAD &SAVE_LOAD_FAVORITE &APPLY_CHECK_SAVE_LOAD \
		&USEBOOT_SAVE_LOAD &CPU_TYPE_FAVORITE &CONNECT_TYPE_FAVORITE &PATH_SELECTED_FAVORITE &PATH_SELECTED_BOOT_FAVORITE \
		&PATH_SELECTED_NUM_FAVORITE 
		)
		
		RETURN
	)
	; COMING FROM FAVORITE_DYNA_HANDLE_SUB
	IF &SAVE_LOAD_FAVORITE=="LOAD"
	(
		DO ~~\Button\Favorit.cmm &SET_VALUE_SAVE_LOAD &SAVE_LOAD_FAVORITE &APPLY_CHECK_SAVE_LOAD \
		&USEBOOT_SAVE_LOAD 

		IF &APPLY_CHECK_SAVE_LOAD=="APPLY"
		(
			ENTRY &FAVORITE_USE &FAVORITE_VERI_CHECK_PULLDOWN &CPU_TYPE_FAVORITE \
			&CONNECT_TYPE_FAVORITE &PATH_SELECTED_FAVORITE &PATH_SELECTED_BOOT_FAVORITE &PATH_SELECTED_NUM_FAVORITE
			
			IF &FAVORITE_USE==TRUE()
			(	
				PRINT "Favorite LOAD&APPLY success"
				RETURN &CPU_TYPE_FAVORITE &CONNECT_TYPE_FAVORITE &PATH_SELECTED_FAVORITE &PATH_SELECTED_BOOT_FAVORITE
			)
			ELSE
			(
				;PRINT "Varification fail APPLY"
				RETURN
			)			
		)
		ELSE IF &APPLY_CHECK_SAVE_LOAD=="PULLDOWN"
		(
			ENTRY &FAVORITE_USE &FAVORITE_VERI_CHECK_PULLDOWN &CPU_TYPE_FAVORITE &CONNECT_TYPE_FAVORITE \
			&PATH_SELECTED_FAVORITE &PATH_SELECTED_BOOT_FAVORITE &PATH_SELECTED_NUM_FAVORITE
			IF &FAVORITE_VERI_CHECK_PULLDOWN==TRUE()
			(	
				PRINT "Favorite LOAD success"
				RETURN &CPU_TYPE_FAVORITE &CONNECT_TYPE_FAVORITE &PATH_SELECTED_FAVORITE &PATH_SELECTED_BOOT_FAVORITE				
			)
			ELSE
			(
				;PRINT "Varification fail PULLDOWN"
				RETURN &CPU_TYPE_FAVORITE &CONNECT_TYPE_FAVORITE &PATH_SELECTED_FAVORITE &PATH_SELECTED_BOOT_FAVORITE
			)
		)
		ELSE IF &APPLY_CHECK_SAVE_LOAD=="CHANGE"
		(
			ENTRY &FAVORITE_USE &FAVORITE_VERI_CHECK_PULLDOWN &CPU_TYPE_FAVORITE &CONNECT_TYPE_FAVORITE \
			&PATH_SELECTED_FAVORITE &PATH_SELECTED_BOOT_FAVORITE &PATH_SELECTED_NUM_FAVORITE
			IF &FAVORITE_VERI_CHECK_PULLDOWN==TRUE()
			(	
				PRINT "Favorite LOAD success"
				RETURN &CPU_TYPE_FAVORITE &CONNECT_TYPE_FAVORITE &PATH_SELECTED_FAVORITE &PATH_SELECTED_BOOT_FAVORITE				
			)
			ELSE
			(
				;PRINT "Varification fail CHANGE"
				RETURN &CPU_TYPE_FAVORITE &CONNECT_TYPE_FAVORITE &PATH_SELECTED_FAVORITE &PATH_SELECTED_BOOT_FAVORITE
			)
		)
	)
)
//-----------------------	END OF FAVORITE_SAVE_LOAD_SUB		-------------------


//-----------------------	FAVORITE_DYNA_HANDLE_SUB		---------------------------
FAVORITE_DYNA_HANDLE_SUB:
(
	LOCAL &CPU_TYPE_DYNA_HANDLE &CONNECT_TYPE_DYNA_HANDLE &PATH_SELECTED_DYNA_HANDLE &PATH_SELECTED_BOOT_DYNA_HANDLE
	LOCAL &SETTING_VALUE &SAVE_LOAD_FAVORITE &PULL_APPLY &USEBOOT_DYNA_HANDLE
	ENTRY &SETTING_VALUE &SAVE_LOAD_FAVORITE &PULL_APPLY &USEBOOT_DYNA_HANDLE
	GOSUB FAVORITE_SAVE_LOAD_SUB &SETTING_VALUE &SAVE_LOAD_FAVORITE &PULL_APPLY &USEBOOT_DYNA_HANDLE
	
	ENTRY &CPU_TYPE_DYNA_HANDLE &CONNECT_TYPE_DYNA_HANDLE &PATH_SELECTED_DYNA_HANDLE &PATH_SELECTED_BOOT_DYNA_HANDLE
	DIALOG.Set Dyna_Favorite	"CPU: &CPU_TYPE_DYNA_HANDLE"
	DIALOG.Set Dyna_Favorite2	"CONNECT: &CONNECT_TYPE_DYNA_HANDLE"
	DIALOG.Set Dyna_Favorite3	OS.FILE.NAME("&PATH_SELECTED_DYNA_HANDLE")
	IF &USEBOOT_DYNA_HANDLE==FALSE()
	(
		DIALOG.Set Dyna_Favorite4	""
	)
	ELSE
	(
		DIALOG.Set Dyna_Favorite4	OS.FILE.NAME("&PATH_SELECTED_BOOT_DYNA_HANDLE")
	)
	
	RETURN &CPU_TYPE_DYNA_HANDLE &CONNECT_TYPE_DYNA_HANDLE &PATH_SELECTED_DYNA_HANDLE &PATH_SELECTED_BOOT_DYNA_HANDLE
)
//-----------------------	END OF FAVORITE_DYNA_HANDLE_SUB		-------------------
//-----------------------	PATH_HANDLE_SUB		------------------------
PATH_HANDLE_SUB:
(
	LOCAL &CPU_TYPE_PATH_HANDLE &DefaultFolderName_HANDLE
	ENTRY &CPU_TYPE_PATH_HANDLE &DefaultFolderName_HANDLE
	IF "&CPU_TYPE_PATH_HANDLE"=="TC21x"
	(
		PRINT "hello21x"
		&ELF_PATH_CORE="ELF_PATH_TC21x_BOOT"
	)
	ELSE IF "&CPU_TYPE_PATH_HANDLE"=="TC22x"
	(
		PRINT "hello22x"
		&ELF_PATH_CORE="ELF_PATH_TC22x_BOOT"
	)
	ELSE IF "&CPU_TYPE_PATH_HANDLE"=="TC23x"
	(
		PRINT "hello23x"
		&ELF_PATH_CORE="ELF_PATH_TC23x_BOOT"
	)
	ELSE IF "&CPU_TYPE_PATH_HANDLE"=="TC26x"
	(
		PRINT "hello26x"
		&ELF_PATH_CORE="ELF_PATH_TC26x_BOOT"
	)
	ELSE IF "&CPU_TYPE_PATH_HANDLE"=="TC27x"
	(
		PRINT "hello27x"
		&ELF_PATH_CORE="ELF_PATH_TC27x_BOOT"
	)
	ELSE IF "&CPU_TYPE_PATH_HANDLE"=="TC29x"
	(
		PRINT "hello29x"
		&ELF_PATH_CORE="ELF_PATH_TC29x_BOOT"
	)
	ELSE IF "&CPU_TYPE_PATH_HANDLE"=="TC38x"
	(
		PRINT "hello38x"
		&ELF_PATH_CORE="ELF_PATH_TC38x_BOOT"
	)	
	ELSE IF "&CPU_TYPE_PATH_HANDLE"=="TC39x"
	(
		PRINT "hello39x"
		&ELF_PATH_CORE="ELF_PATH_TC39x_BOOT"
	)
		
	IF (!os.file(~~\Button\Env\Elf_path\&ELF_PATH_CORE.txt))
	(
		OPEN  #1 ~~\Button\Env\Elf_path\&ELF_PATH_CORE.txt /CREATE
		WRITE #1 "C:"
		WRITE #1 "C:"
		WRITE #1 "C:"
		WRITE #1 "C:"
		WRITE #1 "PATH_CHECK.1"
		WRITE #1 "TRUE()"
		CLOSE #1
	)
	OPEN  #1 ~~\Button\Env\Elf_path\&ELF_PATH_CORE.txt
	READ  #1 %line &PATH1
	READ  #1 %line &PATH2
	READ  #1 %line &PATH3
	READ  #1 %line &PATH4
	READ  #1 %line &PATH_SELECTED_NUM_CHECK
	READ  #1 &DEFAULT_PATH_CHECK_HANDLE
	CLOSE #1
	
	IF &DEFAULT_PATH_CHECK_HANDLE==TRUE()
	(
		&PATH_FOLDER1="&DefaultFolderName_HANDLE"
		&PATH_FOLDER2="&DefaultFolderName_HANDLE"
		&PATH_FOLDER3="&DefaultFolderName_HANDLE"
		&PATH_FOLDER4="&DefaultFolderName_HANDLE"		
	)
	ELSE
	(
		&PATH_FOLDER1=os.file.path("&PATH1")
		&PATH_FOLDER2=os.file.path("&PATH2")
		&PATH_FOLDER3=os.file.path("&PATH3")
		&PATH_FOLDER4=os.file.path("&PATH4")
	)

	DIALOG.Set PATH_1 OS.FILE.NAME("&PATH1")
	DIALOG.Set PATH_2 OS.FILE.NAME("&PATH2")
	DIALOG.Set PATH_3 OS.FILE.NAME("&PATH3")
	DIALOG.Set PATH_4 OS.FILE.NAME("&PATH4")

	DIALOG.SET &PATH_SELECTED_NUM_CHECK
	
	RETURN &ELF_PATH_CORE &DEFAULT_PATH_CHECK_HANDLE
)

PATH_HANDLE_DEFAULT_SUB:
(
	LOCAL &DEFAULT_PATH_CHECK_HANDLE &DefaultFolderName_HANDLE
	ENTRY &DEFAULT_PATH_CHECK_HANDLE &DefaultFolderName_HANDLE
	
	IF &DEFAULT_PATH_CHECK_HANDLE==TRUE()
	(
		&PATH_FOLDER1=os.file.path("&PATH1")
		&PATH_FOLDER2=os.file.path("&PATH2")
		&PATH_FOLDER3=os.file.path("&PATH3")
		&PATH_FOLDER4=os.file.path("&PATH4")
		&DEFAULT_PATH_CHECK_HANDLE=FALSE()
	)
	ELSE
	(
		
		&PATH_FOLDER1=&DefaultFolderName_HANDLE
		&PATH_FOLDER2=&DefaultFolderName_HANDLE
		&PATH_FOLDER3=&DefaultFolderName_HANDLE
		&PATH_FOLDER4=&DefaultFolderName_HANDLE	
		&DEFAULT_PATH_CHECK_HANDLE=TRUE()	


	)
	RETURN &DEFAULT_PATH_CHECK_HANDLE
)
//-----------------------	END OF PATH_HANDLE_SUB		------------------------

//-----------------------	PREVIOUS_INFORMATION_SAVE_SUB -----------------
PREVIOUS_INFORMATION_SAVE_SUB:
(
	LOCAL &CONNECT_INFORMATION_SAVE
	IF DIALOG.BOOLEAN(Option_Connect.1)
	(
		&CONNECT_INFORMATION_SAVE="DAP2"
	)
	ELSE IF DIALOG.BOOLEAN(Option_Connect.2)
	(
		&CONNECT_INFORMATION_SAVE="JTAG"
	)
	RETURN	&CONNECT_INFORMATION_SAVE
)
//-----------------------	END OF PREVIOUS_INFORMATION_SAVE_SUB		--------------------
//-----------------------	PATH_FILE_SAVE_SUB		------------------------
PATH_FILE_SAVE_SUB:
(
	LOCAL &ELF_PATH_CORE_SAVE
	ENTRY &ELF_PATH_CORE_SAVE &DEFAULT_PATH_CHECK_SAVE
	OPEN #1 ~~\Button\Env\Elf_path\&ELF_PATH_CORE_SAVE.txt /CREATE
	WRITE #1 "&PATH1"
	WRITE #1 "&PATH2"
	WRITE #1 "&PATH3"
	WRITE #1 "&PATH4"
	WRITE #1 "&PATH_SELECTED_NUM_CHECK"
	WRITE #1 "&DEFAULT_PATH_CHECK_SAVE"
	CLOSE #1
	RETURN	
)
//-----------------------	END OF PATH_FILE_SAVE_SUB		--------------------