B::
ENTRY &CPU_TYPE &CORE_SELECTED_T &MULTI_CORE_WINDOW_T &CORE_STATE_T &RAMFLASH_T &MCS_CORE &MCS_CHANNEL_NUMBER &MCS_CORE_CONFIG &GTM_SELECT_T &PC_T &PCADDRESS_T &USEBOOT_T &MODE_T &DefaultFolderName \
&Boot_PC_ADD
LOCAL &CPU_CHECK &DEFAULT_TOUCH
&DEFAULT_TOUCH=FALSE()
&CPU_CHECK=STRING.MID("&CPU_TYPE",0.,4.)
GOSUB MAIN

MAIN:
(
	DIALOG
	(
		POS 0. 0. 16. 8.
		BOX "CORE"
		POS 1. 1. 10. 1.
		CORE_CHEK.0: 	CHOOSEBOX "1 CORE" ""
		CORE_CHEK.1: 	CHOOSEBOX "2 CORE"
		(
			IF ("&CPU_CHECK"=="TC22"||"&CPU_CHECK"=="TC23")
			(
				DIALOG.SET CORE_CHEK.0
				PRINT "Current core is &CPU_TYPE, This option can not select."
			)
		)
		CORE_CHEK.2: 	CHOOSEBOX "3 CORE"
		(
			IF ("&CPU_CHECK"=="TC22"||"&CPU_CHECK"=="TC23"||"&CPU_CHECK"=="TC26")
			(
				DIALOG.SET CORE_CHEK.0
				PRINT "Current core is &CPU_TYPE, This option can not select."
			)
		)
		CORE_CHEK.3: 	CHOOSEBOX "4 CORE"
		(
			IF ("&CPU_CHECK"=="TC22"||"&CPU_CHECK"=="TC23"||"&CPU_CHECK"=="TC26"||"&CPU_CHECK"=="TC27")
			(
				DIALOG.SET CORE_CHEK.0
				PRINT "Current core is &CPU_TYPE, This option can not select."
			)
		)
		CORE_CHEK.4: 	CHOOSEBOX "5 CORE"
		(
			IF ("&CPU_CHECK"=="TC22"||"&CPU_CHECK"=="TC23"||"&CPU_CHECK"=="TC26"||"&CPU_CHECK"=="TC27"||"&CPU_CHECK"=="TC38")
			(
				DIALOG.SET CORE_CHEK.0
				PRINT "Current core is &CPU_TYPE, This option can not select."
			)
		)
		CORE_CHEK.5: 	CHOOSEBOX "6 CORE"
		(
			IF ("&CPU_CHECK"=="TC22"||"&CPU_CHECK"=="TC23"||"&CPU_CHECK"=="TC26"||"&CPU_CHECK"=="TC27"||"&CPU_CHECK"=="TC38")
			(
				DIALOG.SET CORE_CHEK.0
				PRINT "Current core is &CPU_TYPE, This option can not select."
			)
		)
		POS 16. 0. 18. 5.
		BOX "Boot"
		POS 17. 1. 4. 1.
		PC: CHECKBOX "PC:" ""

		POS 17. 2. 6. 1.
		USEBOOT: CHECKBOX "BOOT" ""		
		POS 22. 1. 11. 1.
		Boot_PC:   EDIT "0xA0000020"
		(;get the user input when the cursor leaves the EDIT control
			&Boot_PC_ADD=DIALOG.STRing(Boot_PC)
		)
		
		POS 0. 7. 16. 6.
		BOX "ETC"
		POS 1. 8. 14. 1.
		CORE_STATE: CHECKBOX "Core state" ""
		POS 1. 9. 14. 1.
		MULTI_CORE_WINDOW: CHECKBOX "Multicore window" ""
		POS 1. 10. 14. 1.
		SIMPLE_REPROGRAM: CHECKBOX "Simple reprogram" ""
		POS 1. 11. 14. 1. 
		RAMFLASH: CHECKBOX "Ramflash" ""	

		POS 19. 7. 10. 1.
		BUTTON "DEFAULT PATH "
		(		
			dialog.DIR "&DefaultFolderName"\*
			entry %line &DefaultFolderName
			print "&DefaultFolderName"
			&DEFAULT_TOUCH=TRUE()
		)		
		POS 0. 12. 34. 3.
		BOX "GTM"
		POS 1. 13. 10. 1.
		GTM_DEBUG: CHECKBOX "GTM Debug" ""
		POS 19. 13. 10. 1.
		BUTTON "[:edit]MCS "
		(
			DO ~~\Button\GTM_mcs.cmm 
		)		
		POS 1. 15. 10. 1.
		DEFBUTTON "APPLY" "JUMPTO CLOSEDIALOG2"
		CLOSE "GOTO CLOSEDIALOG"
	)
		;Default Configuration
		&CPU_CHECK=STRING.MID("&CPU_TYPE",0.,4.)
		PRINT "&CPU_CHECK"
		IF !("&CPU_CHECK"=="TC22"||"&CPU_CHECK"=="TC23")
		(
			IF "&CORE_SELECTED_T"=="SINGLE"
			(
				DIALOG.SET CORE_CHEK.0
			)
			ELSE IF "&CORE_SELECTED_T"=="DOUBLE"
			(
				DIALOG.SET CORE_CHEK.1
			)
			ELSE IF "&CORE_SELECTED_T"=="TRIPLE"
			(
				DIALOG.SET CORE_CHEK.2
			)
			ELSE IF "&CORE_SELECTED_T"=="QUAD"
			(
				DIALOG.SET CORE_CHEK.3
			)
			ELSE IF "&CORE_SELECTED_T"=="PENTA"
			(
				DIALOG.SET CORE_CHEK.4
			)
			ELSE IF "&CORE_SELECTED_T"=="HEXA"
			(
				DIALOG.SET CORE_CHEK.5
			)
		)
		ELSE
		(
			DIALOG.SET CORE_CHEK.0
		)
		IF &MULTI_CORE_WINDOW_T==TRUE()
		(
			DIALOG.SET MULTI_CORE_WINDOW
		)
		IF &RAMFLASH_T==TRUE()
		(
			DIALOG.SET RAMFLASH
		)
		IF &CORE_STATE_T==TRUE()
		(
			DIALOG.SET CORE_STATE
		)
		IF "&MODE_T"=="SIMPLE"
		(
			DIALOG.SET SIMPLE_REPROGRAM
		)
		IF "&GTM_SELECT_T"=="GTM_YES"
		(
			DIALOG.SET GTM_DEBUG
		)
		IF &PC_T==TRUE()
		(
			DIALOG.SET PC
		)
		DIALOG.SET Boot_PC "&Boot_PC_ADD"
		IF &USEBOOT_T==TRUE()
		(
			DIALOG.SET USEBOOT
		)
	STOP
)

CLOSEDIALOG:
	DIALOG.END
	ENDDO &CPU_TYPE &CORE_SELECTED_T &MULTI_CORE_WINDOW_T &CORE_STATE_T &RAMFLASH_T &MCS_CORE &MCS_CHANNEL_NUMBER &MCS_CORE_CONFIG &GTM_SELECT_T &PC_T &PCADDRESS_T &USEBOOT_T &MODE_T \
	&DefaultFolderName2
	
CLOSEDIALOG2:
	GOSUB CORE_CHECK_SUB
	GOSUB RESETGO_WRITE_SUB
	GOSUB ENVIRONMENT_WRITE_SUB
	DIALOG.END

	IF &DEFAULT_TOUCH==FALSE()
	(	
		ENDDO &CPU_TYPE &CORE_SELECTED_T &MULTI_CORE_WINDOW_T &CORE_STATE_T &RAMFLASH_T &MCS_CORE &MCS_CHANNEL_NUMBER &MCS_CORE_CONFIG &GTM_SELECT_T &PC_T &PCADDRESS_T &USEBOOT_T &MODE_T \
		&DefaultFolderName
	)
	ELSE
	(
		ENDDO &CPU_TYPE &CORE_SELECTED_T &MULTI_CORE_WINDOW_T &CORE_STATE_T &RAMFLASH_T &MCS_CORE &MCS_CHANNEL_NUMBER &MCS_CORE_CONFIG &GTM_SELECT_T &PC_T &PCADDRESS_T &USEBOOT_T &MODE_T \
		"&DefaultFolderName"
	)
	
	
	
//-----------------------		CORE_CHECK_SUB		-----------------------	
CORE_CHECK_SUB:
(
	IF DIALOG.BOOLEAN(CORE_CHEK.0)
	(
		&CORE_SELECTED_T="SINGLE"
	)
	ELSE IF DIALOG.BOOLEAN(CORE_CHEK.1)
	(	
		&CORE_SELECTED_T="DOUBLE"
		IF DIALOG.BOOLEAN(MULTI_CORE_WINDOW)
		(	
			&MULTI_CORE_WINDOW_T=TRUE()
		)
	)
	ELSE IF DIALOG.BOOLEAN(CORE_CHEK.2)
	(
		&CORE_SELECTED_T="TRIPLE"
		IF DIALOG.BOOLEAN(MULTI_CORE_WINDOW)
		(	
			&MULTI_CORE_WINDOW_T=TRUE()
		)
	)
	ELSE IF DIALOG.BOOLEAN(CORE_CHEK.3)
	(
		&CORE_SELECTED_T="QUAD"
		IF DIALOG.BOOLEAN(MULTI_CORE_WINDOW)
		(	
			&MULTI_CORE_WINDOW_T=TRUE()
		)
	)
	ELSE IF DIALOG.BOOLEAN(CORE_CHEK.4)
	(
		&CORE_SELECTED_T="PENTA"
		IF DIALOG.BOOLEAN(MULTI_CORE_WINDOW)
		(	
			&MULTI_CORE_WINDOW_T=TRUE()
		)
	)
	ELSE IF DIALOG.BOOLEAN(CORE_CHEK.5)
	(
		&CORE_SELECTED_T="HEXA"
		IF DIALOG.BOOLEAN(MULTI_CORE_WINDOW)
		(	
			&MULTI_CORE_WINDOW_T=TRUE()
		)
	)
	IF DIALOG.BOOLEAN(GTM_DEBUG)
	(
		&GTM_SELECT_T="GTM_YES"
	)
	ELSE
	(
		&GTM_SELECT_T="GTM_NO"
	)
	IF DIALOG.BOOLEAN(SIMPLE_REPROGRAM)
	(	
		&MODE_T="SIMPLE"
	)
	ELSE
	(	
		&MODE_T="COMPLEX"
	)
	IF DIALOG.BOOLEAN(CORE_STATE)
	(
		&CORE_STATE_T=TRUE()
	)
	ELSE
	(
		&CORE_STATE_T=FALSE()
	)	
	IF DIALOG.BOOLEAN(RAMFLASH)
	(
		&RAMFLASH_T=TRUE()
	)
	ELSE
	(
		&RAMFLASH_T=FALSE()
	)
	IF DIALOG.BOOLEAN(MULTI_CORE_WINDOW)
	(
		&MULTI_CORE_WINDOW_T=TRUE()
	)
	ELSE
	(
		&MULTI_CORE_WINDOW_T=FALSE()
	)
	IF DIALOG.BOOLEAN(PC)
	(
		&PC_T=TRUE()
	)
	ELSE
	(
		&PC_T=FALSE()
	)
	IF DIALOG.BOOLEAN(USEBOOT)
	(
		&USEBOOT_T=TRUE()
	)
	ELSE
	(
		&USEBOOT_T=FALSE()
	)
	RETURN
)
//-----------------------		ENVIRONMENT_WRITE_SUB		-----------------------	
ENVIRONMENT_WRITE_SUB:
(
	OPEN #1 ~~\Button\Env\ETC_PATH.txt /CREATE
	WRITE #1 "&CORE_SELECTED_T"
	WRITE #1 "&MODE_T"
	WRITE #1 "&MCS_CORE"
	WRITE #1 "&MCS_CORE_CONFIG"
	WRITE #1 "&MCS_CHANNEL_NUMBER"
	WRITE #1 "&GTM_SELECT_T"
	WRITE #1 "&CORE_STATE_T"
	WRITE #1 "&RAMFLASH_T"
	WRITE #1 "&MULTI_CORE_WINDOW_T"
	WRITE #1 "&PC_T"
	WRITE #1 "&PCADDRESS_T"
	WRITE #1 "&USEBOOT_T"
	IF &DEFAULT_TOUCH==FALSE()
	(	
		WRITE #1 &DefaultFolderName
	)
	ELSE
	(
		WRITE #1 "&DefaultFolderName"
	)
	WRITE #1 "&Boot_PC_ADD"
	CLOSE #1

	
	RETURN
)

//-----------------------		RESETGO_WRITE_SUB		-----------------------	
RESETGO_WRITE_SUB:
(
	OPEN #1 ~~\Button\Reset_go.CMM /CREATE
	WRITE #1 "b::"
	WRITE #1 "Sys.d"
	WRITE #1 "Sys.u"
	WRITE #1 "R.S PC " "&Boot_PC_ADD"
	WRITE #1 "GO"
	CLOSE #1
	RETURN
)
